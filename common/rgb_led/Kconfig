## common/rgb_led/Kconfig
```kconfig
#
# Copyright (c) 2026, Realtek Semiconductor Corporation
#
# SPDX-License-Identifier: LicenseRef-Realtek-5-Clause
#

menu "Realtek Common Module RGB LED"
config REALTEK_COMMON_MODULE_RGB_LED
    bool "Enable Realtek Common Module RGB LED"
    default n
    help
        Realtek common module RGB LED support.
endmenu
```

## common/rtk_charger/Kconfig
```kconfig
#
# Copyright (c) 2026, Realtek Semiconductor Corporation
#
# SPDX-License-Identifier: LicenseRef-Realtek-5-Clause
#

menu "Realtek Common Module RTK Charger"
config REALTEK_COMMON_MODULE_RTK_CHARGER
    bool "Enable Realtek Common Module RTK Charger"
    default n
    help
        Realtek common module RTK charger support.
endmenu
```

## common/stream/Kconfig
```kconfig
#
# Copyright (c) 2026, Realtek Semiconductor Corporation
#
# SPDX-License-Identifier: LicenseRef-Realtek-5-Clause
#

menu "Realtek Common Module Stream"
config REALTEK_COMMON_MODULE_STREAM
    bool "Enable Realtek Common Module Stream"
    default n
    help
        Realtek common module stream support.
endmenu
```

## common/sw_keyscan/Kconfig
```kconfig
#
# Copyright (c) 2026, Realtek Semiconductor Corporation
#
# SPDX-License-Identifier: LicenseRef-Realtek-5-Clause
#

menu "Realtek Common Module Sw Keyscan"
config REALTEK_COMMON_MODULE_SW_KEYSCAN
    bool "Enable Realtek Common Module Sw Keyscan"
    default n
    help
        Realtek common module sw keyscan support.
endmenu
```

## common/usb/Kconfig
```kconfig
#
# Copyright (c) 2026, Realtek Semiconductor Corporation
#
# SPDX-License-Identifier: LicenseRef-Realtek-5-Clause
#

menu "Realtek Common Module Usb"
config REALTEK_COMMON_MODULE_USB
    bool "Enable Realtek Common Module Usb"
    default n
    help
        Realtek common module usb support.
endmenu
```

## common/vector/Kconfig
```kconfig
#
# Copyright (c) 2026, Realtek Semiconductor Corporation
#
# SPDX-License-Identifier: LicenseRef-Realtek-5-Clause
#

menu "Realtek Common Module Vector"
config REALTEK_COMMON_MODULE_VECTOR
    bool "Enable Realtek Common Module Vector"
    default n
    help
        Realtek common module vector support.
endmenu
```

## samples/tinyml/Kconfig
```kconfig
#
# Copyright (c) 2026, Realtek Semiconductor Corporation
#
# SPDX-License-Identifier: LicenseRef-Realtek-5-Clause
#

menu "TinyML Application"
rsource "src/apps/Kconfig"
endmenu

source "Kconfig.zephyr"
```

## samples/tinyml/src/apps/bench/Kconfig
```kconfig
#
# Copyright (c) 2026, Realtek Semiconductor Corporation
#
# SPDX-License-Identifier: LicenseRef-Realtek-5-Clause
#

config TINYML_APP_BENCH
	bool "Benchmark (UART-streamed model)"
	select SERIAL
	select UART_INTERRUPT_DRIVEN
	help
	  Host-driven test harness: the model and input data are streamed in
	  over the data UART (uart2) using a framed protocol, and results / RAM
	  usage / operator lists / profiler traces are streamed back to the PC
	  tool.  Requires the interrupt-driven UART and the uart2 node enabled
	  by the board overlay.
```

## samples/tinyml/src/apps/ic/Kconfig
```kconfig
#
# Copyright (c) 2026, Realtek Semiconductor Corporation
#
# SPDX-License-Identifier: LicenseRef-Realtek-5-Clause
#

config TINYML_APP_IC
	bool "Image classification (96x96 RGB)"
	help
	  Classify a 96x96 RGB image embedded in the firmware with a
	  convolutional classifier.  RGB [0,1] normalization is done in plain C
	  (ic_normalize.c); the model runs on the shared ts_realtek engine.
```

## samples/tinyml/src/apps/kws/Kconfig
```kconfig
#
# Copyright (c) 2026, Realtek Semiconductor Corporation
#
# SPDX-License-Identifier: LicenseRef-Realtek-5-Clause
#

config TINYML_APP_KWS
	bool "Keyword spotting"
	help
	  Offline streaming keyword-spotting demo driven by a static PCM clip.
	  The clip is fed through a mel feature frontend (libkws_feature) and a
	  streaming wake-word model on the shared ts_realtek engine.
```

## samples/tinyml/src/apps/motion/Kconfig
```kconfig
#
# Copyright (c) 2026, Realtek Semiconductor Corporation
#
# SPDX-License-Identifier: LicenseRef-Realtek-5-Clause
#

config TINYML_APP_MOTION
	bool "Motion recognition"
	help
	  TinyMotion 1D-CNN motion-trajectory recognition on a raw accelerometer
	  window embedded in the firmware.  z-score + int8 quantization is done
	  in plain C (motion_preprocess.c); the model runs on the shared
	  ts_realtek engine with a confidence-threshold open-set gate.
```

## subsys/Kconfig
```kconfig
#
# Copyright (c) 2026, Realtek Semiconductor Corporation
#
# SPDX-License-Identifier: LicenseRef-Realtek-5-Clause
#

menu "Realtek SDK subsys selection"
rsource "*/Kconfig"
endmenu
```

## subsys/bluetooth/gatt_profile/Kconfig
```kconfig
#
# Copyright (c) 2026, Realtek Semiconductor Corporation
#
# SPDX-License-Identifier: LicenseRef-Realtek-5-Clause
#

# This Kconfig file is picked by the Zephyr build system because it is defined
# as the module Kconfig entry point (see zephyr/module.yml). You can browse
# module options by going to Zephyr -> Modules in Kconfig.


menu "Realtek Subsys BLE GATT Profiles"
    menu "Client"
        config REALTEK_SUBSYS_GATT_PROFILE_AMS_CLIENT
            bool "Enable Realtek GATT profile AMS client"
            default n
            help
                Realtek GATT profile AMS client support.
        
        config REALTEK_SUBSYS_GATT_PROFILE_ANCS_CLIENT
            bool "Enable Realtek GATT profile ANCS client"
            default n
            help
                Realtek GATT profile ANCS client support.

        config REALTEK_SUBSYS_GATT_PROFILE_ASP_CLIENT
            bool "Enable Realtek GATT profile ASP client"
            default n
            help
                Realtek GATT profile ASP client support.

        config REALTEK_SUBSYS_GATT_PROFILE_BAS_CLIENT
            bool "Enable Realtek GATT profile BAS client"
            default n
            help
                Realtek GATT profile BAS client support.

        config REALTEK_SUBSYS_GATT_PROFILE_DIS_CLIENT
            bool "Enable Realtek GATT profile DIS client"
            default n
            help
                Realtek GATT profile DIS client support.

        config REALTEK_SUBSYS_GATT_PROFILE_GAPS_CLIENT
            bool "Enable Realtek GATT profile GAPS client"
            default n
            help
                Realtek GATT profile GAPS client support.

        config REALTEK_SUBSYS_GATT_PROFILE_HID_OVER_ISO_CLIENT
            bool "Enable Realtek GATT profile HID over ISO client"
            default n
            help
                Realtek GATT profile HID over ISO client support.

        config REALTEK_SUBSYS_GATT_PROFILE_HIDS_CFU_CLIENT
            bool "Enable Realtek GATT profile HIDS CFU client"
            default n
            help
                Realtek GATT profile HIDS CFU client support.

        config REALTEK_SUBSYS_GATT_PROFILE_HIDS_CLIENT
            bool "Enable Realtek GATT profile HIDS client"
            default n
            help
                Realtek GATT profile HIDS client support.

        config REALTEK_SUBSYS_GATT_PROFILE_IAS_CLIENT
            bool "Enable Realtek GATT profile IAS client"
            default n
            help
                Realtek GATT profile IAS client support.
    endmenu
    menu "Server"
        config REALTEK_SUBSYS_GATT_PROFILE_ASP_SERVER
            bool "Enable Realtek GATT profile ASP server"
            default n
            help
                Realtek GATT profile ASP server support.
        
        config REALTEK_SUBSYS_GATT_PROFILE_BAS_SERVER
            bool "Enable Realtek GATT profile BAS server"
            default n
            help
                Realtek GATT profile BAS server support.

        config REALTEK_SUBSYS_GATT_PROFILE_DIS_SERVER
            bool "Enable Realtek GATT profile DIS server"
            default n
            help
                Realtek GATT profile DIS server support.

        config REALTEK_SUBSYS_GATT_PROFILE_HID_OVER_ISO_SERVER
            bool "Enable Realtek GATT profile HID over ISO server"
            default n
            help
                Realtek GATT profile HID over ISO server support.

        config REALTEK_SUBSYS_GATT_PROFILE_HIDS_CFU_SERVER
            bool "Enable Realtek GATT profile HIDS CFU server"
            default n
            help
                Realtek GATT profile HIDS CFU server support.

        config REALTEK_SUBSYS_GATT_PROFILE_HIDS_SERVER
            bool "Enable Realtek GATT profile HIDS server"
            default n
            help
                Realtek GATT profile HIDS server support.

        config REALTEK_SUBSYS_GATT_PROFILE_IAS_SERVER
            bool "Enable Realtek GATT profile IAS server"
            default n
            help
                Realtek GATT profile IAS server support.

        config REALTEK_SUBSYS_GATT_PROFILE_TPS_SERVER
            bool "Enable Realtek GATT profile TPS server"
            default n
            help
                Realtek GATT profile TPS server support.

        config REALTEK_SUBSYS_GATT_PROFILE_TRANSMIT_SVC_DONGLE_SERVER
            bool "Enable Realtek GATT profile transmit dongle server"
            default n
            help
                Realtek GATT profile transmit dongle server support.
        
        config REALTEK_SUBSYS_GATT_PROFILE_HRS_SERVER
            bool "Enable Realtek GATT profile HRS server"
            default n
            help
                Realtek GATT profile HRS server support.
    endmenu
endmenu
```

## west.yml
```yaml
manifest:
  version: '1.2'
  remotes:
  - name: fork
    url-base: https://github.com/Haonan-Shi
  defaults:
    remote: fork
  projects:
  - name: zephyr
    repo-path: zephyr
    revision: 6088863e727cd5578989e65b1cabaf33810c76af
    path: zephyrproject/zephyr
    west-commands: scripts/west-commands.yml
  - name: cmsis
    url: https://github.com/zephyrproject-rtos/cmsis.git
    revision: 4b96cbb174678dcd3ca86e11e1f24bc5f8726da0
    path: zephyrproject/modules/hal/cmsis
    groups:
    - hal
  - name: fatfs
    url: https://github.com/zephyrproject-rtos/fatfs.git
    revision: 427159bf95ea49b7680facffaa29ad506b42709b
    path: zephyrproject/modules/fs/fatfs
    groups:
    - fs
  - name: mbedtls
    url: https://github.com/zephyrproject-rtos/mbedtls.git
    revision: a78176c6ff0733ba08018cba4447bd3f20de7978
    path: zephyrproject/modules/crypto/mbedtls
    groups:
    - crypto
  - name: tinycrypt
    url: https://github.com/zephyrproject-rtos/tinycrypt.git
    revision: 1012a3ebee18c15ede5efc8332ee2fc37817670f
    path: zephyrproject/modules/crypto/tinycrypt
    groups:
    - crypto
  - name: honeygui
    repo-path: HoneyGUI
    revision: ebe9378874810fd86c239f1def9488878257be6f
    path: zephyrproject/modules/honeygui
  - name: lvgl
    repo-path: lvgl
    revision: 491c579e0dafb49917100d45510e0d741a89d116
    path: zephyrproject/modules/lvgl
  - name: hal_realtek
    repo-path: zephyr-hal
    revision: 51b8588b5e9b174373f7475c5c972b514ba32872
    path: zephyrproject/modules/hal/realtek
  - name: display
    repo-path: display
    revision: 8a44eafb0e6a78952eaacbfe5ac106b80fdd373d
    path: zephyrproject/modules/display
  self:
    path: zephyrproject/realtek-app
    userdata:
      product: common
      version: v1.0.0.21
```
