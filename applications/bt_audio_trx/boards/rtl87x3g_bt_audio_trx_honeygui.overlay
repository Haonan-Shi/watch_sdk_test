/*
 * Copyright (c) 2026, Realtek Semiconductor Corporation
 *
 * SPDX-License-Identifier: LicenseRef-Realtek-5-Clause
 */

#include <zephyr/dt-bindings/gpio/realtek-rtl87x3g-gpio.h>
#include <dt-bindings/pinctrl/rtl87x3g-pinctrl.h>

&display_lcd {
	status = "okay";
};

&i2c1 {
	status = "okay";
};

&touch_device {
	status = "okay";
};

