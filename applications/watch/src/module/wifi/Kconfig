## applications/watch/src/module/wifi/Kconfig
```kconfig
#
# Copyright (c) 2026, Realtek Semiconductor Corporation
#
# SPDX-License-Identifier: LicenseRef-Realtek-5-Clause
#

menu "WIFI module config"
	config WIFI
		bool "WIFI support"
		default n
	help
		This option enables the WIFI.

	config WIFI_CAMERA
		depends on WIFI
		bool "WIFI Camera support"
		default n
	help
	  	This option enables the WIFI Camera.

	config WIFI_RTSP
		bool "wifi rtsp support"
		depends on WIFI_CAMERA
		default y
	help
	  	This option enables the mjpeg rtsp protocol.

	config WIFI_JPEG_PARSER
		bool "jpeg parser support"
		depends on WIFI_CAMERA
		default n
	help
	  	This option enables the mjpeg parser for http protocol.

	config WIFI_AUDIO_PLAYER
		bool "wifi audio player support"
		depends on WIFI_RTSP
		default n
	help
	  	This option enables the wifi audio player for wifi camera.

	config WIFI_AUDIO_RECORDER
		bool "wifi audio recorder support"
		depends on WIFI_CAMERA
		default n
	help
	  	This option enables the wifi audio recorder for wifi camera.

endmenu
```

## applications/watch/src/module/wifi_8711/Kconfig
```kconfig
#
# Copyright (c) 2026, Realtek Semiconductor Corporation
#
# SPDX-License-Identifier: LicenseRef-Realtek-5-Clause
#

menu "WIFI 8711 (AT-over-SPI) module config"
	config WIFI_8711
		bool "WiFi 8711 AT-over-SPI support"
		default n
	help
		This option enables the WiFi 8711 AT-over-SPI module: the SPI master
		driver toward the 8711 WiFi AT slave chip, the AT-over-SPI command
		engine and the SPI/TCP throughput test. Enabled by the wifi_8711 snippet
		(applications/watch/snippets/wifi_8711), which also supplies the
		wifi_8711_device / wifi_8711_resources devicetree nodes the SPI
		master binds to.

	config WIFI_8711_ROLE_MASTER
		bool "WiFi 8711 SPI master role"
		depends on WIFI_8711
		default y
	help
		Build the SPI master side (drives the 8711 slave over SPI DMA). This is
		the only role the watch supports; keep it enabled.

	config WIFI_8711_ROLE_SLAVE
		bool "WiFi 8711 SPI slave role"
		depends on WIFI_8711
		default n
	help
		Build the SPI slave side. No slave implementation exists on the watch,
		so this stays disabled.

	config WIFI_8711_TEST
		bool "WiFi 8711 shell test commands"
		depends on WIFI_8711 && SHELL
		default n
	help
		Register the `wifi8711` shell command group (SPI role init, AT WLCONN /
		WLDISCONN, and the SPI+TCP throughput test) so the flows previously
		triggered by host commands in app_cmd.c can be driven from a UART
		console. Replaces the CMD_SPI_INIT / CMD_AT_CMD_WLCONN /
		CMD_SPI_TCP_TP_TEST handling.

endmenu
```

## applications/watch/src/shell_app/Kconfig
```kconfig
#
# Copyright (c) 2026, Realtek Semiconductor Corporation
#
# SPDX-License-Identifier: LicenseRef-Realtek-5-Clause
#

menu "Shell App Test Scenarios"

    config SHELL_APP
        bool "root config of the shell app test scenarios"
        default n
        help
           Root config of the zephyr-shell app test scenarios under
           src/shell_app. Enable it plus the per-scenario options below
           (usually via the "shell" snippet).


    config SHELL_APP_A2DP_SRC
        bool "A2DP source play-music shell test module"
        depends on SHELL_APP && SHELL
        default n
        help
          Shell-driven A2DP-source test: scan / connect a headphone / play
          local music (MP3 if present, else synthetic SBC) / stop, via the
          `a2dp_src` shell command. Decoupled test module; event_bus for coupling.

    config SHELL_APP_WIFI_BASIC
        bool "WiFi basic shell test module"
        depends on SHELL_APP && SHELL && WIFI
        default n
        help
          Shell-driven WiFi test: enter / connect AP (SSID+password) /
          uplink throughput (ATWT client) / downlink throughput (ATWT server),
          via the `wifi` shell command. Decoupled via event_bus.


    config SHELL_APP_DLPS
        bool "DLPS power-consumption shell test module"
        depends on SHELL_APP && SHELL && PM
        default n
        help
          Shell-driven DLPS power test: enter (BT off, DLPS mode on) /
          40m / 100m / 200m CPU frequency cycles / stop / status.
          Each test cycle: CPU active 500 us, sleep 65.5 ms (66 ms period).

    config SHELL_APP_BLE_THROUGHPUT
        bool "BLE throughput monitor shell module"
        depends on SHELL_APP && SHELL
        default n
        help
          Read-only shell front-end for the Phone-driven LE throughput GATT
          service in src/app. Subscribes to pushed test snapshots via event_bus
          and exposes `ble_throughput` commands: enter / exit / status / report / link /
          monitor / reset, plus `stop` (the only control) to abort a test.

endmenu
```

## boards/realtek/rtl87x3g_bt_audio_trx/Kconfig.defconfig
```kconfig
#
# Copyright (c) 2026, Realtek Semiconductor Corporation
#
# SPDX-License-Identifier: LicenseRef-Realtek-5-Clause
#

if BOARD_RTL87X3G_BT_AUDIO_TRX

config BOARD
	default "rtl87x3g_bt_audio_trx"

endif #BOARD_RTL87X3G_BT_AUDIO_TRX
```

## boards/realtek/rtl87x3g_bt_audio_trx/Kconfig.rtl87x3g_bt_audio_trx
```kconfig
#
# Copyright (c) 2026, Realtek Semiconductor Corporation
#
# SPDX-License-Identifier: LicenseRef-Realtek-5-Clause
#

config BOARD_RTL87X3G_BT_AUDIO_TRX
	select SOC_RTL8773GTP if BOARD_RTL87X3G_BT_AUDIO_TRX_RTL8773GTP
	select SOC_RTL8783GBF if BOARD_RTL87X3G_BT_AUDIO_TRX_RTL8783GBF
    select SOC_RTL8763GWS if BOARD_RTL87X3G_BT_AUDIO_TRX_RTL8763GWS
    select SOC_RTL8763GTS if BOARD_RTL87X3G_BT_AUDIO_TRX_RTL8763GTS
```

## boards/realtek/rtl87x3g_bt_audio_trx/board.yml
```yaml
#
# Copyright (c) 2026, Realtek Semiconductor Corporation
#
# SPDX-License-Identifier: LicenseRef-Realtek-5-Clause
#

board:
  name: rtl87x3g_bt_audio_trx
  vendor: realtek
  socs:
  - name: rtl8773gtp
  - name: rtl8783gbf
  - name: rtl8763gws
  - name: rtl8763gts
```

## boards/realtek/rtl87x3g_bt_audio_trx/rtl87x3g_bt_audio_trx_rtl8763gts_defconfig
```kconfig
#
# Copyright (c) 2026, Realtek Semiconductor Corporation
#
# SPDX-License-Identifier: LicenseRef-Realtek-5-Clause
#

#DISASSEMBLY
CONFIG_OUTPUT_DISASSEMBLY=y

# Console Driver
# CONFIG_CONSOLE=y
# CONFIG_UART_CONSOLE=y

# UART Driver
# CONFIG_SERIAL=y
# CONFIG_UART_INTERRUPT_DRIVEN=y
# CONFIG_UART_ASYNC_API=y

# Enable HW stack protection
CONFIG_HW_STACK_PROTECTION=y
```

## boards/realtek/rtl87x3g_sample/Kconfig.defconfig
```kconfig
#
# Copyright (c) 2026, Realtek Semiconductor Corporation
#
# SPDX-License-Identifier: LicenseRef-Realtek-5-Clause
#
if BOARD_RTL87X3G_SAMPLE

config BOARD
	default "rtl87x3g_sample"

endif #BOARD_RTL87X3G_SAMPLE
```

## boards/realtek/rtl87x3g_sample/Kconfig.rtl87x3g_sample
```kconfig
#
# Copyright (c) 2026, Realtek Semiconductor Corporation
#
# SPDX-License-Identifier: LicenseRef-Realtek-5-Clause
#
config BOARD_RTL87X3G_SAMPLE
	select SOC_RTL8773GTP
```

## boards/realtek/rtl87x3g_watch/Kconfig.defconfig
```kconfig
#
# Copyright (c) 2026, Realtek Semiconductor Corporation
#
# SPDX-License-Identifier: LicenseRef-Realtek-5-Clause
#

if BOARD_RTL87X3G_WATCH

config BOARD
	default "rtl87x3g_watch"

endif #BOARD_RTL87x3G_WATCH
```

## boards/realtek/rtl87x3g_watch/Kconfig.rtl87x3g_watch
```kconfig
#
# Copyright (c) 2026, Realtek Semiconductor Corporation
#
# SPDX-License-Identifier: LicenseRef-Realtek-5-Clause
#

config BOARD_RTL87X3G_WATCH
	select SOC_RTL8773GTP if BOARD_RTL87X3G_WATCH_RTL8773GTP
	select SOC_RTL8773GTP if BOARD_RTL87X3G_WATCH_RTL8773GTP_NANDBOOT
	select SOC_NAND_BOOT if BOARD_RTL87X3G_WATCH_RTL8773GTP_NANDBOOT
	select SOC_RTL8783GBF if BOARD_RTL87X3G_WATCH_RTL8783GBF
```

## boards/realtek/rtl87x3g_watch/board.yml
```yaml
board:
  name: rtl87x3g_watch
  vendor: realtek
  socs:
  - name: rtl8773gtp
    variants:
    - name: nandboot
  - name: rtl8783gbf
```

## boards/realtek/rtl87x3g_watch/rtl87x3g_watch_rtl8783gbf_defconfig
```kconfig
# Copyright (c) 2024 Realtek Semiconductor Corp.
# SPDX-License-Identifier: Apache-2.0
#################Zephyr Kernel Config########################
# Enable HW stack protection
CONFIG_HW_STACK_PROTECTION=y
# DISASSEMBLY
CONFIG_OUTPUT_DISASSEMBLY=y
#compile and libc config
CONFIG_NEWLIB_LIBC=y
CONFIG_NEWLIB_LIBC_MIN_REQUIRED_HEAP_SIZE=0
#zephyr assert
CONFIG_ASSERT=y
#zephyr log config
CONFIG_LOG=y
CONFIG_LOG_DEFAULT_LEVEL=3
CONFIG_PRINTK=y
CONFIG_DEBUG_COREDUMP=y
CONFIG_DEBUG_COREDUMP_BACKEND_LOGGING=y
CONFIG_DEBUG_COREDUMP_MEMORY_DUMP_MIN=y
CONFIG_EXTRA_EXCEPTION_INFO=y
CONFIG_THREAD_ANALYZER=y
CONFIG_THREAD_NAME=y
# used by dma
CONFIG_HEAP_MEM_POOL_SIZE=2048 
#################Zephyr Drivers Config########################
#hardware device config
CONFIG_GPIO=y
CONFIG_RTL87X3G_USE_P8_6_AS_GPIOB19=y
CONFIG_RTL87X3G_USE_P8_7_AS_GPIOB20=y

CONFIG_I2C=y
CONFIG_RTC=y
CONFIG_DMA=y
CONFIG_RTC_RTL87X3G=y
CONFIG_RTC_ALARM=y
CONFIG_SENSOR=y
CONFIG_QDEC_RTL87X3G=y
CONFIG_RTL87X3G_QDEC_X_AXIS_ENABLE=y
CONFIG_GPIO_ENABLE_DISABLE_INTERRUPT=y
CONFIG_SDHC_RTL87X3G_TUNING=n
CONFIG_SDHC_RTL87X3G_READ_STATIC=y
# Console Driver
CONFIG_CONSOLE=n
CONFIG_UART_CONSOLE=n
# UART Driver
CONFIG_SERIAL=n
CONFIG_UART_INTERRUPT_DRIVEN=n
CONFIG_UART_ASYNC_API=n

#################Zephyr Tasks Config########################
#if do fsmk, main stack size may need to increase.
CONFIG_MAIN_STACK_SIZE=3072
CONFIG_IDLE_STACK_SIZE=1536
# rtk log need 252 stack size
CONFIG_SYSTEM_WORKQUEUE_STACK_SIZE=3072

#################Realtek System Config########################
#log output by rtk
CONFIG_LOG_RTK=y
```

## common/Kconfig
```kconfig
#
# Copyright (c) 2026, Realtek Semiconductor Corporation
#
# SPDX-License-Identifier: LicenseRef-Realtek-5-Clause
#

menu "Realtek SDK common modules selection"
rsource "*/Kconfig"
endmenu
```

## common/console/Kconfig
```kconfig
#
# Copyright (c) 2026, Realtek Semiconductor Corporation
#
# SPDX-License-Identifier: LicenseRef-Realtek-5-Clause
#

menu "Realtek Common Module Console"
config REALTEK_COMMON_MODULE_CONSOLE
    bool "Enable Realtek Common Module Console"
    default n
    help
       Realtek common module console support.
endmenu
```

## common/data_transfer/Kconfig
```kconfig
#
# Copyright (c) 2026, Realtek Semiconductor Corporation
#
# SPDX-License-Identifier: LicenseRef-Realtek-5-Clause
#

menu "Realtek Common Module Data Transfer"
config REALTEK_COMMON_MODULE_DATA_TRANSFER
    bool "Enable Realtek Common Module Data Transfer"
    default n
    help
        Realtek common module data transfer support.
endmenu
```

## common/data_uart_cmd/Kconfig
```kconfig
#
# Copyright (c) 2026, Realtek Semiconductor Corporation
#
# SPDX-License-Identifier: LicenseRef-Realtek-5-Clause
#

menu "Realtek Common Module Data Uart Cmd"
config REALTEK_COMMON_MODULE_DATA_UART_CMD
    bool "Enable Realtek Common Module Data Uart Cmd"
    default n
    help
        Realtek common module data uart cmd support.
endmenu
```

## common/eq/Kconfig
```kconfig
#
# Copyright (c) 2026, Realtek Semiconductor Corporation
#
# SPDX-License-Identifier: LicenseRef-Realtek-5-Clause
#

menu "Realtek Common Module Eq"
config REALTEK_COMMON_MODULE_EQ
    bool "Enable Realtek Common Module Eq"
    default n
    help
        Realtek common module eq support.
endmenu
```

## common/ir_detect_pulse/Kconfig
```kconfig
#
# Copyright (c) 2026, Realtek Semiconductor Corporation
#
# SPDX-License-Identifier: LicenseRef-Realtek-5-Clause
#

menu "Realtek Common Module Ir Detect Pulse"
config REALTEK_COMMON_MODULE_IR_DETECT_PULSE
    bool "Enable Realtek Common Module Ir Detect Pulse"
    default n
    help
        Realtek common module ir detect pulse support.
endmenu
```

## common/led/Kconfig
```kconfig
#
# Copyright (c) 2026, Realtek Semiconductor Corporation
#
# SPDX-License-Identifier: LicenseRef-Realtek-5-Clause
#

menu "Realtek Common Module Led"
config REALTEK_COMMON_MODULE_LED
    bool "Enable Realtek Common Module Led"
    default n
    help
        Realtek common module led support.
endmenu
```

## common/local_audio/Kconfig
```kconfig
#
# Copyright (c) 2026, Realtek Semiconductor Corporation
#
# SPDX-License-Identifier: LicenseRef-Realtek-5-Clause
#

menu "Realtek Common Module Local Audio"
config REALTEK_COMMON_MODULE_LOCAL_AUDIO
    bool "Enable Realtek Common Module Local Audio"
    default n
    help
        Realtek common module local audio support.
endmenu
```

## common/malleus/Kconfig
```kconfig
#
# Copyright (c) 2026, Realtek Semiconductor Corporation
#
# SPDX-License-Identifier: LicenseRef-Realtek-5-Clause
#

menu "Realtek Common Module Malleus"
config REALTEK_COMMON_MODULE_MALLEUS
    bool "Enable Realtek Common Module Malleus"
    default n
    help
        Realtek common module malleus support.
endmenu
```
