## applications/watch/src/Kconfig
```kconfig
#
# Copyright (c) 2026, Realtek Semiconductor Corporation
#
# SPDX-License-Identifier: LicenseRef-Realtek-5-Clause
#

rsource "app/Kconfig"
rsource "comm/Kconfig"
rsource "dev/Kconfig"
rsource "event_bus/Kconfig"
rsource "gui/Kconfig"
rsource "hub/Kconfig"
rsource "module/Kconfig"
rsource "shell_app/Kconfig"
rsource "dev/Kconfig"
```

## applications/watch/src/app/Kconfig
```kconfig
#
# Copyright (c) 2026, Realtek Semiconductor Corporation
#
# SPDX-License-Identifier: LicenseRef-Realtek-5-Clause
#

menu "Realtek Watch Application Select"
	config SC_KEY_DERIVE
		bool "one-click connection"
		default n
		help
		  SC = Secure Connection. When enabled, after a successful BLE connection, a security key will be automatically derived and the BT connection will be initiated.

	config GATT_OVER_BREDR
		bool "GATT over BR/EDR support"
		default n
		help
		  Enable GATT service over classic Bluetooth (BR/EDR) transport.

	config WECHAT_CALL_ON_PHONE_OUTPUT_ONLY
		bool "Disable WeChat call audio output on watch"
		default n
		help
		  If enabled, WeChat call audio will not be played on the watch.
	config PHONEBOOK_SYNC_SUPPORT
		bool "Enable phonebook sync"
		default n
		help
		  Enable synchronization of phonebook data via PBAP.
	config BLE_DEFAULT_LINKS
		int "ble default links"
		default 1
	help
		This option configs ble default links.
endmenu
```

## applications/watch/src/dev/Kconfig
```kconfig
#
# Copyright (c) 2026, Realtek Semiconductor Corporation
#
# SPDX-License-Identifier: LicenseRef-Realtek-5-Clause
#

# This loads watch source code config

menu "Realtek Watch Application Device Select"
rsource "charger/Kconfig"
rsource "gsensor/Kconfig"
rsource "qdec/Kconfig"
rsource "usb/Kconfig"
rsource "mfb/Kconfig"
endmenu
```

## applications/watch/src/dev/charger/Kconfig
```kconfig
#
# Copyright (c) 2026, Realtek Semiconductor Corporation
#
# SPDX-License-Identifier: LicenseRef-Realtek-5-Clause
#

config INTERNAL_CHARGER
	bool "Enable internal charger"
	default n
	depends on HUB_CHARGER
help
	This config for enable internal charger
	
config CJ4056_CHARGER
	bool "Enable cj4056 charger"
	default n
	depends on HUB_CHARGER
help
	This config for enable cj4056 charger
```

## applications/watch/src/dev/gsensor/Kconfig
```kconfig
#
# Copyright (c) 2026, Realtek Semiconductor Corporation
#
# SPDX-License-Identifier: LicenseRef-Realtek-5-Clause
#

config GSENSOR_STK8321
	bool "Enable gensor stk8321"
	default n
	depends on HUB_GSENSOR
help
	This config for enable gsensor stk8321
```

## applications/watch/src/dev/qdec/Kconfig
```kconfig
#
# Copyright (c) 2026, Realtek Semiconductor Corporation
#
# SPDX-License-Identifier: LicenseRef-Realtek-5-Clause
#

config QDEC
	bool "Enable qdec"
	default n
help
	This config for enable qdec
```

## applications/watch/src/event_bus/Kconfig
```kconfig
#
# Copyright (c) 2026, Realtek Semiconductor Corporation
#
# SPDX-License-Identifier: LicenseRef-Realtek-5-Clause
#

config EVENT_BUS
	bool "App event bus module (pub/sub)"
	default y
	help
	  This option enables the event_bus module which provides
	  a lightweight publish/subscribe mechanism for event
	  communication between modules.

config EVENT_BUS_LOG
	bool "App event bus log enable"
	depends on EVENT_BUS && LOG
	default y
	help
	  Enable Zephyr logging for the event_bus module.

if EVENT_BUS_LOG

module = EVENT_BUS
module-str = event_bus
source "subsys/logging/Kconfig.template.log_config"

endif
```

## applications/watch/src/gui/Kconfig
```kconfig
#
# Copyright (c) 2026, Realtek Semiconductor Corporation
#
# SPDX-License-Identifier: LicenseRef-Realtek-5-Clause
#

# This loads watch source code config

menu "Realtek Watch Application GUI Select"
config REALTEK_HONEYGUI_410_502_HMI_SMARTWATCH_DEMO
    bool "Compile HMI designer smartwatch demo"
	default n
    help
        Compile HMI designer smartwatch demo.
endmenu
```

## applications/watch/src/hub/Kconfig
```kconfig
#
# Copyright (c) 2026, Realtek Semiconductor Corporation
#
# SPDX-License-Identifier: LicenseRef-Realtek-5-Clause
#

# This loads watch source code config

menu "Realtek Watch Application HUB Select"
	
	config HUB_CHARGER
		bool "hub charger"
		default n
	help
		This option enables the charger.
	
	config HUB_CLOCK
		bool "hub clock"
		default y
	help
		This option enables the clock.
		
	config HUB_GSENSOR
		bool "hub gsensor"
		default n
		select GSENSOR_STK8321
	help
		This option enables the gsensor.
	
	config HUB_HRS
		bool "hub hrs"
		default n
		select RTK_PPG
	help
		This option enables the hrs.
	
	config HUB_USB
		bool "hub usb"
		default n
	help
		This option enables the usb.
endmenu
```

## applications/watch/src/module/Kconfig
```kconfig
#
# Copyright (c) 2026, Realtek Semiconductor Corporation
#
# SPDX-License-Identifier: LicenseRef-Realtek-5-Clause
#

menu "Realtek Watch Application Module Select"
rsource "*/Kconfig"
endmenu
```

## applications/watch/src/module/airsync/Kconfig
```kconfig
#
# Copyright (c) 2026, Realtek Semiconductor Corporation
#
# SPDX-License-Identifier: LicenseRef-Realtek-5-Clause
#

config AIRSYNC_SERVICE_SUPPORT
	bool "AirSync Service"
	default n
	help
	  Enable AirSync GATT service (supports both BLE and BR/EDR).

config AIRSYNC_SERVICE_NUM
	int "Airsync Service"
	default 1 if AIRSYNC_SERVICE_SUPPORT
	default 0
	help
	  This option configs airsync service.

config AIRSYNC_GATT_OVER_BREDR
	bool "AirSync GATT over BR/EDR support"
	depends on AIRSYNC_SERVICE_SUPPORT && GATT_OVER_BREDR
	default n
	help
	  This option enables AirSync over GATT over BR/EDR transport.
```

## applications/watch/src/module/alipay/Kconfig
```kconfig
#
# Copyright (c) 2026, Realtek Semiconductor Corporation
#
# SPDX-License-Identifier: LicenseRef-Realtek-5-Clause
#

	config ALIPAY
		bool "Alipay support"
		default n
	help
	  This option enables the Alipay.

	config ALIPAY_SERVICES
		int "alipay services"
		default 1 if ALIPAY
		default 0
	help
		This option configs alipay services.

	config ALIPAY_TRANSIT
		bool "Alipay transit module support"
		depends on ALIPAY
		default n
	help
		This option enables the Alipay transit module.
		This function requires CONFIG_REALTEK_SUBSYS_LWIP and CONFIG_REALTEK_SUBSYS_MBEDTLS to be enabled.

	config ALIPAY_TEST
		bool "Alipay shell test commands"
		depends on ALIPAY && SHELL
		default n
	help
		Register `alipay` shell command group for triggering bind / transit code /
		paycode / unbind flows from a UART console without depending on the watch UI.
		Intended for engineering bring-up; should be disabled in release builds.
```

## applications/watch/src/module/audio/Kconfig
```kconfig
#
# Copyright (c) 2026, Realtek Semiconductor Corporation
#
# SPDX-License-Identifier: LicenseRef-Realtek-5-Clause
#

config REALTEK_APP_DSP_ONLINE_DEBUG
	bool "dsp online debug"
	default n
	help
	  This option enables the audio data capture.

config REALTEK_APP_AUDIO_DATA_CAPTURE
	bool "audio data capture"
	default n
	depends on REALTEK_APP_DSP_ONLINE_DEBUG
	help
	  This option enables the audio data capture.
```

## applications/watch/src/module/chatgpt/Kconfig
```kconfig
#
# Copyright (c) 2026, Realtek Semiconductor Corporation
#
# SPDX-License-Identifier: LicenseRef-Realtek-5-Clause
#

menu "chatgpt module config"

	config CHATGPT
		bool "chatgpt support"
		default n
		depends on OPUS
	help
		This option enables the chatgpt.
	
endmenu
```

## applications/watch/src/module/cywee/Kconfig
```kconfig
# Copyright(c) 2024, Realtek Semiconductor Corporation.

menu "cywee motion algorithm"

	config CYWEE_MOTION_ALGORITHM
		bool "cywee motion algorithm support"
		default n
		help
		  This option enables the cywee motion algorithm.
		  
endmenu
```

## applications/watch/src/module/dfu/Kconfig
```kconfig
#
# Copyright (c) 2026, Realtek Semiconductor Corporation
#
# SPDX-License-Identifier: LicenseRef-Realtek-5-Clause
#

menu "DFU module config"
	config DFU
		bool "dfu support"
		default y
	help
		This option enables the dfu.
	
	config DFU_NORMAL_OTA
		bool "normal ota support"
		depends on DFU
		default y
	help
		This option enables the normal ota.
	
	config DFU_COMPRESS_OTA
		bool "compress ota support"
		depends on DFU
		default n
	help
		This option enables the compress ota.
	
endmenu
```

## applications/watch/src/module/eq/Kconfig
```kconfig
#
# Copyright (c) 2026, Realtek Semiconductor Corporation
#
# SPDX-License-Identifier: LicenseRef-Realtek-5-Clause
#

config EQ
	bool "support EQ"
	help
	  This option enables the EQ.
```

## applications/watch/src/module/findmy/Kconfig
```kconfig
#
# Copyright (c) 2026, Realtek Semiconductor Corporation
#
# SPDX-License-Identifier: LicenseRef-Realtek-5-Clause
#

menu "Findmy module config"
	config FINDMY
		bool "findmy support"
		depends on REALTEK_SUBSYS_MBEDTLS
		depends on REALTEK_SUBSYS_GATT_PROFILE_TPS_SERVER
		default n
	help
		This option enables the findmy.

	config FINDMY_MAX_LINKS
		int "findmy max links"
		default 1 if FINDMY
		default 0
	help
		This option configs findmy links.

	config FINDMY_SERVICES
		int "findmy max services"
		default 3 if FINDMY
		default 0
	help
		This option configs findmy services.

	config FINDMY_USE_UARP
		bool "findmy uarp support"
		depends on FINDMY
		default n
	help
		This option enables the findmy uarp.
	
	config FINDMY_USE_NFC
		bool "findmy nfc support"
		depends on FINDMY
		default n
	help
		This option enables the findmy nfc.
	
endmenu
```

## applications/watch/src/module/gfps/Kconfig
```kconfig
#
# Copyright (c) 2026, Realtek Semiconductor Corporation
#
# SPDX-License-Identifier: LicenseRef-Realtek-5-Clause
#

menu "gfps module config"

	config REALTEK_GFPS_FEATURE_SUPPORT
		bool "gfps support"
		default n
		select REALTEK_SUBSYS_GFPS
	help
		This option enables the gpfs.
	
	config REALTEK_GFPS_FINDER_SUPPORT
		bool "gfps finder support"
		default y if REALTEK_GFPS_FEATURE_SUPPORT
		default n
	help
		This option configs gfps finder function.

	config REALTEK_GFPS_LE_DEVICE_SUPPORT
		bool "gfps le device support"
		default y if REALTEK_GFPS_FEATURE_SUPPORT
		default n
	help
		This option enables gfps le device.

	config REALTEK_GFPS_SERVICES
		int "gfps services"
		default 2 if REALTEK_GFPS_FEATURE_SUPPORT
		default 0
	help
		This option configs gfps services.
	
	config REALTEK_GFPS_MAX_LINKS
		int "gfps services"
		default 2 if REALTEK_GFPS_FEATURE_SUPPORT
		default 0
	help
		This option configs gfps links.
	
endmenu
```

## applications/watch/src/module/local_playback/Kconfig
```kconfig
#
# Copyright (c) 2026, Realtek Semiconductor Corporation
#
# SPDX-License-Identifier: LicenseRef-Realtek-5-Clause
#

config LOCAL_PLAYBACK
	bool "local playback support"
	help
	  This option enables the local playback.

config PLAYBACK_GATT_OVER_BREDR
	bool "local playback GATT over BR/EDR support"
	depends on LOCAL_PLAYBACK && GATT_OVER_BREDR
	help
	  This option enables GATT over BR/EDR transport for local playback.
	  When enabled, playback service will use BR/EDR instead of LE for data transfer.
```

## applications/watch/src/module/opus/Kconfig
```kconfig
#
# Copyright (c) 2026, Realtek Semiconductor Corporation
#
# SPDX-License-Identifier: LicenseRef-Realtek-5-Clause
#

config OPUS
	bool "opus support"
	help
	  This option enables the opus.
```

## applications/watch/src/module/rtk_ppg/Kconfig
```kconfig
#
# Copyright (c) 2026, Realtek Semiconductor Corporation
#
# SPDX-License-Identifier: LicenseRef-Realtek-5-Clause
#

menu "rtk ppg module config"
	
	config RTK_PPG
		bool "rtk ppg support"
		depends on HUB_HRS
		default n
	help
		This option enables the rtk ppg.
	
	config RTK_PPG_SERVICES
		int "rtk ppg max services"
		default 1 if RTK_PPG
		default 0
	help
		This option configs ppg services.
	
endmenu
```

## applications/watch/src/module/walkie_talkie/Kconfig
```kconfig
#
# Copyright (c) 2026, Realtek Semiconductor Corporation
#
# SPDX-License-Identifier: LicenseRef-Realtek-5-Clause
#

menu "walkie talkie module config"

	config WALKIE_TALKIE
		bool "walkie talkie support"
		default n
	help
		This option enables the walkie talkie.
	
	config WALKIE_TALKIE_SERVICES
		int "walkie talkie services"
		default 1 if WALKIE_TALKIE
		default 0
	help
		This option configs walkie talkie services.

	config WALKIE_TALKIE_BLE_LINKS
		int "walkie talkie ble links"
		default 2 if WALKIE_TALKIE
		default 0
	help
		This option configs walkie talkie ble links.
	
endmenu
```
