/*
 * Copyright(c) 2026, Realtek Semiconductor Corporation.
 *
 * SPDX-License-Identifier: Apache-2.0
 */

#include <rtl87x3g-display-lcd.dtsi>

&display_lcd {
    status = "okay";
};

/ {
    chosen {
        zephyr,display = &display_lcd;
    };
};
