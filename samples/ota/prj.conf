## CMakeLists.txt
```
#
# Copyright (c) 2026, Realtek Semiconductor Corporation
#
# SPDX-License-Identifier: LicenseRef-Realtek-5-Clause
#

message(STATUS "CMAKELIST FOLDER: ${CMAKE_CURRENT_SOURCE_DIR}")

cmake_minimum_required(VERSION 3.20.0)

#===========version generation===========
include(${CMAKE_CURRENT_SOURCE_DIR}/../../cmake/version_generate.cmake)
generate_version()
#===========version generation===========
#===========post build===========
# post build should be called before find_package
include(${CMAKE_CURRENT_SOURCE_DIR}/../../cmake/post_build.cmake)
rtk_post_build()
#===========post build===========

find_package(Zephyr REQUIRED HINTS $ENV{ZEPHYR_BASE})
project(ota_demo)

FILE(GLOB app_sources src/*.c)
target_sources(app PRIVATE
  ${app_sources}
  )

set(sources 
   ${ZEPHYR_REALTEK_APP_MODULE_DIR}/applications/bt_audio_trx/src/common/app_ble_service/ota_service.c
   )

if(CONFIG_REALTEK_COMMON_SDK_4M)
set (flash_map_source_dir ${ZEPHYR_REALTEK_APP_MODULE_DIR}/applications/bt_audio_trx/src/flashmap/4M)
else()
set (flash_map_source_dir ${ZEPHYR_REALTEK_APP_MODULE_DIR}/applications/bt_audio_trx/src/flashmap/16M)
endif()
message(STATUS "flash map dir: ${flash_map_source_dir}")

set(headers 
    #header files from app
	src/
	${ZEPHYR_REALTEK_APP_MODULE_DIR}/applications/bt_audio_trx/src/common/app_ble_service
	${ZEPHYR_REALTEK_APP_MODULE_DIR}/common/stream/
	${ZEPHYR_REALTEK_MODULE_DIR}/rtl87x3g/subsys/bluetooth/bt_host/inc
	${flash_map_source_dir}
	# ${ZEPHYR_REALTEK_MODULE_DIR}/rtl87x3g/platform/hal_lib/inc/io
    #header files from libs

    )

foreach(header ${headers})
    if(EXISTS ${header})
        zephyr_include_directories(${header})
    else()
        message(FATAL_ERROR "header file directory does not exist: ${header}. Current cmakelist: ${CMAKE_CURRENT_SOURCE_DIR}")
    endif()
endforeach()

foreach(src ${sources})
    if(EXISTS ${src})
        target_sources(app PRIVATE ${src})
    else()
        message(FATAL_ERROR "source file does not exist: ${src}. Current cmakelist: ${CMAKE_CURRENT_SOURCE_DIR}")
    endif()
endforeach()

target_precompile_headers(app PUBLIC 
	          ${CMAKE_CURRENT_SOURCE_DIR}/src/app_flags.h
			  )
    
target_include_directories(app PRIVATE src)
```

## Kconfig
```
#
# Copyright (c) 2026, Realtek Semiconductor Corporation
#
# SPDX-License-Identifier: LicenseRef-Realtek-5-Clause
#

# Copyright(c) 2024, Realtek Semiconductor Corporation.

# This loads bt_audio_trx source code config
menu "Realtek bt_audio_trx Application"
rsource "src/Kconfig"

config SOC_SERIES_RTL87X3G
            bool "Select RTL87X3G IC Type"
            default y
            help
                Select RTL87X3G IC Type.

config REALTEK_FILESYSTEM_EXFAT_SUPPORT
            bool "Realtek Filesystem exfat support"
            default y
            help
                Realtek Filesystem exfat support.

choice
        prompt "bank select"
        default REALTEK_COMMON_SDK_BANK0
config REALTEK_COMMON_SDK_BANK0
        bool "build bank0 image"
config REALTEK_COMMON_SDK_BANK1
        bool "build bank1 image"
endchoice

choice
        prompt "flash size select"
        default REALTEK_COMMON_SDK_16M
config REALTEK_COMMON_SDK_4M
        bool "use 4M flash map"
config REALTEK_COMMON_SDK_16M
        bool "use 16M flash map"
endchoice
endmenu

config REALTEK_APP_GUI
		bool "Enable APP GUI Code"
		default n
		help
			Enable APP GUI Code.
			
config REALTEK_KEY_BUTTON_8773G_ZEPHYR_CS
		bool "Enable KEY Button Driver"
		default n
		help
			Enable KEY Button Driver.

menu "Zephyr Kernel"
source "Kconfig.zephyr"
endmenu
```

## prj.conf
```kconfig
CONFIG_REALTEK_SUBSYS_AUDIO=y
CONFIG_REALTEK_SUBSYS_UPPERSTACK=y
CONFIG_REALTEK_SUBSYS_BLE_MGR=y
CONFIG_REALTEK_SUBSYS_SYSM=y
CONFIG_REALTEK_SUBSYS_REMOTE=y
CONFIG_REALTEK_SUBSYS_BTM=y
CONFIG_REALTEK_COMMON_SDK_4M=y
```

## src/app_ble_common_adv.c
```c
/*
 * Copyright (c) 2026, Realtek Semiconductor Corporation
 *
 * SPDX-License-Identifier: LicenseRef-Realtek-5-Clause
 */

#include <string.h>
#include "os_mem.h"
#include "os_queue.h"
#include "trace.h"
#include "gap_le_types.h"
#include "app_ble_common_adv.h"
#include "ble_ext_adv.h"
#include "app_main.h"
#include "app_ble_gap.h"


typedef struct CB_ELEM CB_ELEM;

typedef struct CB_ELEM
{
    CB_ELEM             *p_next;
    LE_COMMON_ADV_CB    cb;
} CB_ELEM;

struct
{
    bool use_static_addr_type;
    uint8_t adv_handle;
    uint8_t conn_id;
    T_BLE_EXT_ADV_MGR_STATE state;
    T_OS_QUEUE cb_queue;
} le_common_adv =
{
    .use_static_addr_type = true,
    .adv_handle = 0xff,
    .conn_id = 0xff,
    .state = BLE_EXT_ADV_MGR_ADV_DISABLED,
    .cb_queue = {0}
};

static uint8_t app_ble_common_adv_data[31] =
{
    /* This modification is used to solve issue: BLE name shown on Android list */
    /* TX Power Level */
    0x02,/* length */
    GAP_ADTYPE_POWER_LEVEL,
    0x00, /* Don't care now */

    /* Service */
    17,/* length */
    GAP_ADTYPE_128BIT_COMPLETE,/* "Complete 128-bit UUIDs available"*/
    /*transmit service uuid*/
    0x12, 0xA2, 0x4D, 0x2E, 0xFE, 0x14, 0x48, 0x8e, 0x93, 0xD2, 0x17, 0x3C, 0xFD, 0x02, 0x00,
    0x00,/*bud role:0x00 single,0x01 pri, 0x02 sec*/

    /* Manufacturer Specific Data */
    9,/* length */
    0xFF,
    0x5D, 0x00, /* Company ID */

};


static void app_ble_common_adv_callback(uint8_t cb_type, void *p_cb_data)
{
    T_BLE_EXT_ADV_CB_DATA cb_data;
    memcpy(&cb_data, p_cb_data, sizeof(T_BLE_EXT_ADV_CB_DATA));
    switch (cb_type)
    {
    case BLE_EXT_ADV_STATE_CHANGE:
        {
            APP_PRINT_TRACE2("app_ble_common_adv_callback: adv_state %d, adv_handle %d",
                             cb_data.p_ble_state_change->state, cb_data.p_ble_state_change->adv_handle);
            le_common_adv.state = cb_data.p_ble_state_change->state;
        }
        break;

    case BLE_EXT_ADV_SET_CONN_INFO:
        APP_PRINT_TRACE1("app_ble_common_adv_callback: BLE_EXT_ADV_SET_CONN_INFO conn_id 0x%x",
                         cb_data.p_ble_conn_info->conn_id);

        le_common_adv.conn_id = cb_data.p_ble_conn_info->conn_id;
        break;

    default:
        break;
    }

    CB_ELEM *p_cb_elem = (CB_ELEM *)le_common_adv.cb_queue.p_first;
    APP_PRINT_TRACE1("app_ble_common_adv_callback: p_cb_elem %p", p_cb_elem);

    for (; p_cb_elem != NULL; p_cb_elem = p_cb_elem->p_next)
    {
        APP_PRINT_TRACE1("app_ble_common_adv_callback: cb %p", p_cb_elem->cb);
        p_cb_elem->cb(cb_type, cb_data);
    }

    return;
}

bool app_ble_common_adv_start(uint16_t duration_10ms)
{
    if (le_common_adv.state == BLE_EXT_ADV_MGR_ADV_DISABLED)
    {
        if (ble_ext_adv_mgr_enable(le_common_adv.adv_handle, duration_10ms) == GAP_CAUSE_SUCCESS)
        {
            return true;
        }
        else
        {
            return false;
        }
    }
    else
    {
        APP_PRINT_TRACE0("app_ble_common_adv_start: Already started");
        return true;
    }
}

bool app_ble_common_adv_stop(int8_t app_cause)
{
    APP_PRINT_INFO0("app_ble_common_adv_stop");
    if (ble_ext_adv_mgr_disable(le_common_adv.adv_handle, app_cause) == GAP_CAUSE_SUCCESS)
    {
        return true;
    }
    else
    {
        return false;
    }
}

uint8_t app_ble_common_adv_get_conn_id(void)
{
    return le_common_adv.conn_id;
}

void app_ble_common_adv_reset_conn_id(void)
{
    le_common_adv.conn_id = 0xff;
}

void app_ble_common_adv_init(void)
{
    T_LE_EXT_ADV_LEGACY_ADV_PROPERTY adv_event_prop = LE_EXT_ADV_LEGACY_ADV_CONN_SCAN_UNDIRECTED;
    uint16_t adv_interval_min = 0xA0;
    uint16_t adv_interval_max = 0xB0;
    T_GAP_LOCAL_ADDR_TYPE own_address_type = GAP_LOCAL_ADDR_LE_RANDOM;//GAP_LOCAL_ADDR_LE_PUBLIC

    T_GAP_REMOTE_ADDR_TYPE peer_address_type = GAP_REMOTE_ADDR_LE_PUBLIC;
    uint8_t  peer_address[6] = {0, 0, 0, 0, 0, 0};
    T_GAP_ADV_FILTER_POLICY filter_policy = GAP_ADV_FILTER_ANY;

    uint8_t data_len = 8;

    for (int i = 0; i < 6; i++)
    {
        app_ble_common_adv_data[25 + i] =  app_db.factory_addr[5 - i];
    }

    app_ble_gap_gen_scan_rsp_data(&scan_rsp_data_len, scan_rsp_data);

    uint8_t le_random_addr[6] = {1, 2, 3, 4, 5, 6};

    ble_ext_adv_mgr_init_adv_params(&le_common_adv.adv_handle, adv_event_prop, adv_interval_min,
                                    adv_interval_max, own_address_type, peer_address_type, peer_address,
                                    filter_policy, 23 + data_len, app_ble_common_adv_data,
                                    scan_rsp_data_len, scan_rsp_data, le_random_addr);

    APP_PRINT_TRACE2("app_ble_common_adv_init: app_ble_common_adv_data %b, le_random_addr %s",
                     TRACE_BINARY(sizeof(app_ble_common_adv_data), app_ble_common_adv_data),
                     TRACE_BDADDR(le_random_addr));

    ble_ext_adv_mgr_register_callback(app_ble_common_adv_callback, le_common_adv.adv_handle);

    os_queue_init(&le_common_adv.cb_queue);
}
```

## src/app_ble_common_adv.h
```c
/*
 * Copyright (c) 2026, Realtek Semiconductor Corporation
 *
 * SPDX-License-Identifier: LicenseRef-Realtek-5-Clause
 */

#ifndef _APP_BLE_COMMON_ADV_H_
#define _APP_BLE_COMMON_ADV_H_

#include <stdint.h>
#include <stdbool.h>
#include "ble_ext_adv.h"
#include "remote.h"

#ifdef __cplusplus
extern "C" {
#endif /* __cplusplus */


/** @defgroup APP_BLE_COMMON_ADV App BLE Common Adv
  * @brief App BLE Common Adv
  * @{
  */


typedef void (*LE_COMMON_ADV_CB)(uint8_t cb_type, T_BLE_EXT_ADV_CB_DATA cb_data);


/*============================================================================*
 *                              Macros
 *============================================================================*/


/*============================================================================*
 *                              Functions
 *============================================================================*/

/**
    * @brief  get ble common advertising conn id
    * @param  void
    * @return ble advertising conn id
    */
uint8_t app_ble_common_adv_get_conn_id(void);

/**
    * @brief  reset ble common advertising conn id
    * @param  void
    * @return void
    */
void app_ble_common_adv_reset_conn_id(void);

/**
    * @brief  start ble common advertising
    * @param  duration_ms advertising duration time
    * @return true  Command has been sent successfully.
    * @return false Command was fail to send.
    */
bool app_ble_common_adv_start(uint16_t duration_10ms);

/**
    * @brief  stop ble common advertising
    * @param  app_cause cause
    * @return true  Command has been sent successfully.
    * @return false Command was fail to send.
    */
bool app_ble_common_adv_stop(int8_t app_cause);

/**
    * @brief  init ble common advertising parameters
    * @param  void
    * @return void
    */
void app_ble_common_adv_init(void);


/** @} */ /* End of group APP_BLE_COMMON_ADV_Exported_Functions */

/** End of APP_BLE_COMMON_ADV
* @}
*/

#ifdef __cplusplus
}
#endif /* __cplusplus */

#endif /* _APP_BLE_COMMON_ADV_H_ */
```

## src/app_ble_gap.c
```c
/*
 * Copyright (c) 2026, Realtek Semiconductor Corporation
 *
 * SPDX-License-Identifier: LicenseRef-Realtek-5-Clause
 */
#include <string.h>
#include "os_mem.h"
#include "trace.h"
#include "sysm.h"
#include "gap_conn_le.h"
#include "gap_bond_le.h"
#include "gap_ext_scan.h"
#include "dfu_api.h"
#include "ota_service.h"
#include "app_ble_gap.h"
#include "app_main.h"
#include "app_ble_common_adv.h"
#include "ble_stream.h"
#include "ble_scan.h"
#include "ble_mgr.h"
#include "ble_conn.h"

uint8_t scan_rsp_data_len;
uint8_t scan_rsp_data[GAP_MAX_LEGACY_ADV_LEN];

bool app_ble_gap_gen_scan_rsp_data(uint8_t *p_scan_len, uint8_t *p_scan_data)
{
    uint8_t device_name_len;

    if (p_scan_len == NULL || p_scan_data == NULL)
    {
        return false;
    }

    uint8_t ble_device_name[40] = "BLE ota demo";
    device_name_len = strlen((const char *)ble_device_name);

    if (device_name_len > GAP_MAX_LEGACY_ADV_LEN - 2)
    {
        device_name_len = GAP_MAX_LEGACY_ADV_LEN - 2;
    }

    p_scan_data[0] = device_name_len + 1;
    p_scan_data[1] = GAP_ADTYPE_LOCAL_NAME_COMPLETE;

    memcpy(&p_scan_data[2], ble_device_name, device_name_len);

    *p_scan_len = device_name_len + 2;
    return true;
}

static T_APP_RESULT app_ble_gap_cb(uint8_t cb_type, void *p_cb_data)
{
    T_APP_RESULT result = APP_RESULT_SUCCESS;
    T_LE_CB_DATA cb_data;

    memcpy(&cb_data, p_cb_data, sizeof(T_LE_CB_DATA));

    ble_mgr_handle_gap_cb(cb_type, p_cb_data);

    APP_PRINT_TRACE1("app_ble_gap_cb %d", cb_type);

    switch (cb_type)
    {
    case GAP_MSG_LE_EXT_ADV_STATE_CHANGE_INFO:
        {
            APP_PRINT_TRACE0("GAP_MSG_LE_EXT_ADV_STATE_CHANGE_INFO");
        }
        break;
    case GAP_MSG_LE_EXT_ADV_REPORT_INFO:
        APP_PRINT_INFO6("GAP_MSG_LE_EXT_ADV_REPORT_INFO:event_type 0x%x, bd_addr %s, addr_type %d, rssi %d, data_len %d,data %b",
                        cb_data.p_le_ext_adv_report_info->event_type,
                        TRACE_BDADDR(cb_data.p_le_ext_adv_report_info->bd_addr),
                        cb_data.p_le_ext_adv_report_info->addr_type,
                        cb_data.p_le_ext_adv_report_info->rssi,
                        cb_data.p_le_ext_adv_report_info->data_len,
                        TRACE_BINARY(cb_data.p_le_ext_adv_report_info->data_len, cb_data.p_le_ext_adv_report_info->p_data));
        break;

    case GAP_MSG_LE_CONN_UPDATE_IND:
        {
            APP_PRINT_TRACE0("GAP_MSG_LE_CONN_UPDATE_IND");
            result = APP_RESULT_ACCEPT;
        }
        break;

    case GAP_MSG_LE_EXT_ADV_START_SETTING:
        {
            APP_PRINT_TRACE0("GAP_MSG_LE_EXT_ADV_START_SETTING");
        }
        break;

    case GAP_MSG_LE_MODIFY_WHITE_LIST:
        {
            APP_PRINT_INFO2("GAP_MSG_LE_MODIFY_WHITE_LIST: operation = 0x%x cause=0x%x",
                            cb_data.p_le_modify_white_list_rsp->operation,
                            cb_data.p_le_modify_white_list_rsp->cause);
        }
        break;
    default:
        break;
    }

    return result;
}

bool app_ble_gap_disconnect(T_APP_LE_LINK *p_link, T_LE_LOCAL_DISC_CAUSE disc_cause)
{
    if (p_link != NULL)
    {
        APP_PRINT_TRACE2("app_ble_gap_disconnect: conn_id %d, disc_cause %d",
                         p_link->conn_id, disc_cause);
        if (le_disconnect(p_link->conn_id) == GAP_CAUSE_SUCCESS)
        {
            p_link->local_disc_cause = disc_cause;
            return true;
        }
    }
    return false;
}

void app_ble_gap_handle_mtu_info(uint8_t conn_id, uint16_t mtu)
{
    T_APP_LE_LINK *p_link;
    p_link = app_link_find_le_link_by_conn_id(conn_id);
    if (p_link != NULL)
    {
        p_link->mtu_size = mtu;
    }
}

static void app_ble_gap_handle_new_conn_state_evt(uint8_t conn_id, T_GAP_CONN_STATE new_state,
                                                  uint16_t disc_cause)
{
    T_APP_LE_LINK *p_link;

    APP_PRINT_TRACE3("app_ble_gap_handle_new_conn_state_evt: conn_id %d, new_state %d, cause 0x%04x",
                     conn_id, new_state, disc_cause);

    p_link = app_link_find_le_link_by_conn_id(conn_id);

    switch (new_state)
    {
    case GAP_CONN_STATE_DISCONNECTING:
        if (p_link != NULL)
        {
            p_link->state = LE_LINK_STATE_DISCONNECTING;
        }
        break;

    case GAP_CONN_STATE_DISCONNECTED:
        if (p_link != NULL)
        {
            // uint8_t local_disc_cause = p_link->local_disc_cause;
            for (uint8_t i = 0; i < p_link->disc_cb_list.count; i++)
            {
                T_LE_DISC_CB_ENTRY *p_entry;
                p_entry = os_queue_peek(&p_link->disc_cb_list, i);
                if (p_entry != NULL && p_entry->disc_callback != NULL)
                {
                    p_entry->disc_callback(conn_id, p_link->local_disc_cause, disc_cause);
                }
            }

            //app_transfer_queue_reset(CMD_PATH_LE);
            if (conn_id == app_ble_common_adv_get_conn_id())
            {
                app_ble_common_adv_reset_conn_id();
            }

            app_link_free_le_link(p_link);
            //if (local_disc_cause != LE_LOCAL_DISC_CAUSE_POWER_OFF &&
            //      local_disc_cause != LE_LOCAL_DISC_CAUSE_ROLESWAP)
            //{
            //      app_ble_device_handle_power_on_rtk_adv();
            //}
        }
        break;

    case GAP_CONN_STATE_CONNECTING:
        if (p_link == NULL)
        {
            p_link = app_link_alloc_le_link_by_conn_id(conn_id);
            if (p_link != NULL)
            {
                p_link->state = LE_LINK_STATE_CONNECTING;
            }
        }
        break;

    case GAP_CONN_STATE_CONNECTED:
        if (p_link != NULL)
        {
            p_link->conn_handle = le_get_conn_handle(conn_id);


            if (p_link->state == LE_LINK_STATE_CONNECTING)
            {
                //app_auto_power_off_disable(AUTO_POWER_OFF_MASK_BLE_LINK_EXIST);
                p_link->state = LE_LINK_STATE_CONNECTED;
                le_get_conn_param(GAP_PARAM_CONN_MTU_SIZE, &p_link->mtu_size, conn_id);
            }


            if (conn_id == app_ble_common_adv_get_conn_id())
            {
                uint16_t conn_interval_min = RWS_LE_DEFAULT_MIN_CONN_INTERVAL;
                uint16_t conn_interval_max = RWS_LE_DEFAULT_MAX_CONN_INTERVAL;
                uint16_t conn_latency = RWS_LE_DEFAULT_SLAVE_LATENCY;
                uint16_t conn_supervision_timeout = RWS_LE_DEFAULT_SUPERVISION_TIMEOUT;

                ble_set_prefer_conn_param(conn_id, conn_interval_min, conn_interval_max, conn_latency,
                                          conn_supervision_timeout);
            }
        }
        break;

    default:
        break;
    }
}

void app_ble_gap_handle_gap_msg(T_IO_MSG *p_io_msg)
{
    T_LE_GAP_MSG stack_msg;
    memcpy(&stack_msg, &p_io_msg->u.param, sizeof(p_io_msg->u.param));
    APP_PRINT_TRACE1("app_ble_gap_handle_gap_msg: subtype %d", p_io_msg->subtype);

    ble_mgr_handle_gap_msg(p_io_msg->subtype, &stack_msg);

    switch (p_io_msg->subtype)
    {
    case GAP_MSG_LE_CONN_STATE_CHANGE:
        {
            app_ble_gap_handle_new_conn_state_evt(stack_msg.msg_data.gap_conn_state_change.conn_id,
                                                  (T_GAP_CONN_STATE)stack_msg.msg_data.gap_conn_state_change.new_state,
                                                  stack_msg.msg_data.gap_conn_state_change.disc_cause);
        }
        break;

    case GAP_MSG_LE_CONN_MTU_INFO:
        {
            app_ble_gap_handle_mtu_info(stack_msg.msg_data.gap_conn_mtu_info.conn_id,
                                        stack_msg.msg_data.gap_conn_mtu_info.mtu_size);
        }
        break;

    default:
        break;
    }
}

static void app_ble_gap_bt_cback(T_BT_EVENT event_type, void *event_buf, uint16_t buf_len)
{
    T_BT_EVENT_PARAM *param = event_buf;

    switch (event_type)
    {
    case BT_EVENT_READY:
        {
            APP_PRINT_INFO0("BT_EVENT_READY2");
            memcpy(app_db.factory_addr, param->ready.bd_addr, 6);
            /* init here to avoid app_cfg_nv.bud_local_addr no mac info (due to factory reset) */
            app_ble_common_adv_init();
            app_ble_common_adv_start(0);//START ADV
        }
        break;

    default:
        break;
    }
}

void app_ble_gap_ble_mgr_init(void)
{
    BLE_MGR_PARAMS param = {0};

    param.ble_ext_adv.enable = true;
    param.ble_ext_adv.adv_num = 1;//todo future
    param.ble_conn.enable = true;
    uint8_t supported_max_le_link_num = le_get_max_link_num();
    param.ble_conn.link_num = ((MAX_BLE_LINK_NUM <= supported_max_le_link_num) ? MAX_BLE_LINK_NUM :
                               supported_max_le_link_num);

    param.ble_scan.enable = true;

    ble_mgr_init(&param);
}

void app_ble_gap_init(void)
{
    APP_PRINT_INFO0("app_ble_gap_init");
    bt_mgr_cback_register(app_ble_gap_bt_cback);
    le_register_app_cb(app_ble_gap_cb);
    app_ble_gap_ble_mgr_init();
}

void app_ble_gap_param_init(void)
{
    /*set device name and device appearance*/
    uint16_t appearance = GAP_GATT_APPEARANCE_UNKNOWN;

    le_set_gap_param(GAP_PARAM_APPEARANCE, sizeof(appearance), &appearance);
    le_set_gap_param(GAP_PARAM_DEVICE_NAME, GAP_DEVICE_NAME_LEN, "BLE ota demo");

    /*set GAP Bond Manager parameters*/
    uint32_t passkey             = 0;
    uint8_t use_fixed_passkey    = false;
    uint8_t sec_req_enable       = false;
    uint16_t sec_req_requirement = GAP_AUTHEN_BIT_SC_FLAG;

    le_bond_set_param(GAP_PARAM_BOND_FIXED_PASSKEY, sizeof(uint32_t), &passkey);
    le_bond_set_param(GAP_PARAM_BOND_FIXED_PASSKEY_ENABLE, sizeof(uint8_t), &use_fixed_passkey);
    le_bond_set_param(GAP_PARAM_BOND_SEC_REQ_ENABLE, sizeof(uint8_t), &sec_req_enable);
    le_bond_set_param(GAP_PARAM_BOND_SEC_REQ_REQUIREMENT, sizeof(uint16_t), &sec_req_requirement);

    /*Initialize ble link*/
    uint8_t supported_max_le_link_num = le_get_max_link_num();
    uint8_t link_num = ((MAX_BLE_LINK_NUM <= supported_max_le_link_num) ? MAX_BLE_LINK_NUM :
                        supported_max_le_link_num);
    le_gap_init(link_num);

    /* Initialize scan parameters */
    T_GAP_SCAN_MODE  scan_mode              = GAP_SCAN_MODE_PASSIVE;
    uint8_t scan_filter_policy              = GAP_SCAN_FILTER_ANY;
    uint8_t scan_filter_duplicate           = GAP_SCAN_FILTER_DUPLICATE_ENABLE;
    T_GAP_LOCAL_ADDR_TYPE  own_address_type = GAP_LOCAL_ADDR_LE_PUBLIC;

    T_GAP_LE_EXT_SCAN_PARAM extended_scan_param[GAP_EXT_SCAN_MAX_PHYS_NUM];
    extended_scan_param[0].scan_type     = scan_mode;
    extended_scan_param[0].scan_interval = 0x10;
    extended_scan_param[0].scan_window   = 0x10;

    uint8_t  scan_phys         = GAP_EXT_SCAN_PHYS_1M_BIT;
    uint16_t ext_scan_duration = 0;
    uint16_t ext_scan_period   = 0;

    le_ext_scan_set_param(GAP_PARAM_EXT_SCAN_LOCAL_ADDR_TYPE, sizeof(own_address_type),
                          &own_address_type);
    le_ext_scan_set_param(GAP_PARAM_EXT_SCAN_PHYS, sizeof(scan_phys),
                          &scan_phys);
    le_ext_scan_set_param(GAP_PARAM_EXT_SCAN_DURATION, sizeof(ext_scan_duration),
                          &ext_scan_duration);
    le_ext_scan_set_param(GAP_PARAM_EXT_SCAN_PERIOD, sizeof(ext_scan_period),
                          &ext_scan_period);
    le_ext_scan_set_param(GAP_PARAM_EXT_SCAN_FILTER_POLICY, sizeof(scan_filter_policy),
                          &scan_filter_policy);
    le_ext_scan_set_param(GAP_PARAM_EXT_SCAN_FILTER_DUPLICATES, sizeof(scan_filter_duplicate),
                          &scan_filter_duplicate);
    le_ext_scan_set_phy_param(LE_SCAN_PHY_LE_1M, &extended_scan_param[0]);
}
```

## src/app_ble_gap.h
```c
/*
 * Copyright (c) 2026, Realtek Semiconductor Corporation
 *
 * SPDX-License-Identifier: LicenseRef-Realtek-5-Clause
 */

#ifndef _APP_BLE_GAP_H_
#define _APP_BLE_GAP_H_

#include <stdint.h>
#include <stdbool.h>

#include "app_msg.h"
#include "gap.h"
#include "ble_ext_adv.h"
#include "app_link_util.h"
#include "app_adv_stop_cause.h"

#ifdef __cplusplus
extern "C" {
#endif /* __cplusplus */


/** @defgroup APP_BLE_GAP App Ble Gap
  * @brief App Ble Gap
  * @{
  */
#define RWS_LE_DEFAULT_MIN_CONN_INTERVAL   (12)//12*1.25 = 15ms
#define RWS_LE_DEFAULT_MAX_CONN_INTERVAL   (24)//24*1.25 = 30ms
#define RWS_LE_DEFAULT_SLAVE_LATENCY       (0)
#define RWS_LE_DEFAULT_SUPERVISION_TIMEOUT (500)//500*10 = 5000ms
/**  @brief  App define le link connection state status */
typedef enum
{
    LE_LINK_STATE_DISCONNECTED,
    LE_LINK_STATE_CONNECTING,
    LE_LINK_STATE_CONNECTED,
    LE_LINK_STATE_DISCONNECTING,
} T_LE_LINK_STATE;

/**  @brief  App define le link encryption state */
typedef enum
{
    LE_LINK_UNENCRYPTIONED = 0,
    LE_LINK_ENCRYPTIONED = 1,
    LE_LINK_ERROR = 2,
} T_LE_LINK_ENCRYPTION_STATE;

typedef enum
{
    LE_LOCAL_DISC_CAUSE_UNKNOWN = 0x00,
    LE_LOCAL_DISC_CAUSE_POWER_OFF = 0x01,
    LE_LOCAL_DISC_CAUSE_SWITCH_TO_OTA = 0x02,
    LE_LOCAL_DISC_CAUSE_AUTHEN_FAILED = 0x03,
    LE_LOCAL_DISC_CAUSE_TTS_DISC = 0x04,
    LE_LOCAL_DISC_CAUSE_OTA_RESET = 0x05,
    LE_LOCAL_DISC_CAUSE_GFPS_STOP = 0x06,
    LE_LOCAL_DISC_CAUSE_GFPS_FAILED = 0x07,
    LE_LOCAL_DISC_CAUSE_ROLESWAP = 0x08,
    LE_LOCAL_DISC_CAUSE_SECONDARY = 0x09,
    LE_LOCAL_DISC_CAUSE_TUYA = 0x0A,
    LE_LOCAL_DISC_CAUSE_ENGAGE_STREAM_PRIOIRTY = 0x0B,
} T_LE_LOCAL_DISC_CAUSE;

extern uint8_t scan_rsp_data_len;
extern uint8_t scan_rsp_data[GAP_MAX_LEGACY_ADV_LEN];

void app_ble_gap_param_init(void);
void app_ble_gap_init(void);
bool app_ble_gap_gen_scan_rsp_data(uint8_t *p_scan_len, uint8_t *p_scan_data);
bool app_ble_gap_disconnect(T_APP_LE_LINK *p_link, T_LE_LOCAL_DISC_CAUSE disc_cause);

/**
    * @brief  All the bt gap msg events are pre-handled in this function.
    *         Then the event handling function shall be called according to the subType of BEE_IO_MSG.
    * @param  p_bee_io_msg  pointer to bee io msg
    * @return void
    */
void app_ble_gap_handle_gap_msg(T_IO_MSG *p_bee_io_msg);

/** End of APP_BLE_GAP
* @}
*/

#ifdef __cplusplus
}
#endif /* __cplusplus */

#endif /* _APP_BLE_GAP_H_ */
```

## src/app_ble_service.c
```c
/*
 * Copyright (c) 2026, Realtek Semiconductor Corporation
 *
 * SPDX-License-Identifier: LicenseRef-Realtek-5-Clause
 */

#include "trace.h"
#include "os_mem.h"
#include "dfu_api.h"
#include "ota_service.h"
#include "app_ble_service.h"
#include "app_main.h"
#include "app_ble_gap.h"
#include "bt_gatt_svc.h"

static T_APP_RESULT app_ble_service_ota_srv_cb(T_SERVER_ID service_id, void *p_data)
{
    T_APP_RESULT app_result = APP_RESULT_SUCCESS;

    T_OTA_CALLBACK_DATA *p_ota_cb_data = (T_OTA_CALLBACK_DATA *)p_data;
    APP_PRINT_INFO2("app_ble_service_ota_srv_cb: service_id %d, msg_type %d",
                    service_id, p_ota_cb_data->msg_type);
    switch (p_ota_cb_data->msg_type)
    {
    case SERVICE_CALLBACK_TYPE_READ_CHAR_VALUE:
        break;
    case SERVICE_CALLBACK_TYPE_WRITE_CHAR_VALUE:
        if (OTA_WRITE_CHAR_VAL == p_ota_cb_data->msg_data.write.opcode &&
            OTA_VALUE_ENTER == p_ota_cb_data->msg_data.write.value)
        {
            /* Check battery level first */
            if (app_db.local_batt_level >= 30)
            {
                T_APP_LE_LINK *p_link;
                p_link = app_link_find_le_link_by_conn_id(p_ota_cb_data->conn_id);
                /* Battery level is greater than or equal to 30 percent */
                if (p_link != NULL)
                {
                    app_ble_gap_disconnect(p_link, LE_LOCAL_DISC_CAUSE_SWITCH_TO_OTA);
                }
                APP_PRINT_INFO1("app_ble_service_ota_srv_cb: Preparing switch into OTA mode conn_id %d",
                                p_ota_cb_data->conn_id);
            }
            else
            {
                /* Battery level is less than 30 percent */
                APP_PRINT_WARN1("app_ble_service_ota_srv_cb: Battery level is not enough to support OTA, local_batt_level %d",
                                app_db.local_batt_level);
            }
        }
        break;

    default:

        break;
    }

    return app_result;
}

void app_ble_service_init(void)
{
    /** NOTES: 1 includes ota service.
     *  if more ble service are added, you need to modify this value.
     * */
#if F_APP_GATT_SERVER_EXT_API_SUPPORT
    server_cfg_use_ext_api(true);
    APP_PRINT_INFO0("app_ble_service_init: server_cfg_use_ext_api true");
    server_ext_register_app_cb(app_ble_service_ota_srv_cb);
#else
    server_register_app_cb(app_ble_service_ota_srv_cb);
#endif

    server_init(1);

#if F_APP_GATT_SERVER_EXT_API_SUPPORT
    gatt_svc_init(GATT_SVC_USE_EXT_SERVER, 0);
#else
    gatt_svc_init(GATT_SVC_USE_NORMAL_SERVER, 0);
#endif

    ota_add_service(app_ble_service_ota_srv_cb);
}
```

## src/app_ble_service.h
```c
/*
 * Copyright (c) 2026, Realtek Semiconductor Corporation
 *
 * SPDX-License-Identifier: LicenseRef-Realtek-5-Clause
 */

#ifndef _APP_BLE_SERVICE_H_
#define _APP_BLE_SERVICE_H_

#include <stdint.h>

#ifdef __cplusplus
extern "C" {
#endif /* __cplusplus */

/** @defgroup APP_BLE_SERVICE App Ble Service
  * @brief App Ble Service
  * @{
  */

/*============================================================================*
 *                              Macros
 *============================================================================*/
/** @defgroup APP_BLE_SERVICE_Exported_Macros App Ble Service Macros
   * @{
   */
#define TX_ENABLE_CCCD_BIT                  0x01
#define TX_ENABLE_AUTHEN_BIT                0x02
#define TX_ENABLE_READY                     (TX_ENABLE_CCCD_BIT|TX_ENABLE_AUTHEN_BIT)
/** End of APP_BLE_SERVICE_Exported_Macros
    * @}
    */

/*============================================================================*
 *                              Functions
 *============================================================================*/
/** @defgroup APP_BLE_SERVICE_Exported_Functions App Ble Service Functions
    * @{
    */
/**
    * @brief  Ble Service module init
    * @param  void
    * @return void
    */
void app_ble_service_init(void);

/** @} */ /* End of group APP_BLE_SERVICE_Exported_Functions */

/** End of APP_BLE_SERVICE
* @}
*/



#ifdef __cplusplus
}
#endif /* __cplusplus */

#endif /* _APP_BLE_SERVICE_H_ */
```

## src/app_cmd.c
```c
/*
 * Copyright (c) 2026, Realtek Semiconductor Corporation
 *
 * SPDX-License-Identifier: LicenseRef-Realtek-5-Clause
 */

#include <string.h>
#include "stdlib_corecrt.h"
#include "trace.h"
#include "gap_scan.h"
#include "app_timer.h"
#include "os_mem.h"
#include "btm.h"
#include "bt_types.h"
#include "stdlib.h"
#include "patch_header_check.h"
#include "fmc_api.h"
#include "app_cmd.h"
#include "app_main.h"
#include "app_transfer.h"
#include "app_report.h"
#include "app_ota.h"

void app_cmd_handler(uint8_t *cmd_ptr, uint16_t cmd_len, uint8_t cmd_path, uint8_t rx_seqn,
                     uint8_t app_idx)
{
    uint16_t cmd_id;
    uint8_t  ack_pkt[3];

    cmd_id     = (uint16_t)(cmd_ptr[0] | (cmd_ptr[1] << 8));
    ack_pkt[0] = cmd_ptr[0];
    ack_pkt[1] = cmd_ptr[1];
    ack_pkt[2] = CMD_SET_STATUS_COMPLETE;

    APP_PRINT_TRACE4("app_cmd_handler: cmd_id 0x%04x, cmd_len 0x%04x, cmd_path %u, rx_seqn 0x%02x",
                     cmd_id, cmd_len, cmd_path, rx_seqn);

    /* check duplicated seq num */
    if ((cmd_id != CMD_ACK) && (rx_seqn != 0))
    {
        uint8_t *check_rx_seqn = NULL;
        uint8_t  report_app_idx = app_idx;

        if (cmd_path == CMD_PATH_SPP)
        {
            check_rx_seqn = &app_db.br_link[app_idx].rx_cmd_seqn;
        }

        if (check_rx_seqn)
        {
            if (*check_rx_seqn == rx_seqn)
            {
                app_report_event(cmd_path, EVENT_ACK, report_app_idx, ack_pkt, 3);
                return;
            }

            *check_rx_seqn = rx_seqn;
        }
    }

    if (cmd_path == CMD_PATH_SPP)
    {
        app_db.br_link[app_idx].cmd_set_enable = true;
    }

    switch (cmd_id)
    {
    case CMD_ACK:
        {
            if (cmd_path == CMD_PATH_SPP)
            {
                uint16_t event_id = (uint16_t)(cmd_ptr[2] | (cmd_ptr[3] << 8));
                uint8_t status = cmd_ptr[4];

                {
                    app_transfer_queue_recv_ack_check(event_id, cmd_path);
                }

                if (event_id == EVENT_OTA_ACTIVE_ACK || event_id == EVENT_OTA_ROLESWAP)
                {
                    //if (cmd_path == CMD_PATH_SPP)
                    {
                        app_ota_cmd_ack_handle(event_id, status);
                    }
                }
            }
        }
        break;

    case CMD_OTA_DEV_INFO:
    case CMD_OTA_IMG_VER:
    case CMD_OTA_INACTIVE_BANK_VER:
    case CMD_OTA_START:
    case CMD_OTA_PACKET:
    case CMD_OTA_VALID:
    case CMD_OTA_RESET:
    case CMD_OTA_ACTIVE_RESET:
    case CMD_OTA_BUFFER_CHECK_ENABLE:
    case CMD_OTA_BUFFER_CHECK:
    case CMD_OTA_IMG_INFO:
    case CMD_OTA_SECTION_SIZE:
    case CMD_OTA_DEV_EXTRA_INFO:
    case CMD_OTA_PROTOCOL_TYPE:
    case CMD_OTA_GET_RELEASE_VER:
    case CMD_OTA_COPY_IMG:
    case CMD_OTA_CHECK_SHA256:
    case CMD_OTA_TEST_EN:
    case CMD_OTA_ROLESWAP:
    case CMD_OTA_CHECK_KEY:
        {
            app_ota_cmd_handle(cmd_path, cmd_len, cmd_ptr, app_idx);
        }
        break;
    default:
        {
            ack_pkt[2] = CMD_SET_STATUS_UNKNOW_CMD;
            app_report_event(cmd_path, EVENT_ACK, app_idx, ack_pkt, 3);
        }
        break;
    }

    APP_PRINT_TRACE1("app_cmd_handler: ack 0x%02x", ack_pkt[2]);
}
```

## src/app_flags.h
```c
/*
 * Copyright (c) 2026, Realtek Semiconductor Corporation
 *
 * SPDX-License-Identifier: LicenseRef-Realtek-5-Clause
 */

#ifndef _APP_FLAGS_H_
#define _APP_FLAGS_H_

#define  OTA_DEMO_BY_BLE_ENABLE
#define F_APP_GATT_SERVER_EXT_API_SUPPORT        0
#endif
```

## src/app_gap.c
```c
/*
 * Copyright (c) 2026, Realtek Semiconductor Corporation
 *
 * SPDX-License-Identifier: LicenseRef-Realtek-5-Clause
 */

#include <string.h>
#include "trace.h"
#include "bt_bond.h"
#include "gap.h"
#include "gap_br.h"
#include "app_gap.h"
#include "app_main.h"
#include "btm.h"
#include "app_cfg.h"

static void app_gap_bt_cback(T_BT_EVENT event_type, void *event_buf, uint16_t buf_len)
{
    T_BT_EVENT_PARAM *param = event_buf;
    T_APP_BR_LINK *p_link = NULL;


    switch (event_type)
    {
    case BT_EVENT_READY:
        {
            APP_PRINT_INFO0("BT_EVENT_READY");

            memcpy(app_db.factory_addr, param->ready.bd_addr, 6);
            memcpy(app_cfg_nv.bud_local_addr, app_db.factory_addr, 6);
        }
        break;

    case BT_EVENT_ACL_CONN_IND:
        {
            APP_PRINT_TRACE1("app_gap_bt_cback: conn ind device cod 0x%08x", param->acl_conn_ind.cod);

            p_link = app_link_find_br_link(param->acl_conn_ind.bd_addr);

            if (p_link != NULL)
            {
                bt_acl_conn_reject(param->acl_conn_ind.bd_addr, BT_ACL_REJECT_UNACCEPTABLE_ADDR);
            }
            else
            {
                bt_acl_conn_accept(param->acl_conn_ind.bd_addr, BT_LINK_ROLE_SLAVE);
            }
            //gap_br_set_radio_mode(GAP_RADIO_MODE_NONE_DISCOVERABLE, false, 0);
        }
        break;

    case BT_EVENT_LINK_KEY_REQ:
        {
            uint8_t link_key[16];
            T_BT_LINK_KEY_TYPE type;

            if (bt_bond_key_get(param->link_key_req.bd_addr, link_key, (uint8_t *)&type))
            {
                bt_link_key_cfm(param->link_key_req.bd_addr, true, type, link_key);
            }
            else
            {
                bt_link_key_cfm(param->link_key_req.bd_addr, false, type, link_key);
            }
        }
        break;

    case BT_EVENT_LINK_PIN_CODE_REQ:
        {
            uint8_t pin_code[4] = {1, 2, 3, 4};
            bt_link_pin_code_cfm(param->link_pin_code_req.bd_addr, pin_code, 4, true);
        }
        break;

    case BT_EVENT_LINK_KEY_INFO:
        break;

    case BT_EVENT_LINK_USER_CONFIRMATION_REQ:
        {
            gap_br_user_cfm_req_cfm(param->link_user_confirmation_req.bd_addr, GAP_CFM_CAUSE_ACCEPT);
        }
        break;

    case BT_EVENT_ACL_CONN_SUCCESS:
        {
            app_link_alloc_br_link(param->acl_conn_success.bd_addr);
        }
        break;

    case BT_EVENT_ACL_CONN_DISCONN:
        {
            p_link = app_link_find_br_link(param->acl_conn_disconn.bd_addr);
            if (p_link != NULL)
            {
                app_link_free_br_link(p_link);
            }
        }
        break;

    case BT_EVENT_SDP_ATTR_INFO:
        {
            APP_PRINT_INFO0("BT_EVENT_SDP_ATTR_INFO");
        }
        break;

    case BT_EVENT_SDP_DISCOV_CMPL:
        {
            APP_PRINT_INFO0("BT_EVENT_SDP_DISCOV_CMPL");
        }
        break;

    default:
        break;
    }
}

void app_gap_init(void)
{
    APP_PRINT_INFO0("app_gap_init");
    bt_mgr_cback_register(app_gap_bt_cback);
}
```

## src/app_gap.h
```c
/*
 * Copyright (c) 2026, Realtek Semiconductor Corporation
 *
 * SPDX-License-Identifier: LicenseRef-Realtek-5-Clause
 */

#ifndef _APP_GAP_H_
#define _APP_GAP_H_

#ifdef __cplusplus
extern "C" {
#endif /* __cplusplus */


/** @defgroup APP_GAP App Gap
  * @brief App Gap
  * @{
  */

/*============================================================================*
 *                              Functions
 *============================================================================*/
/** @defgroup APP_GAP_Exported_Functions App Gap Functions
    * @{
    */
/**
    * @brief  gap module init.
    * @param  void
    * @return void
    */
void app_gap_init(void);

/** @} */ /* End of group APP_GAP_Exported_Functions */
/** End of APP_GAP
* @}
*/


#ifdef __cplusplus
}
#endif /* __cplusplus */

#endif /* _APP_GAP_H_ */
```

## src/app_link_util.c
```c
/*
 * Copyright (c) 2026, Realtek Semiconductor Corporation
 *
 * SPDX-License-Identifier: LicenseRef-Realtek-5-Clause
 */

#include <string.h>
#include <stdlib.h>
#include "os_mem.h"
#include "trace.h"
#include "app_main.h"
#include "app_ble_gap.h"

T_APP_BR_LINK *app_link_find_br_link(uint8_t *bd_addr)
{
    T_APP_BR_LINK *p_link = NULL;

    if (bd_addr != NULL)
    {
        for (uint8_t i = 0; i < MAX_BR_LINK_NUM; i++)
        {
            if (app_db.br_link[i].used == true &&
                !memcmp(app_db.br_link[i].bd_addr, bd_addr, 6))
            {
                p_link = &app_db.br_link[i];
                break;
            }
        }
    }

    return p_link;
}

T_APP_BR_LINK *app_link_alloc_br_link(uint8_t *bd_addr)
{
    T_APP_BR_LINK *p_link = NULL;

    if (bd_addr != NULL)
    {
        for (uint8_t i = 0; i < MAX_BR_LINK_NUM; i++)
        {
            if (app_db.br_link[i].used == false)
            {
                p_link = &app_db.br_link[i];

                p_link->used = true;
                p_link->id   = i;
                memcpy(p_link->bd_addr, bd_addr, 6);
                break;
            }
        }
    }
    return p_link;
}

bool app_link_free_br_link(T_APP_BR_LINK *p_link)
{
    if (p_link != NULL)
    {
        if (p_link->used == true)
        {
            memset(p_link, 0, sizeof(T_APP_BR_LINK));
            return true;
        }
    }

    return false;
}

T_APP_LE_LINK *app_link_find_le_link_by_conn_id(uint8_t conn_id)
{
    T_APP_LE_LINK *p_link = NULL;
    uint8_t i;

    for (i = 0; i < MAX_BLE_LINK_NUM; i++)
    {
        if (app_db.le_link[i].used == true &&
            app_db.le_link[i].conn_id == conn_id)
        {
            p_link = &app_db.le_link[i];
            break;
        }
    }

    return p_link;
}

T_APP_LE_LINK *app_link_alloc_le_link_by_conn_id(uint8_t conn_id)
{
    T_APP_LE_LINK *p_link = NULL;
    uint8_t i;

    for (i = 0; i < MAX_BLE_LINK_NUM; i++)
    {
        if (app_db.le_link[i].used == false)
        {
            p_link = &app_db.le_link[i];

            p_link->used    = true;
            p_link->id      = i;
            p_link->conn_id = conn_id;
            break;
        }
    }

    return p_link;
}

bool app_link_free_le_link(T_APP_LE_LINK *p_link)
{
    if (p_link != NULL)
    {
        if (p_link->used == true)
        {
            if (p_link->p_embedded_cmd != NULL)
            {
                free(p_link->p_embedded_cmd);
            }

            while (p_link->disc_cb_list.count > 0)
            {
                T_LE_DISC_CB_ENTRY *p_entry;
                p_entry = os_queue_out(&p_link->disc_cb_list);
                if (p_entry)
                {
                    free(p_entry);
                }
            }

            memset(p_link, 0, sizeof(T_APP_LE_LINK));
            p_link->conn_id = 0xFF;
            return true;
        }
    }

    return false;
}

bool app_link_reg_le_link_disc_cb(uint8_t conn_id, P_FUN_LE_LINK_DISC_CB p_fun_cb)
{
    T_APP_LE_LINK *p_link = app_link_find_le_link_by_conn_id(conn_id);

    if (p_link != NULL)
    {
        T_LE_DISC_CB_ENTRY *p_entry;

        for (uint8_t i = 0; i < p_link->disc_cb_list.count; i++)
        {
            p_entry = os_queue_peek(&p_link->disc_cb_list, i);
            if (p_entry != NULL && p_entry->disc_callback == p_fun_cb)
            {
                return true;
            }
        }

        p_entry = calloc(1, sizeof(T_LE_DISC_CB_ENTRY));
        if (p_entry != NULL)
        {
            p_entry->disc_callback = p_fun_cb;
            os_queue_in(&p_link->disc_cb_list, p_entry);
            return true;
        }
    }

    return false;
}
```

## src/app_main.c
```c
/*
 * Copyright (c) 2026, Realtek Semiconductor Corporation
 *
 * SPDX-License-Identifier: LicenseRef-Realtek-5-Clause
 */

#include <stdint.h>
#include <string.h>
#include "os_mem.h"
#include "os_sched.h"
#include "os_msg.h"
#include "os_task.h"
#include "os_ext.h"
#include "trace.h"
#include "audio.h"
#include "sysm.h"
#include "gap_br.h"
#include "gap.h"
#include "fmc_api.h"
#include "spp_stream.h"
#include "ble_stream.h"
#include "app_main.h"
#include "app_gap.h"
#include "app_ble_gap.h"
#include "app_ble_service.h"
#include "app_transfer.h"
#include "app_timer.h"
#include "app_sdp.h"
#include "app_spp.h"
#include "app_cmd.h"
#include "app_ota.h"
#include "app_cfg.h"


/** @defgroup APP_MAIN App Main
  * @brief Main entry function for audio sample application.
  * @{
  */

/*============================================================================*
 *                              Macros
 *============================================================================*/
/** @defgroup OTA_APP_TASK_Exported_Macros OTA App Task Exported Macros
    * @{
    */
/**Task priorities */
#define APP_TASK_PRIORITY       1
/**Task stack size in bytes */
#define APP_TASK_STACK_SIZE     1024 * 2

#define MAX_NUMBER_OF_GAP_MESSAGE       0x20
#define MAX_NUMBER_OF_IO_MESSAGE        0x20
#define MAX_NUMBER_OF_EVENT_MESSAGE     (MAX_NUMBER_OF_GAP_MESSAGE + MAX_NUMBER_OF_IO_MESSAGE)

#define MAX_NUMBER_OF_DSP_MSG           0x20    //!< number of dsp message reserved for DSP message handling.
#define MAX_NUMBER_OF_CODEC_MSG         0x10    //!< number of codec message reserved for CODEC message handling.
#define MAX_NUMBER_OF_ANC_MSG           0x10    //!< number of anc message reserved for ANC message handling.
#define MAX_NUMBER_OF_SYS_MSG           0x20    //!< indicate SYS timer queue size
#define MAX_NUMBER_OF_LOADER_MSG        0x10    //!< indicate Bin Loader queue size
#define MAX_NUMBER_OF_APP_TIMER_MODULE  0x30    //!< indicate app timer module size

/** indicate rx event queue size*/
#define MAX_NUMBER_OF_RX_EVENT      \
    (MAX_NUMBER_OF_GAP_MESSAGE + MAX_NUMBER_OF_IO_MESSAGE + MAX_NUMBER_OF_APP_TIMER_MODULE + \
     MAX_NUMBER_OF_DSP_MSG + MAX_NUMBER_OF_CODEC_MSG + MAX_NUMBER_OF_ANC_MSG + \
     MAX_NUMBER_OF_SYS_MSG + MAX_NUMBER_OF_LOADER_MSG)

#define DEFAULT_PAGESCAN_WINDOW         0x12
#define DEFAULT_PAGESCAN_INTERVAL       0x800
#define DEFAULT_PAGE_TIMEOUT            0x2000
#define DEFAULT_SUPVISIONTIMEOUT        0x1f40
#define DEFAULT_INQUIRYSCAN_WINDOW      0x12
#define DEFAULT_INQUIRYSCAN_INTERVAL    0x1000

#define PLAYBACK_POOL_SIZE              (13*1024)
#define VOICE_POOL_SIZE                 (2*1024)
#define RECORD_POOL_SIZE                (1*1024)
#define NOTIFICATION_POOL_SIZE          (8*1024)

void *ota_demo_evt_queue_handle;
void *ota_demo_io_queue_handle;

T_APP_DB app_db;
T_APP_CFG_NV app_cfg_nv;

/**
* @brief board_init() contains the initialization of pinmux settings and pad settings.
*
*   All the pinmux settings and pad settings shall be initiated in this function.
*   But if legacy driver is used, the initialization of pinmux setting and pad setting
*   should be peformed with the IO initializing.
*
* @return void
*/
static void board_init(void)
{
}

/**
 * @brief    Contains the initialization of all tasks
 * @note     There is only one task in BLE Peripheral APP, thus only one APP task is init here
 * @return   void
 */


static void app_bt_gap_init(void)
{
    uint32_t class_of_device = (uint32_t)(0x18 | (0x04 << 8) | (0x24 << 16));

    uint16_t supervision_timeout = DEFAULT_SUPVISIONTIMEOUT;
    uint16_t link_policy = GAP_LINK_POLICY_ROLE_SWITCH | GAP_LINK_POLICY_SNIFF_MODE;
    uint8_t radio_mode = GAP_RADIO_MODE_VISIBLE_CONNECTABLE;
    bool limited_discoverable = false;
    bool auto_accept_acl = false;

    uint8_t  pagescan_type = GAP_RADIO_MODE_VISIBLE_CONNECTABLE;//GAP_PAGE_SCAN_TYPE_INTERLACED;
    uint16_t pagescan_interval = DEFAULT_PAGESCAN_INTERVAL;
    uint16_t pagescan_window = DEFAULT_PAGESCAN_WINDOW;
    uint16_t page_timeout = DEFAULT_PAGE_TIMEOUT;

    uint8_t inquiryscan_type = GAP_INQUIRY_SCAN_TYPE_STANDARD;
    uint16_t inquiryscan_window = DEFAULT_INQUIRYSCAN_WINDOW;
    uint16_t inquiryscan_interval = DEFAULT_INQUIRYSCAN_INTERVAL;
    uint8_t inquiry_mode = GAP_INQUIRY_MODE_EXTENDED_RESULT;

    uint8_t pair_mode = GAP_PAIRING_MODE_PAIRABLE;
    uint16_t auth_flags = GAP_AUTHEN_BIT_GENERAL_BONDING_FLAG | GAP_AUTHEN_BIT_SC_FLAG;
    uint8_t io_cap = GAP_IO_CAP_NO_INPUT_NO_OUTPUT;
    uint8_t oob_enable = false;
    uint8_t bt_mode = GAP_BT_MODE_21ENABLED;

    gap_lib_init();

    //1: to be slave when accept the acl connect request by default.
    gap_br_cfg_accept_role(1);

    gap_br_set_param(GAP_BR_PARAM_NAME, GAP_DEVICE_NAME_LEN, "ota demo");

    gap_set_param(GAP_PARAM_BOND_PAIRING_MODE, sizeof(uint8_t), &pair_mode);
    gap_set_param(GAP_PARAM_BOND_AUTHEN_REQUIREMENTS_FLAGS, sizeof(uint16_t), &auth_flags);
    gap_set_param(GAP_PARAM_BOND_IO_CAPABILITIES, sizeof(uint8_t), &io_cap);
    gap_set_param(GAP_PARAM_BOND_OOB_ENABLED, sizeof(uint8_t), &oob_enable);

    gap_br_set_param(GAP_BR_PARAM_BT_MODE, sizeof(uint8_t), &bt_mode);
    gap_br_set_param(GAP_BR_PARAM_COD, sizeof(uint32_t), &class_of_device);
    gap_br_set_param(GAP_BR_PARAM_LINK_POLICY, sizeof(uint16_t), &link_policy);
    gap_br_set_param(GAP_BR_PARAM_SUPV_TOUT, sizeof(uint16_t), &supervision_timeout);
    gap_br_set_param(GAP_BR_PARAM_AUTO_ACCEPT_ACL, sizeof(bool), &auto_accept_acl);

    gap_br_set_param(GAP_BR_PARAM_RADIO_MODE, sizeof(uint8_t), &radio_mode);
    gap_br_set_param(GAP_BR_PARAM_LIMIT_DISCOV, sizeof(bool), &limited_discoverable);

    gap_br_set_param(GAP_BR_PARAM_PAGE_SCAN_TYPE, sizeof(uint8_t), &pagescan_type);
    gap_br_set_param(GAP_BR_PARAM_PAGE_SCAN_INTERVAL, sizeof(uint16_t), &pagescan_interval);
    gap_br_set_param(GAP_BR_PARAM_PAGE_SCAN_WINDOW, sizeof(uint16_t), &pagescan_window);
    gap_br_set_param(GAP_BR_PARAM_PAGE_TIMEOUT, sizeof(uint16_t), &page_timeout);

    gap_br_set_param(GAP_BR_PARAM_INQUIRY_SCAN_TYPE, sizeof(uint8_t), &inquiryscan_type);
    gap_br_set_param(GAP_BR_PARAM_INQUIRY_SCAN_INTERVAL, sizeof(uint16_t), &inquiryscan_interval);
    gap_br_set_param(GAP_BR_PARAM_INQUIRY_SCAN_WINDOW, sizeof(uint16_t), &inquiryscan_window);
    gap_br_set_param(GAP_BR_PARAM_INQUIRY_MODE, sizeof(uint8_t), &inquiry_mode);

#ifdef OTA_DEMO_BY_BLE_ENABLE
    app_ble_gap_param_init();
#endif
}

static void framework_init(void)
{
    /* System Manager */
    sys_mgr_init(ota_demo_evt_queue_handle);

    /* RemoteController Manager */
    remote_mgr_init(REMOTE_SESSION_ROLE_SINGLE);

    /* Bluetooth Manager */
    bt_mgr_init();

    /* Audio Manager */
    audio_mgr_init(PLAYBACK_POOL_SIZE, VOICE_POOL_SIZE, RECORD_POOL_SIZE, NOTIFICATION_POOL_SIZE);
}

void app_handle_io_msg(T_IO_MSG io_msg)
{
    uint16_t msg_type = io_msg.type;

    switch (msg_type)
    {
    case IO_MSG_TYPE_BT_STATUS:
        {
            app_ble_gap_handle_gap_msg(&io_msg);
        }
        break;
    default:
        break;
    }
}

/**
    * @brief        App task to handle events & messages
    * @param[in]    p_params    Parameters sending to the task
    * @return       void
    */
static void ota_demo_main_task(void *p_params)
{
    char event;

    APP_PRINT_INFO2("ota_demo_main_task OTA_DEMO_TASK_STACK_SIZE:%d OTA_DEMO_TASK_PRIORITY:%d",
                    APP_TASK_STACK_SIZE,
                    APP_TASK_PRIORITY);

    gap_start_bt_stack(ota_demo_evt_queue_handle, ota_demo_io_queue_handle, MAX_NUMBER_OF_GAP_MESSAGE);

    while (true)
    {
        if (os_msg_recv(ota_demo_evt_queue_handle, &event, 0xFFFFFFFF) == true)
        {
            if (EVENT_GROUP(event) == EVENT_GROUP_IO)
            {
                T_IO_MSG io_msg;

                if (os_msg_recv(ota_demo_io_queue_handle, &io_msg, 0) == true)
                {
                    if (event == EVENT_IO_TO_APP)
                    {
                        app_handle_io_msg(io_msg);
                    }
                }
            }
            else if (EVENT_GROUP(event) == EVENT_GROUP_STACK)
            {
                gap_handle_msg(event);
            }
            else if (EVENT_GROUP(event) == EVENT_GROUP_FRAMEWORK)
            {
                sys_mgr_event_handle(event);
            }
            else if (EVENT_GROUP(event) == EVENT_GROUP_APP)
            {
                app_timer_handle_msg(event);
            }
        }
    }
}

/** @} */ /* End of group OTA_APP_TASK_Exported_Functions */

/** @} */ /* End of group OTA_APP_TASK */


int main(void)
{
    void *app_task_handle;

    APP_PRINT_INFO0("OTA_DEMO START FROM HW_RESET");

    os_msg_queue_create(&ota_demo_io_queue_handle, "ioQ", MAX_NUMBER_OF_IO_MESSAGE, sizeof(T_IO_MSG));
    os_msg_queue_create(&ota_demo_evt_queue_handle, "evtQ", MAX_NUMBER_OF_EVENT_MESSAGE,
                        sizeof(unsigned char));

    app_init_timer(ota_demo_evt_queue_handle, MAX_NUMBER_OF_APP_TIMER_MODULE);

    board_init();
    framework_init();

    app_bt_gap_init();
    app_ota_init();

    app_gap_init();

#ifdef OTA_DEMO_BY_BLE_ENABLE
    app_ble_gap_init();
    app_ble_service_init();
#endif

    app_sdp_init();
    app_spp_init();

    app_transfer_init();

    os_task_create(
        &app_task_handle,       /* Task handle. */
        "ota_demo_main_task",   /* Text name for the task, to facilitate debug only. */
        ota_demo_main_task,     /* Pointer to the function that implements the task. */
        (void *)0,              /* We are not using the task parameter. */
        APP_TASK_STACK_SIZE,    /* Stack depth in bytes, 1KB. */
        APP_TASK_PRIORITY       /* This task will run at priority 2. */
    );

    os_sched_start();

    return 0;
}


/** End of APP_MAIN
* @}
*/
```
