## CMakeLists.txt
```
#
# Copyright (c) 2026, Realtek Semiconductor Corporation
#
# SPDX-License-Identifier: LicenseRef-Realtek-5-Clause
#

message(STATUS "CMAKELIST FOLDER: ${CMAKE_CURRENT_SOURCE_DIR}")

cmake_minimum_required(VERSION 3.20.0)

#===========version generation===========
include(${CMAKE_CURRENT_SOURCE_DIR}/../../cmake/version_generate.cmake)
generate_version()
#===========version generation===========
#===========post build===========
# post build should be called before find_package
include(${CMAKE_CURRENT_SOURCE_DIR}/../../cmake/post_build.cmake)
rtk_post_build()
#===========post build===========

find_package(Zephyr REQUIRED HINTS $ENV{ZEPHYR_BASE})
project(ble_observer)

FILE(GLOB app_sources src/*.c)
target_sources(app PRIVATE
  ${app_sources}
  )

set(sources

   )

set(headers
    #header files from app
	src/
    #header files from libs

    )

foreach(header ${headers})
    if(EXISTS ${header})
        zephyr_include_directories(${header})
    else()
        message(FATAL_ERROR "header file directory does not exist: ${header}. Current cmakelist: ${CMAKE_CURRENT_SOURCE_DIR}")
    endif()
endforeach()

foreach(src ${sources})
    if(EXISTS ${src})
        target_sources(app PRIVATE ${src})
    else()
        message(FATAL_ERROR "source file does not exist: ${src}. Current cmakelist: ${CMAKE_CURRENT_SOURCE_DIR}")
    endif()
endforeach()

target_precompile_headers(app PUBLIC
	          ${CMAKE_CURRENT_SOURCE_DIR}/src/app_observer_flags.h
			  )

target_include_directories(app PRIVATE src)
```

## prj.conf
```kconfig
# nothing here
CONFIG_REALTEK_SUBSYS_BLE_MGR=y
```

## src/app_observer_flags.h
```c
/*
 * Copyright (c) 2026, Realtek Semiconductor Corporation
 *
 * SPDX-License-Identifier: LicenseRef-Realtek-5-Clause
 */

#ifndef _APP_OBSERVER_FLAGS_H_
#define _APP_OBSERVER_FLAGS_H_

/** @defgroup  OB_Config Observer App Configuration
    * @brief This file is used to config app functions.
    * @{
    */
/*============================================================================*
 *                              Constants
 *============================================================================*/
/** @brief  Config DLPS: 0-Disable DLPS, 1-Enable DLPS */
#define F_DLPS_EN                        1

/** @} */ /* End of group OB_Config */
#endif
```

## src/app_observer_gap.c
```c
/*
 * Copyright (c) 2026, Realtek Semiconductor Corporation
 *
 * SPDX-License-Identifier: LicenseRef-Realtek-5-Clause
 */

/*============================================================================*
 *                              Header Files
 *============================================================================*/
#include "trace.h"
#include "ble_mgr.h"
#include "string.h"
#include "app_observer_gap.h"
#include "app_observer_scan.h"

/** @defgroup  OB_APP Observer Application
    * @brief This file handles BLE observer application routines.
    * @{
    */
/** @defgroup  OB_GAP_MSG GAP Message Handler
    * @brief Handle GAP Message
    * @{
    */
/*============================================================================*
 *                              Variables
 *============================================================================*/
T_GAP_DEV_STATE gap_dev_state = {0, 0, 0, 0};/**< GAP device state */
void app_handle_gap_msg(T_IO_MSG  *p_gap_msg);

/*============================================================================*
 *                              Functions
 *============================================================================*/
/**
 * @brief app_gap_ble_mgr_init
 *        initialize ble manager lib which will enable ble extend scan module.
 */
void app_gap_ble_mgr_init(void)
{
    BLE_MGR_PARAMS param = {0};
    param.ble_scan.enable = true;
    ble_mgr_init(&param);
}

/**
 * @brief app_gap_init
 *        register gap message callback and initialize ble manager module.
 */
void app_gap_init(void)
{
    /* register gap message callback */
    le_register_app_cb(app_gap_callback);

    /* ble manager module initialize*/
    app_gap_ble_mgr_init();
}

/**
 * @brief app_handle_io_msg
 *        All the application messages are pre-handled in this function
 * @note  All the IO MSGs are sent to this function, then the event handling
 *        function shall be called according to the MSG type.
 * @param[in] io_msg  IO message data
 * @return    void
 */
void app_handle_io_msg(T_IO_MSG io_msg)
{
    uint16_t msg_type = io_msg.type;

    switch (msg_type)
    {
    case IO_MSG_TYPE_BT_STATUS:
        {
            app_handle_gap_msg(&io_msg);
        }
        break;

    default:
        break;
    }
}

/**
 * @brief app_handle_dev_state_evt
 *        Handle msg GAP_MSG_LE_DEV_STATE_CHANGE
 * @note  All the gap device state events are pre-handled in this function.
 *        Then the event handling function shall be called according to the new_state.
 * @param[in] new_state  New gap device state
 * @param[in] cause GAP device state change cause
 * @return    void
 */
void app_handle_dev_state_evt(T_GAP_DEV_STATE new_state, uint16_t cause)
{
    APP_PRINT_INFO3("app_handle_dev_state_evt: init state %d, scan state %d, cause 0x%x",
                    new_state.gap_init_state,
                    new_state.gap_scan_state, cause);
    if (gap_dev_state.gap_init_state != new_state.gap_init_state)
    {
        if (new_state.gap_init_state == GAP_INIT_STATE_STACK_READY)
        {
            APP_PRINT_INFO0("app_handle_dev_state_evt: GAP stack ready");
            /*stack ready*/
            app_scan_start(APP_SCAN_INTERVAL, APP_SCAN_WINDOW);
        }
    }

    if (gap_dev_state.gap_scan_state != new_state.gap_scan_state)
    {
        if (new_state.gap_scan_state == GAP_SCAN_STATE_IDLE)
        {
            APP_PRINT_INFO0("GAP scan stop");
        }
        else if (new_state.gap_scan_state == GAP_SCAN_STATE_SCANNING)
        {
            APP_PRINT_INFO0("GAP scan start");
        }
    }

    gap_dev_state = new_state;
}

/**
 * @brief app_handle_gap_msg
 *        All the BT GAP MSG are pre-handled in this function.
 * @note  Then the event handling function shall be called according to the
 *        subtype of T_IO_MSG
 * @param[in] p_gap_msg Pointer to GAP msg
 * @return    void
 */
void app_handle_gap_msg(T_IO_MSG *p_gap_msg)
{
    T_LE_GAP_MSG gap_msg;
    memcpy(&gap_msg, &p_gap_msg->u.param, sizeof(p_gap_msg->u.param));
    ble_mgr_handle_gap_msg(p_gap_msg->subtype, &gap_msg);
    APP_PRINT_ERROR1("app_handle_gap_msg: subtype %d", p_gap_msg->subtype);

    switch (p_gap_msg->subtype)
    {
    case GAP_MSG_LE_DEV_STATE_CHANGE:
        {
            app_handle_dev_state_evt(gap_msg.msg_data.gap_dev_state_change.new_state,
                                     gap_msg.msg_data.gap_dev_state_change.cause);
        }
        break;

    default:
        //APP_PRINT_ERROR1("app_handle_gap_msg: unknown subtype %d", p_gap_msg->subtype);
        break;
    }
}
/** @} */ /* End of group OB_GAP_MSG */

/** @defgroup  OB_GAP_CALLBACK GAP Callback Event Handler
    * @brief Handle GAP callback event
    * @{
    */
/**
  * @brief app_gap_callback
  *        Callback for gap le to notify app
  * @param[in] cb_type callback msy type @ref GAP_LE_MSG_Types.
  * @param[in] p_cb_data point to callback data @ref T_LE_CB_DATA.
  * @retval    result @ref T_APP_RESULT
  */
T_APP_RESULT app_gap_callback(uint8_t cb_type, void *p_cb_data)
{
    T_APP_RESULT result = APP_RESULT_SUCCESS;
    T_LE_CB_DATA *p_data = (T_LE_CB_DATA *)p_cb_data;
    ble_mgr_handle_gap_cb(cb_type, p_cb_data);
    APP_PRINT_INFO1("app_gap_callback: cb_type 0x%x", cb_type);

    switch (cb_type)
    {
    case GAP_MSG_LE_MODIFY_WHITE_LIST:
        APP_PRINT_INFO2("app_gap_callback: GAP_MSG_LE_MODIFY_WHITE_LIST operation %d, cause 0x%x",
                        p_data->p_le_modify_white_list_rsp->operation,
                        p_data->p_le_modify_white_list_rsp->cause);
        break;

    default:
        //APP_PRINT_ERROR1("app_gap_callback: unhandled cb_type 0x%x", cb_type);
        break;
    }
    return result;
}
/** @} */ /* End of group OB_GAP_CALLBACK */

/** @} */ /* End of group OB_APP */
```

## src/app_observer_gap.h
```c
/*
 * Copyright (c) 2026, Realtek Semiconductor Corporation
 *
 * SPDX-License-Identifier: LicenseRef-Realtek-5-Clause
 */

#ifndef _APP_OBSERVER_GAP_H_
#define _APP_OBSERVER_GAP_H_

#ifdef __cplusplus
extern "C" {
#endif
/*============================================================================*
 *                              Header Files
 *============================================================================*/
#include <app_msg.h>
#include <gap_le.h>

/** @defgroup OB_APP Observer Application
  * @brief Observer Application
  * @{
  */
/*============================================================================*
 *                              Functions
 *============================================================================*/
/**
 * @brief app_handle_io_msg
 *        All the application messages are pre-handled in this function
 * @note  All the IO MSGs are sent to this function, then the event handling
 *        function shall be called according to the MSG type.
 * @param[in] io_msg  IO message data
 * @return    void
 */
void app_handle_io_msg(T_IO_MSG io_msg);

/**
  * @brief app_gap_callback
  *        Callback for gap le to notify app
  * @param[in] cb_type callback msy type @ref GAP_LE_MSG_Types.
  * @param[in] p_cb_data point to callback data @ref T_LE_CB_DATA.
  * @retval    result @ref T_APP_RESULT
  */
T_APP_RESULT app_gap_callback(uint8_t cb_type, void *p_cb_data);

/**
 * @brief app_gap_init
 *        register gap message callback and initialize ble manager module.
 */
void app_gap_init(void);

/** End of OB_APP
* @}
*/

#ifdef __cplusplus
}
#endif
#endif
```

## src/app_observer_main.c
```c
/*
 * Copyright (c) 2026, Realtek Semiconductor Corporation
 *
 * SPDX-License-Identifier: LicenseRef-Realtek-5-Clause
 */

/*============================================================================*
 *                              Header Files
 *============================================================================*/
#include "pm.h"
#include "os_sched.h"
#include "trace.h"
#include "gap_le.h"
#include "app_observer_gap.h"
#include "app_observer_task.h"

/** @defgroup  OB_DEMO_MAIN Observer Main
    * @brief Main file to initialize hardware and BT stack and start task scheduling
    * @{
    */
/*============================================================================*
 *                              Functions
 *============================================================================*/
/**
 * @brief board_init
          Contains the initialization of pinmux settings and pad settings
 * @note  All the pinmux settings and pad settings shall be initiated in this function,
 *        but if legacy driver is used, the initialization of pinmux setting and pad setting
 *        should be peformed with the IO initializing.
 * @return  void
 */
void board_init(void)
{

}

/**
 * @brief driver_init
          Contains the initialization of peripherals
 * @note  Both new architecture driver and legacy driver initialization method can be used
 * @return   void
 */
void driver_init(void)
{

}

/**
 * @brief pwr_mgr_init
          Contains the power mode settings
 * @return void
 */
void pwr_mgr_init(void)
{
#if F_DLPS_EN
    bt_power_mode_set(BTPOWER_DEEP_SLEEP);
    power_mode_set(POWER_DLPS_MODE);
#endif
}

/**
 * @brief    Contains the initialization of all tasks
 * @note     There is only one task in BLE Observer APP, thus only one APP task is init here
 * @return   void
 */
void task_init(void)
{
    app_task_init();
}

/**
 * @brief    Entry of APP code
 * @return   int (To avoid compile warning)
 */
int main(void)
{
    board_init();
    le_gap_init(0);
    gap_lib_init();
    app_gap_init();
    pwr_mgr_init();
    task_init();
    os_sched_start();

    return 0;
}
/** @} */ /* End of group OB_DEMO_MAIN */
```

## src/app_observer_scan.c
```c
/*
 * Copyright (c) 2026, Realtek Semiconductor Corporation
 *
 * SPDX-License-Identifier: LicenseRef-Realtek-5-Clause
 */

/*============================================================================*
 *                              Header Files
 *============================================================================*/
#include "ble_mgr.h"
#include "ble_scan.h"
#include "trace.h"
#include "string.h"
#include "stdint.h"
#include "app_observer_scan.h"

/** @defgroup  OB_APP Observer Application
    * @brief This file handles BLE observer application routines.
    * @{
    */
/*============================================================================*
 *                              Variables
 *============================================================================*/
static BLE_SCAN_HDL app_scan_hdl = NULL;

/*============================================================================*
 *                              Functions
 *============================================================================*/

/**
 * @brief app_scan_cb used to notify APP when receive BLE_SCAN_REPORT or BLE_SCAN_PARAM_CHANGES
 * BLE_SCAN_REPORT:
 * report this event to APP when scanning to advertising device.
 * BLE_SCAN_PARAM_CHANGES:
 * report this event to APP when scan parameter has been modified.
 * @param evt @ref BLE_SCAN_EVT
 * @param data @ref BLE_SCAN_EVT_DATA Information of le extended advertising report.
 */
static void app_scan_cb(BLE_SCAN_EVT evt, BLE_SCAN_EVT_DATA *data)
{
    uint8_t scan_state = ble_scan_get_cur_state();

    switch (evt)
    {
    case BLE_SCAN_REPORT:
        APP_PRINT_INFO6("app_scan_cb: BLE_SCAN_REPORT event_type 0x%x, bd_addr %s, addr_type %d, rssi %d, data_len %d, data_status 0x%x",
                        data->report->event_type,
                        TRACE_BDADDR(data->report->bd_addr),
                        data->report->addr_type,
                        data->report->rssi,
                        data->report->data_len,
                        data->report->data_status);
        break;

    default:
        break;
    }
}

/**
 * @brief app_scan_start
 * @param scan_interval The frequency of scan, in units of 0.625ms, range: 0x0004 to 0xFFFF.
 * @param scan_window   The length of scan, in units of 0.625ms, range: 0x0004 to 0xFFFF.
 */
void app_scan_start(uint16_t scan_interval, uint16_t scan_window)
{
    BLE_SCAN_PARAM param;
    BLE_SCAN_FILTER scan_filter;

    APP_PRINT_TRACE2("app_scan_start: scan_interval 0x%x, scan_window 0x%x",
                     scan_interval, scan_window);

    memset(&param, 0, sizeof(param));
    memset(&scan_filter, 0, sizeof(scan_filter));

    param.scan_param_1m.scan_type = GAP_SCAN_MODE_ACTIVE;
    param.scan_param_1m.scan_interval = scan_interval;
    param.scan_param_1m.scan_window = scan_window;
    param.scan_param_coded.scan_type = GAP_SCAN_MODE_ACTIVE;
    param.scan_param_coded.scan_interval = scan_interval;
    param.scan_param_coded.scan_window = scan_window;
    param.ext_filter_duplicate = GAP_SCAN_FILTER_DUPLICATE_DISABLE;
    param.ext_filter_policy = GAP_SCAN_FILTER_ANY;
    param.own_addr_type = GAP_LOCAL_ADDR_LE_PUBLIC;
    param.phys = GAP_EXT_SCAN_PHYS_1M_BIT;

    scan_filter.filter_flags = BLE_SCAN_FILTER_NONE;

    ble_scan_start(&app_scan_hdl, app_scan_cb, &param, &scan_filter);
}

/**
 * @brief app_scan_stop
 *
 */
void app_scan_stop(void)
{
    ble_scan_stop(&app_scan_hdl);
}
/** @} */ /* End of group OB_APP */
```

## src/app_observer_scan.h
```c
/*
 * Copyright (c) 2026, Realtek Semiconductor Corporation
 *
 * SPDX-License-Identifier: LicenseRef-Realtek-5-Clause
 */

#ifndef _APP_OBSERVER_SCAN_H_
#define _APP_OBSERVER_SCAN_H_

#ifdef __cplusplus
extern "C"
{
#endif

#include "stdint.h"

#define APP_SCAN_INTERVAL     (0xA0)
#define APP_SCAN_WINDOW       (0x98)

/** @defgroup  OB_APP Observer Application
    * @brief This file handles BLE observer application routines.
    * @{
    */
/**
 * @brief app_scan_start
 * @param scan_interval The frequency of scan, in units of 0.625ms, range: 0x0004 to 0xFFFF.
 * @param scan_window   The length of scan, in units of 0.625ms, range: 0x0004 to 0xFFFF.
 */
void app_scan_start(uint16_t scan_interval, uint16_t scan_window);

/**
 * @brief app_scan_stop
 *
 */
void app_scan_stop(void);

/** End of OB_APP
* @}
*/
#ifdef __cplusplus
}
#endif
#endif
```

## src/app_observer_task.c
```c
/*
 * Copyright (c) 2026, Realtek Semiconductor Corporation
 *
 * SPDX-License-Identifier: LicenseRef-Realtek-5-Clause
 */

/*============================================================================*
 *                              Header Files
 *============================================================================*/
#include "os_msg.h"
#include "os_task.h"
#include "app_observer_gap.h"
#include "app_observer_task.h"

/** @defgroup  OB_APP_TASK Observer App Task
    * @brief This file handles the implementation of application task related functions.
    *
    * Create App task and handle events & messages
    * @{
    */
/*============================================================================*
 *                              Macros
 *============================================================================*/
#define APP_TASK_PRIORITY             2         //!< Task priorities
#define APP_TASK_STACK_SIZE           256 * 4   //!<  Task stack size
#define MAX_NUMBER_OF_GAP_MESSAGE     0x20      //!<  GAP message queue size
#define MAX_NUMBER_OF_IO_MESSAGE      0x20      //!<  IO message queue size
#define MAX_NUMBER_OF_EVENT_MESSAGE   (MAX_NUMBER_OF_GAP_MESSAGE + MAX_NUMBER_OF_IO_MESSAGE)    //!< Event message queue size

/*============================================================================*
 *                              Variables
 *============================================================================*/
void *app_task_handle;   //!< APP Task handle
void *evt_queue_handle;  //!< Event queue handle
void *io_queue_handle;   //!< IO queue handle

/*============================================================================*
 *                              Functions
 *============================================================================*/
void app_main_task(void *p_param);

/**
 * @brief app_task_init
          Initialize App task
 * @return void
 */
void app_task_init()
{
    os_task_create(&app_task_handle, "app", app_main_task, 0, APP_TASK_STACK_SIZE,
                   APP_TASK_PRIORITY);
}

/**
 * @brief app_main_task
          App task to handle events & messages
 * @param[in]    p_param    Parameters sending to the task
 * @return       void
 */
void app_main_task(void *p_param)
{
    uint8_t event;

    os_msg_queue_create(&io_queue_handle, "ioQ", MAX_NUMBER_OF_IO_MESSAGE, sizeof(T_IO_MSG));
    os_msg_queue_create(&evt_queue_handle, "evtQ", MAX_NUMBER_OF_EVENT_MESSAGE, sizeof(uint8_t));

    gap_start_bt_stack(evt_queue_handle, io_queue_handle, MAX_NUMBER_OF_GAP_MESSAGE);

    driver_init();
    while (true)
    {
        if (os_msg_recv(evt_queue_handle, &event, 0xFFFFFFFF) == true)
        {
            if (event == EVENT_IO_TO_APP)
            {
                T_IO_MSG io_msg;
                if (os_msg_recv(io_queue_handle, &io_msg, 0) == true)
                {
                    app_handle_io_msg(io_msg);
                }
            }
            else
            {
                gap_handle_msg(event);
            }
        }
    }
}
/** @} */ /* End of group OB_APP_TASK */
```

## src/app_observer_task.h
```c
/*
 * Copyright (c) 2026, Realtek Semiconductor Corporation
 *
 * SPDX-License-Identifier: LicenseRef-Realtek-5-Clause
 */

#ifndef _APP_OBSERVER_TASK_H_
#define _APP_OBSERVER_TASK_H_

#ifdef __cplusplus
extern "C"
{
#endif

/** @defgroup OB_APP_TASK Observer App Task
  * @brief Observer App Task
  * @{
  */
extern void driver_init(void);

/**
 * @brief  Initialize App task
 * @return void
 */
void app_task_init(void);

/** End of OB_APP_TASK
* @}
*/

#ifdef __cplusplus
}
#endif
#endif
```
