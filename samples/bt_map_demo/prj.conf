## CMakeLists.txt
```
#
# Copyright (c) 2026, Realtek Semiconductor Corporation
#
# SPDX-License-Identifier: LicenseRef-Realtek-5-Clause
#

message(STATUS "CMAKELIST FOLDER: ${CMAKE_CURRENT_SOURCE_DIR}")

cmake_minimum_required(VERSION 3.20.0)

#===========version generation===========
include(${CMAKE_CURRENT_SOURCE_DIR}/../../cmake/version_generate.cmake)
generate_version()
#===========version generation===========
#===========post build===========
# post build should be called before find_package
include(${CMAKE_CURRENT_SOURCE_DIR}/../../cmake/post_build.cmake)
rtk_post_build()
#===========post build===========

find_package(Zephyr REQUIRED HINTS $ENV{ZEPHYR_BASE})
project(bt_map_demo)

FILE(GLOB app_sources src/*.c)
target_sources(app PRIVATE
  ${app_sources}
  )

target_precompile_headers(app PUBLIC 
	          ${CMAKE_CURRENT_SOURCE_DIR}/src/app_flags.h
			  )
    
target_include_directories(app PRIVATE src)
```

## prj.conf
```kconfig
# nothing here
CONFIG_HEAP_MEM_POOL_SIZE=2048
CONFIG_SERIAL=y
CONFIG_UART_ASYNC_API=y
CONFIG_REALTEK_SUBSYS_AUDIO=y
CONFIG_REALTEK_SUBSYS_BTM=y
CONFIG_REALTEK_SUBSYS_CONSOLE=y
CONFIG_REALTEK_SUBSYS_REMOTE=y
CONFIG_REALTEK_SUBSYS_SYSM=y
```

## src/app_bt_map_demo.c
```c
/*
 * Copyright (c) 2026, Realtek Semiconductor Corporation
 *
 * SPDX-License-Identifier: LicenseRef-Realtek-5-Clause
 */

#include <string.h>
#include "trace.h"
#include "console.h"
#include "btm.h"
#include "bt_types.h"
#include "bt_sdp.h"
#include "bt_map.h"
#include "app_bt_map_demo_link.h"
#include "app_bt_map_demo.h"

#define RFC_MAP_MNS_CHANN_NUM           20
#define L2CAP_MAP_MNS_PSM               0x1001

static const uint8_t map_mce_sdp_record[] =
{
    SDP_DATA_ELEM_SEQ_HDR,
    0x49,
    //attribute SDP_ATTR_SRV_CLASS_ID_LIST
    SDP_UNSIGNED_TWO_BYTE,
    (uint8_t)(SDP_ATTR_SRV_CLASS_ID_LIST >> 8),
    (uint8_t)SDP_ATTR_SRV_CLASS_ID_LIST,
    SDP_DATA_ELEM_SEQ_HDR,
    0x03,
    SDP_UUID16_HDR,
    (uint8_t)(UUID_MSG_NOTIFICATION_SERVER >> 8),
    (uint8_t)(UUID_MSG_NOTIFICATION_SERVER),

    //attribute SDP_ATTR_PROTO_DESC_LIST
    SDP_UNSIGNED_TWO_BYTE,
    (uint8_t)(SDP_ATTR_PROTO_DESC_LIST >> 8),
    (uint8_t)SDP_ATTR_PROTO_DESC_LIST,
    SDP_DATA_ELEM_SEQ_HDR,
    0x11,
    SDP_DATA_ELEM_SEQ_HDR,
    0x03,
    SDP_UUID16_HDR,
    (uint8_t)(UUID_L2CAP >> 8),
    (uint8_t)(UUID_L2CAP),
    SDP_DATA_ELEM_SEQ_HDR,
    0x05,
    SDP_UUID16_HDR,
    (uint8_t)(UUID_RFCOMM >> 8),
    (uint8_t)(UUID_RFCOMM),
    SDP_UNSIGNED_ONE_BYTE,
    RFC_MAP_MNS_CHANN_NUM,  //channel number
    SDP_DATA_ELEM_SEQ_HDR,
    0x03,
    SDP_UUID16_HDR,
    (uint8_t)(UUID_OBEX >> 8),
    (uint8_t)(UUID_OBEX),

    //Attribute SDP_ATTR_SRV_NAME
    SDP_UNSIGNED_TWO_BYTE,
    (uint8_t)((SDP_ATTR_SRV_NAME + SDP_BASE_LANG_OFFSET) >> 8),
    (uint8_t)(SDP_ATTR_SRV_NAME + SDP_BASE_LANG_OFFSET),
    SDP_STRING_HDR,
    0x0B,
    'R', 'e', 'a', 'l', 't', 'e', 'k', '-', 'M', 'N', 'S',

    //attribute SDP_ATTR_PROFILE_DESC_LIST
    SDP_UNSIGNED_TWO_BYTE,
    (uint8_t)(SDP_ATTR_PROFILE_DESC_LIST >> 8),
    (uint8_t)SDP_ATTR_PROFILE_DESC_LIST,
    SDP_DATA_ELEM_SEQ_HDR,
    0x08,
    SDP_DATA_ELEM_SEQ_HDR,
    0x06,
    SDP_UUID16_HDR,
    (uint8_t)(UUID_MSG_ACCESS_PROFILE >> 8),
    (uint8_t)UUID_MSG_ACCESS_PROFILE,
    SDP_UNSIGNED_TWO_BYTE,
    0x01,
    0x04,   //version 1.4

    //attribute SDP_ATTR_L2C_PSM
    SDP_UNSIGNED_TWO_BYTE,
    (uint8_t)((SDP_ATTR_L2C_PSM) >> 8),
    (uint8_t)(SDP_ATTR_L2C_PSM),
    SDP_UNSIGNED_TWO_BYTE,
    (uint8_t)(L2CAP_MAP_MNS_PSM >> 8),
    (uint8_t)(L2CAP_MAP_MNS_PSM),

    //attribute SDP_ATTR_MAP_SUPPERTED_FEATS
    SDP_UNSIGNED_TWO_BYTE,
    (uint8_t)((SDP_ATTR_MAP_SUPPERTED_FEATS) >> 8),
    (uint8_t)(SDP_ATTR_MAP_SUPPERTED_FEATS),
    SDP_UNSIGNED_FOUR_BYTE,
    (uint8_t)(0x0000024F >> 24),
    (uint8_t)(0x0000024F >> 16),
    (uint8_t)(0x0000024F >> 8),
    (uint8_t)(0x0000024F)
};

static void app_map_demo_cback(T_BT_EVENT event_type, void *event_buf, uint16_t buf_len)
{
    T_BT_EVENT_PARAM *param = event_buf;
    //T_APP_MAP_DEMO_LINK *p_link;

    switch (event_type)
    {
    case BT_EVENT_SDP_ATTR_INFO:
        {
            T_BT_SDP_ATTR_INFO *sdp_info = &param->sdp_attr_info.info;

            if (sdp_info->srv_class_uuid_data.uuid_16 == UUID_MSG_ACCESS_SERVER)
            {
                bt_map_mas_connect_over_rfc_req(param->sdp_attr_info.bd_addr, sdp_info->server_channel);
            }
        }
        break;

    case BT_EVENT_MAP_MAS_CONN_CMPL:
        {
            char *temp_buff = "MAP Connected!\r\n";
            console_write((uint8_t *)temp_buff, strlen(temp_buff));
        }
        break;

    case BT_EVENT_MAP_MAS_DISCONN_CMPL:
        {
            char *temp_buff = "MAP Disconnected!\r\n";
            console_write((uint8_t *)temp_buff, strlen(temp_buff));
        }
        break;

    case BT_EVENT_MAP_MNS_CONN_IND:
        {
            bt_map_mns_connect_cfm(param->map_mns_conn_ind.bd_addr, true);
        }
        break;

    case BT_EVENT_MAP_MNS_CONN_CMPL:
        {
            char *temp_buff = "MAP Message Notification ON!\r\n";
            console_write((uint8_t *)temp_buff, strlen(temp_buff));
        }
        break;

    case BT_EVENT_MAP_MNS_DISCONN_CMPL:
        {
            char *temp_buff = "MAP Message Notification OFF!\r\n";
            console_write((uint8_t *)temp_buff, strlen(temp_buff));
        }
        break;

    case BT_EVENT_MAP_GET_FOLDER_LISTING_CMPL:
        {
            T_BT_EVENT_PARAM_MAP_GET_FOLDER_LISTING_CMPL *event;

            event = &(param->map_get_folder_listing_cmpl);
            if (!event->data_end)
            {
                bt_map_mas_get_continue(event->bd_addr);
            }
            else
            {
                char *temp_buff = "MAP Get Folder Listing Success!\r\n";
                console_write((uint8_t *)temp_buff, strlen(temp_buff));
            }
        }
        break;

    case BT_EVENT_MAP_GET_MSG_LISTING_CMPL:
        {
            T_BT_EVENT_PARAM_MAP_GET_MSG_LISTING_CMPL *event;

            event = &(param->map_get_msg_listing_cmpl);
            if (!event->data_end)
            {
                bt_map_mas_get_continue(event->bd_addr);
            }
            else
            {
                char *temp_buff = "MAP Get Message Listing Success!\r\n";
                console_write((uint8_t *)temp_buff, strlen(temp_buff));
            }
        }
        break;

    case BT_EVENT_MAP_GET_MSG_CMPL:
        {
            T_BT_EVENT_PARAM_MAP_GET_MSG_CMPL *event;

            event = &(param->map_get_msg_cmpl);
            if (!event->data_end)
            {
                bt_map_mas_get_continue(event->bd_addr);
            }
            else
            {
                char *temp_buff = "MAP Get Message Success!\r\n";
                console_write((uint8_t *)temp_buff, strlen(temp_buff));
            }
        }
        break;

    case BT_EVENT_MAP_MSG_NOTIFICATION:
        {
            T_BT_EVENT_PARAM_MAP_MSG_NOTIFICATION *event;

            event = &(param->map_msg_notification);
            if (!event->data_end)
            {
                bt_map_mns_send_event_rsp(event->bd_addr, BT_MAP_RSP_CONTINUE);
            }
            else
            {
                bt_map_mns_send_event_rsp(event->bd_addr, BT_MAP_RSP_SUCCESS);
            }
        }
        break;

    default:
        break;
    }
}

void app_map_demo_init(void)
{
    int32_t ret = 0;

    bt_sdp_record_add((void *)map_mce_sdp_record);

    if (bt_map_init(RFC_MAP_MNS_CHANN_NUM, L2CAP_MAP_MNS_PSM, 0x0000024F) == false)
    {
        ret = -1;
        goto fail_init;
    }

    bt_mgr_cback_register(app_map_demo_cback);

    return;

fail_init:
    APP_PRINT_ERROR1("app_map_demo_init: failed %d", ret);
}

bool app_map_demo_connect(uint8_t *bd_addr)
{
    T_BT_SDP_UUID_DATA uuid;

    uuid.uuid_16 = UUID_MSG_ACCESS_SERVER;

    return bt_sdp_discov_start(bd_addr, BT_SDP_UUID16, uuid);
}

bool app_map_demo_disconnect(uint8_t *bd_addr)
{
    T_APP_MAP_DEMO_LINK *p_link;

    p_link = app_map_demo_find_link(bd_addr);
    if (p_link != NULL)
    {
        return bt_map_mas_disconnect_req(bd_addr);
    }

    return false;
}

bool app_map_demo_msg_notification_set(uint8_t *bd_addr, bool enable)
{
    T_APP_MAP_DEMO_LINK *p_link;

    p_link = app_map_demo_find_link(bd_addr);
    if (p_link != NULL)
    {
        return bt_map_mas_msg_notification_set(bd_addr, enable);
    }

    return false;
}

bool app_map_demo_folder_set(uint8_t *bd_addr, uint8_t folder)
{
    T_APP_MAP_DEMO_LINK *p_link;

    p_link = app_map_demo_find_link(bd_addr);
    if (p_link != NULL)
    {
        return bt_map_mas_folder_set(bd_addr, (T_BT_MAP_FOLDER)folder);
    }

    return false;
}

bool app_map_demo_folder_listing_get(uint8_t *bd_addr)
{
    T_APP_MAP_DEMO_LINK *p_link;

    p_link = app_map_demo_find_link(bd_addr);
    if (p_link != NULL)
    {
        return bt_map_mas_folder_listing_get(bd_addr, 10, 0);
    }

    return false;
}

bool app_map_demo_msg_listing_get(uint8_t *bd_addr)
{
    T_APP_MAP_DEMO_LINK *p_link;

    p_link = app_map_demo_find_link(bd_addr);
    if (p_link != NULL)
    {
        //NULL terminated UNICODE : inbox
        uint8_t map_path_inbox[12] =
        {
            0x00, 0x69, 0x00, 0x6e, 0x00, 0x62, 0x00, 0x6f, 0x00, 0x78, 0x00, 0x00
        };

        return bt_map_mas_msg_listing_get(bd_addr, map_path_inbox, sizeof(map_path_inbox), 20, 0);
    }

    return false;
}
```

## src/app_bt_map_demo.h
```c
/*
 * Copyright (c) 2026, Realtek Semiconductor Corporation
 *
 * SPDX-License-Identifier: LicenseRef-Realtek-5-Clause
 */

#ifndef _APP_BT_MAP_H_
#define _APP_BT_MAP_H_

#ifdef __cplusplus
extern "C" {
#endif /* __cplusplus */

/** @defgroup APP_BT_MAP BT MAP
* @brief APP BT MAP
* @{
*/

/*============================================================================*
 *                         Functions
 *============================================================================*/
/** @defgroup APP_BT_MAP_Exported_Functions BT MAP Exported Functions
  * @brief
  * @{
  */

/**
    * @brief  MAP init
    * @param  void
    * @return void
    */
void app_map_demo_init(void);

bool app_map_demo_connect(uint8_t *bd_addr);

bool app_map_demo_disconnect(uint8_t *bd_addr);

bool app_map_demo_msg_notification_set(uint8_t *bd_addr, bool enable);

bool app_map_demo_folder_set(uint8_t *bd_addr, uint8_t folder);

bool app_map_demo_folder_listing_get(uint8_t *bd_addr);

bool app_map_demo_msg_listing_get(uint8_t *bd_addr);

/** @} End of APP_BT_MAP_Exported_Functions */

/** @} End of APP_BT_MAP */

#ifdef __cplusplus
}
#endif /* __cplusplus */

#endif /* _APP_BT_MAP_H_ */
```

## src/app_bt_map_demo_console.c
```c
/*
 * Copyright (c) 2026, Realtek Semiconductor Corporation
 *
 * SPDX-License-Identifier: LicenseRef-Realtek-5-Clause
 */

#include <stdio.h>
#include <stdlib.h>
#include <stdint.h>
#include <stdbool.h>
#include <string.h>
#include "trace.h"
#include "os_mem.h"
#include "cli.h"
#include "bt_types.h"
#include "app_io_msg.h"
#include "app_bt_map_demo_console.h"

bool app_map_demo_send_msg(T_IO_CONSOLE subtype, void *param_buf)
{
    T_IO_MSG msg;

    msg.type    = IO_MSG_TYPE_CONSOLE;
    msg.subtype = subtype;
    msg.u.buf   = param_buf;

    return app_io_send_msg(&msg);
}

bool console_map(const char *cmd_str, char *buf, size_t buf_len)
{
    char       *subcmd;
    char       *p_param;
    int32_t     param_num;
    uint32_t    param_len;
    uint8_t     action;
    uint8_t     folder = 0;
    uint8_t     addr[6];
    uint8_t     i;
    void       *param_buf;

    param_num = cli_param_num_get(cmd_str);
    if (param_num < 1)
    {
        subcmd = (char *)cmd_str;
        goto err;
    }

    subcmd = (char *)cli_param_get(cmd_str, 1, &param_len);
    subcmd[param_len] = '\0';

    if (!strcmp(subcmd, "connect"))
    {
        if (param_num != 7)
        {
            goto err;
        }

        p_param = subcmd + param_len + 1;

        for (i = 0; i < 6; i++)
        {
            addr[i] = (uint8_t)strtol(cli_param_get(p_param, i, &param_len), NULL, 0);
        }

        action = MAP_DEMO_ACTION_CONNECT;
    }
    else if (!strcmp(subcmd, "disconnect"))
    {
        action = MAP_DEMO_ACTION_DISCONNECT;
    }
    else if (!strcmp(subcmd, "mns_on"))
    {
        action = MAP_DEMO_ACTION_MNS_ON;
    }
    else if (!strcmp(subcmd, "mns_off"))
    {
        action = MAP_DEMO_ACTION_MNS_OFF;
    }
    else if (!strcmp(subcmd, "set_folder"))
    {
        if (param_num != 2)
        {
            goto err;
        }

        p_param = subcmd + param_len + 1;

        folder = (uint8_t)strtol(cli_param_get(p_param, 0, &param_len), NULL, 0);

        action = MAP_DEMO_ACTION_SET_FOLDER;
    }
    else if (!strcmp(subcmd, "get_folder_listing"))
    {
        action = MAP_DEMO_ACTION_GET_FOLDER_LISTING;
    }
    else if (!strcmp(subcmd, "get_msg_listing"))
    {
        action = MAP_DEMO_ACTION_GET_MSG_LISTING;
    }
    else if (!strcmp(subcmd, "get_msg"))
    {
        action = MAP_DEMO_ACTION_GET_MSG;
    }
    else
    {
        goto err;
    }

    param_buf = malloc(40);
    if (param_buf != NULL)
    {
        uint8_t    *p;

        p = param_buf;
        LE_UINT16_TO_STREAM(p, MAP_ID);
        LE_UINT8_TO_STREAM(p, action);
        if (action == MAP_DEMO_ACTION_CONNECT)
        {
            ARRAY_TO_STREAM(p, addr, 6);
        }
        else if (action == MAP_DEMO_ACTION_SET_FOLDER)
        {
            LE_UINT8_TO_STREAM(p, folder);
        }

        if (app_map_demo_send_msg(IO_MSG_CONSOLE_STRING_RX, param_buf) == false)
        {
            free(param_buf);
            goto err;
        }

        snprintf(buf, buf_len, "MAP %s from map demo.\r\n", subcmd);
    }

    return false;

err:
    snprintf(buf, buf_len, "Invalid param %s (map connect/disconnect).\r\n", subcmd);
    return false;
}

static T_CLI_CMD map_demo_cmd =
{
    NULL,           /* Next command pointed to NULL. */
    NULL,           /* Next subcommand. */
    "map",          /* The command string to type. */
    "\r\nmap:\r\n map demo start\r\n\r\n",
    console_map,    /* The function to run. */
    -1              /* Zero or more parameters are expected. */
};

void app_map_demo_cmd_register(void)
{
    cli_cmd_register(&map_demo_cmd);
}
```

## src/app_bt_map_demo_console.h
```c
/*
 * Copyright (c) 2026, Realtek Semiconductor Corporation
 *
 * SPDX-License-Identifier: LicenseRef-Realtek-5-Clause
 */

#ifndef _MAP_DEMO_CONSOLE_H_
#define _MAP_DEMO_CONSOLE_H_

#ifdef __cplusplus
extern "C" {
#endif /* __cplusplus */

/** @defgroup APP_MAP_DEMO_CONSOLE MAP Demo Console
* @brief MAP Demo command
* @{
*/

typedef enum
{
    GAP_LEGACY_ID         = 0x0001,
    MAP_ID               = 0x0002,
} T_MAP_DEMO_CMD_ID;

#define MAP_DEMO_ACTION_CONNECT             0x01
#define MAP_DEMO_ACTION_DISCONNECT          0x02
#define MAP_DEMO_ACTION_MNS_ON              0x03
#define MAP_DEMO_ACTION_MNS_OFF             0x04
#define MAP_DEMO_ACTION_SET_FOLDER          0x05
#define MAP_DEMO_ACTION_GET_FOLDER_LISTING  0x06
#define MAP_DEMO_ACTION_GET_MSG_LISTING     0x07
#define MAP_DEMO_ACTION_GET_MSG             0x08

void app_map_demo_cmd_register(void);

/** @} End of APP_MAP_DEMO_CONSOLE */

#ifdef __cplusplus
}
#endif /* __cplusplus */

#endif /* _MAP_DEMO_CONSOLE_H_ */
```

## src/app_bt_map_demo_gap.c
```c
/*
 * Copyright (c) 2026, Realtek Semiconductor Corporation
 *
 * SPDX-License-Identifier: LicenseRef-Realtek-5-Clause
 */

#include <string.h>
#include "trace.h"
#include "console.h"
#include "btm.h"
#include "gap_br.h"
#include "bt_bond.h"
#include "app_bt_map_demo_link.h"
#include "app_bt_map_demo_gap.h"

static void app_map_demo_gap_bt_cback(T_BT_EVENT event_type, void *event_buf, uint16_t buf_len)
{
    T_BT_EVENT_PARAM *param = event_buf;
    T_APP_MAP_DEMO_LINK *p_link;
    bool handle = true;

    switch (event_type)
    {
    case BT_EVENT_READY:
        break;

    case BT_EVENT_ACL_CONN_IND:
        {
            p_link = app_map_demo_find_link(param->acl_conn_ind.bd_addr);
            if (p_link != NULL)
            {
                bt_acl_conn_reject(param->acl_conn_ind.bd_addr, BT_ACL_REJECT_UNACCEPTABLE_ADDR);
            }
            else
            {
                bt_acl_conn_accept(param->acl_conn_ind.bd_addr, BT_LINK_ROLE_SLAVE);
            }

            gap_br_set_radio_mode(GAP_RADIO_MODE_NONE_DISCOVERABLE, false, 0);
        }
        break;

    case BT_EVENT_LINK_KEY_REQ:
        {
            uint8_t link_key[16];
            T_BT_LINK_KEY_TYPE type;

            if (bt_bond_key_get(param->link_key_req.bd_addr, link_key, (uint8_t *)&type))
            {
                bt_link_key_cfm(param->link_key_req.bd_addr, true, type, link_key);
            }
            else
            {
                bt_link_key_cfm(param->link_key_req.bd_addr, false, type, link_key);
            }
        }
        break;

    case BT_EVENT_LINK_PIN_CODE_REQ:
        {
            uint8_t pin_code[4] = {1, 2, 3, 4};
            bt_link_pin_code_cfm(param->link_pin_code_req.bd_addr, pin_code, 4, true);
        }
        break;

    case BT_EVENT_LINK_USER_CONFIRMATION_REQ:
        {
            gap_br_user_cfm_req_cfm(param->link_user_confirmation_req.bd_addr, GAP_CFM_CAUSE_ACCEPT);
        }
        break;

    case BT_EVENT_ACL_CONN_SUCCESS:
        {
            app_map_demo_alloc_link(param->acl_conn_success.bd_addr);
        }
        break;

    case BT_EVENT_ACL_CONN_DISCONN:
        {
            p_link = app_map_demo_find_link(param->acl_conn_disconn.bd_addr);
            if (p_link != NULL)
            {
                app_map_demo_free_link(p_link);
            }
        }
        break;

    default:
        handle = false;
        break;
    }

    if (handle == true)
    {
        APP_PRINT_INFO1("app_map_demo_gap_bt_cback: event_type 0x%04x", event_type);
    }
}

void app_map_demo_gap_init(void)
{
    bt_mgr_cback_register(app_map_demo_gap_bt_cback);
}
```

## src/app_bt_map_demo_gap.h
```c
/*
 * Copyright (c) 2026, Realtek Semiconductor Corporation
 *
 * SPDX-License-Identifier: LicenseRef-Realtek-5-Clause
 */

#ifndef _MAP_DEMO_GAP_H_
#define _MAP_DEMO_GAP_H_

#ifdef __cplusplus
extern "C" {
#endif /* __cplusplus */

/** @defgroup MAP_DEMO_GAP MAP Demo Gap
  * @brief MAP Demo Gap
  * @{
  */

/*============================================================================*
 *                              Functions
 *============================================================================*/
void app_map_demo_gap_init(void);

/** @} End of MAP_DEMO_GAP_Exported_Functions */

/** @} End of MAP_DEMO_GAP */

#ifdef __cplusplus
}
#endif /* __cplusplus */

#endif /* _MAP_DEMO_GAP_H_ */
```

## src/app_bt_map_demo_link.c
```c
/*
 * Copyright (c) 2026, Realtek Semiconductor Corporation
 *
 * SPDX-License-Identifier: LicenseRef-Realtek-5-Clause
 */

#include <string.h>
#include "app_bt_map_demo_link.h"

T_APP_MAP_DEMO_APP_DB app_db;

T_APP_MAP_DEMO_LINK *app_map_demo_find_link(uint8_t *bd_addr)
{
    T_APP_MAP_DEMO_LINK *p_link = NULL;
    uint8_t          i;

    if (bd_addr != NULL)
    {
        for (i = 0; i < APP_MAP_DEMO_MAX_BR_LINK_NUM; i++)
        {
            if (app_db.br_link[i].used == true &&
                !memcmp(app_db.br_link[i].bd_addr, bd_addr, 6))
            {
                p_link = &app_db.br_link[i];
                break;
            }
        }
    }

    return p_link;
}

T_APP_MAP_DEMO_LINK *app_map_demo_alloc_link(uint8_t *bd_addr)
{
    T_APP_MAP_DEMO_LINK *p_link = NULL;
    uint8_t        i;

    if (bd_addr != NULL)
    {
        for (i = 0; i < APP_MAP_DEMO_MAX_BR_LINK_NUM; i++)
        {
            if (app_db.br_link[i].used == false)
            {
                p_link = &app_db.br_link[i];

                p_link->used = true;
                p_link->id   = i;
                memcpy(p_link->bd_addr, bd_addr, 6);
                break;
            }
        }
    }

    return p_link;
}

bool app_map_demo_free_link(T_APP_MAP_DEMO_LINK *p_link)
{
    if (p_link != NULL)
    {
        if (p_link->used == true)
        {
            memset(p_link, 0, sizeof(T_APP_MAP_DEMO_LINK));
            return true;
        }
    }

    return false;
}
```

## src/app_bt_map_demo_link.h
```c
/*
 * Copyright (c) 2026, Realtek Semiconductor Corporation
 *
 * SPDX-License-Identifier: LicenseRef-Realtek-5-Clause
 */

#ifndef _APP_MAP_DEMO_LINK_H_
#define _APP_MAP_DEMO_LINK_H_

#include <stdint.h>
#include <stdbool.h>

#ifdef __cplusplus
extern "C" {
#endif /* __cplusplus */

/** @defgroup APP_MAP_DEMO_LINK BT Audio APP Link
  * @brief BT Audio APP Link
  * @{
  */

/*============================================================================*
 *                         Macros
 *============================================================================*/
/** @addtogroup APP_MAP_DEMO_LINK_Exported_Macros BT Audio Link Macros
  * @brief
  * @{
  */

/** @brief  Define links number. range: 0-4 */
#define APP_MAP_DEMO_MAX_BR_LINK_NUM                 4

/** End of APP_MAP_DEMO_LINK_Exported_Macros
* @}
*/

/*============================================================================*
 *                         Types
 *============================================================================*/
/** @defgroup APP_MAP_DEMO_LINK_Exported_Types BT Audio Link Types
  * @brief
  * @{
  */

/**  @brief  APP's Bluetooth BR/EDR link connection database */
typedef struct
{
    uint8_t             bd_addr[6];
    bool                used;
    uint8_t             id;
} T_APP_MAP_DEMO_LINK;

/**  @brief  App define global app data structure */
typedef struct
{
    T_APP_MAP_DEMO_LINK  br_link[APP_MAP_DEMO_MAX_BR_LINK_NUM];
    uint8_t                 a2dp_role;
    uint8_t                 hfp_role;
    uint8_t                 remote_addr[6];
} T_APP_MAP_DEMO_APP_DB;
/** End of APP_MAP_DEMO_LINK_Exported_Types
* @}
*/

extern T_APP_MAP_DEMO_APP_DB app_db;

/*============================================================================*
 *                         Functions
 *============================================================================*/
/** @defgroup APP_MAP_DEMO_LINK_Exported_Functions BT Audio Link Exported Functions
  * @brief
  * @{
  */

/**
 * @brief     Find the APP SPP data instance with Remote BT address.
 * @param[in] bd_addr Remote BT address.
 * @return    APP SPP data instance. If returned handle is NULL, the APP SPP
 *            data instance was failed to create.
 */
T_APP_MAP_DEMO_LINK *app_map_demo_find_link(uint8_t *bd_addr);

/**
 * @brief     Allocate the APP SPP data instance with Remote BT address.
 * @param[in] bd_addr Remote BT address.
 * @return    APP SPP data instance. If returned handle is NULL, the APP SPP
 *            data instance was failed to create.
 */
T_APP_MAP_DEMO_LINK *app_map_demo_alloc_link(uint8_t *bd_addr);

/**
 * @brief     Free the APP SPP data instance with Remote BT address.
 * @param[in] bd_addr Remote BT address.
 * @return    APP SPP data instance. If returned handle is NULL, the APP SPP
 *            data instance was failed to create.
 */
bool app_map_demo_free_link(T_APP_MAP_DEMO_LINK *p_link);

/** @} End of APP_MAP_DEMO_LINK_Exported_Functions */

/** @} End of APP_MAP_DEMO_LINK */

#ifdef __cplusplus
}
#endif /* __cplusplus */

#endif /* _APP_MAP_DEMO_LINK_H_ */
```

## src/app_bt_map_demo_main.c
```c
/*
 * Copyright (c) 2026, Realtek Semiconductor Corporation
 *
 * SPDX-License-Identifier: LicenseRef-Realtek-5-Clause
 */

#include "rtl876x_pinmux.h"
#include "rtl876x_uart.h"
#include "trace.h"
#include "os_task.h"
#include "os_mem.h"
#include "os_sched.h"
#include "os_msg.h"
#include "gap.h"
#include "gap_br.h"
#include "btm.h"
#include "sysm.h"
#include "remote.h"
#include "app_msg.h"
#include "app_io_msg.h"
#include "hrp_uart.h"
#include "app_bt_map_demo_console.h"
#include "app_bt_map_demo_gap.h"
#include "app_bt_map_demo.h"

/** @defgroup  MAP_DEMO_MAIN MAP Demo Main
    * @brief Main file to initialize hardware and BT stack and start task scheduling
    * @{
    */

#define MAP_DEMO_UART_TX          P3_1
#define MAP_DEMO_UART_RX          P3_0

#define MAP_DEMO_DEFAULT_PAGESCAN_WINDOW             0x12
#define MAP_DEMO_DEFAULT_PAGESCAN_INTERVAL           0x800 //0x800
#define MAP_DEMO_DEFAULT_PAGE_TIMEOUT                0x4000
#define MAP_DEMO_DEFAULT_SUPVISIONTIMEOUT            0x1f40 //0x7D00
#define MAP_DEMO_DEFAULT_INQUIRYSCAN_WINDOW          0x12
#define MAP_DEMO_DEFAULT_INQUIRYSCAN_INTERVAL        0x800 //0x1000

#define MAP_DEMO_MAX_NUMBER_OF_GAP_MESSAGE     0x20      //!<  GAP message queue size
#define MAP_DEMO_MAX_NUMBER_OF_IO_MESSAGE      0x20      //!<  IO message queue size
#define MAP_DEMO_MAX_NUMBER_OF_EVENT_MESSAGE   (MAP_DEMO_MAX_NUMBER_OF_GAP_MESSAGE + MAP_DEMO_MAX_NUMBER_OF_IO_MESSAGE)    //!< Event message queue size

#define CONSOLE_UART_RX_BUFFER_SIZE         300

static uint8_t bd_addr_dut[6]  = {0x13, 0x22, 0x56, 0x77, 0x88, 0x66};

void *map_demo_evt_queue_handle;  //!< Event queue handle
void *map_demo_io_queue_handle;   //!< IO queue handle

/*============================================================================*
 *                              Functions
 *============================================================================*/
/**
  * @brief  Initialize gap bond manager related parameters
  * @return void
  */
static void app_bt_gap_init(void)
{
    uint32_t class_of_device = (uint32_t)(0x18 | (0x04 << 8) | (0x24 << 16));
    uint16_t supervision_timeout = MAP_DEMO_DEFAULT_SUPVISIONTIMEOUT;

    uint16_t link_policy = GAP_LINK_POLICY_ROLE_SWITCH | GAP_LINK_POLICY_SNIFF_MODE;

    uint8_t radio_mode = GAP_RADIO_MODE_VISIBLE_CONNECTABLE;
    bool limited_discoverable = false;
    bool auto_accept_acl = false;

    uint8_t pagescan_type = GAP_RADIO_MODE_VISIBLE_CONNECTABLE;
    uint16_t pagescan_interval = MAP_DEMO_DEFAULT_PAGESCAN_INTERVAL;
    uint16_t pagescan_window = MAP_DEMO_DEFAULT_PAGESCAN_WINDOW;
    uint16_t page_timeout = MAP_DEMO_DEFAULT_PAGE_TIMEOUT;

    uint8_t inquiryscan_type = GAP_INQUIRY_SCAN_TYPE_STANDARD;
    uint16_t inquiryscan_window = MAP_DEMO_DEFAULT_INQUIRYSCAN_WINDOW;
    uint16_t inquiryscan_interval = MAP_DEMO_DEFAULT_INQUIRYSCAN_INTERVAL;
    uint8_t inquiry_mode = GAP_INQUIRY_MODE_EXTENDED_RESULT;

    uint8_t pair_mode = GAP_PAIRING_MODE_PAIRABLE;
    uint16_t auth_flags = GAP_AUTHEN_BIT_GENERAL_BONDING_FLAG | GAP_AUTHEN_BIT_SC_FLAG;
    uint8_t io_cap = GAP_IO_CAP_NO_INPUT_NO_OUTPUT;
    uint8_t oob_enable = false;
    uint8_t bt_mode = GAP_BT_MODE_21ENABLED;

    gap_lib_init();

    gap_set_param(GAP_PARAM_BOND_PAIRING_MODE, sizeof(uint8_t), &pair_mode);
    gap_set_param(GAP_PARAM_BOND_AUTHEN_REQUIREMENTS_FLAGS, sizeof(uint16_t), &auth_flags);
    gap_set_param(GAP_PARAM_BOND_IO_CAPABILITIES, sizeof(uint8_t), &io_cap);
    gap_set_param(GAP_PARAM_BOND_OOB_ENABLED, sizeof(uint8_t), &oob_enable);

    gap_br_set_param(GAP_BR_PARAM_BT_MODE, sizeof(uint8_t), &bt_mode);
    gap_br_set_param(GAP_BR_PARAM_COD, sizeof(uint32_t), &class_of_device);
    gap_br_set_param(GAP_BR_PARAM_LINK_POLICY, sizeof(uint16_t), &link_policy);
    gap_br_set_param(GAP_BR_PARAM_SUPV_TOUT, sizeof(uint16_t), &supervision_timeout);
    gap_br_set_param(GAP_BR_PARAM_AUTO_ACCEPT_ACL, sizeof(bool), &auto_accept_acl);

    gap_br_set_param(GAP_BR_PARAM_RADIO_MODE, sizeof(uint8_t), &radio_mode);
    gap_br_set_param(GAP_BR_PARAM_LIMIT_DISCOV, sizeof(bool), &limited_discoverable);

    gap_br_set_param(GAP_BR_PARAM_PAGE_SCAN_TYPE, sizeof(uint8_t), &pagescan_type);
    gap_br_set_param(GAP_BR_PARAM_PAGE_SCAN_INTERVAL, sizeof(uint16_t), &pagescan_interval);
    gap_br_set_param(GAP_BR_PARAM_PAGE_SCAN_WINDOW, sizeof(uint16_t), &pagescan_window);
    gap_br_set_param(GAP_BR_PARAM_PAGE_TIMEOUT, sizeof(uint16_t), &page_timeout);

    gap_br_set_param(GAP_BR_PARAM_INQUIRY_SCAN_TYPE, sizeof(uint8_t), &inquiryscan_type);
    gap_br_set_param(GAP_BR_PARAM_INQUIRY_SCAN_INTERVAL, sizeof(uint16_t), &inquiryscan_interval);
    gap_br_set_param(GAP_BR_PARAM_INQUIRY_SCAN_WINDOW, sizeof(uint16_t), &inquiryscan_window);
    gap_br_set_param(GAP_BR_PARAM_INQUIRY_MODE, sizeof(uint8_t), &inquiry_mode);

    gap_set_bd_addr(bd_addr_dut);
    gap_br_set_param(GAP_BR_PARAM_NAME, GAP_DEVICE_NAME_LEN, "map demo dut");
}

/**
 * @brief    Contains the initialization of framework
 * @return   void
 */
static void framework_init(void)
{
    /* System Manager */
    sys_mgr_init(map_demo_evt_queue_handle);

    /* RemoteController Manager */
    remote_mgr_init(REMOTE_SESSION_ROLE_SINGLE);

    /* Bluetooth Manager */
    bt_mgr_init();
}

/**
 * @brief    Contains the initialization of peripherals
 * @note     Both new architecture driver and legacy driver initialization method can be used
 * @return   void
 */
static void driver_init(void)
{
    T_CONSOLE_PARAM console_param;
    T_CONSOLE_OP    console_op;

    console_param.tx_buf_size   = 512;
    console_param.rx_buf_size   = 512;
    console_param.tx_wakeup_pin = 0;
    console_param.rx_wakeup_pin = 0;

    console_op.init = hrp_uart_init;
    console_op.tx_wakeup_enable = NULL; //console_uart_tx_wakeup_enable;
    console_op.rx_wakeup_enable = NULL; //console_uart_rx_wakeup_enable;
    console_op.write = hrp_uart_tx;
    console_op.wakeup = NULL;

    console_init(&console_param, &console_op);
    console_set_mode(CONSOLE_MODE_STRING);
}

/**
 * @brief        App task to handle events & messages
 * @param[in]    p_param    Parameters sending to the task
 * @return       void
 */
void map_demo_main_task(void *p_param)
{
    uint8_t event;

    gap_start_bt_stack(map_demo_evt_queue_handle, map_demo_io_queue_handle,
                       MAP_DEMO_MAX_NUMBER_OF_GAP_MESSAGE);

    while (true)
    {
        if (os_msg_recv(map_demo_evt_queue_handle, &event, 0xFFFFFFFF) == true)
        {
            if (EVENT_GROUP(event) == EVENT_GROUP_IO)
            {
                T_IO_MSG io_msg;

                if (os_msg_recv(map_demo_io_queue_handle, &io_msg, 0) == true)
                {
                    if (event == EVENT_IO_TO_APP)
                    {
                        app_io_handle_msg(io_msg);
                    }
                }
            }
            else if (EVENT_GROUP(event) == EVENT_GROUP_STACK)
            {
                gap_handle_msg(event);
            }
            else if (EVENT_GROUP(event) == EVENT_GROUP_FRAMEWORK)
            {
                sys_mgr_event_handle(event);
            }
        }
    }
}

/**
 * @brief    Contains the initialization of all tasks
 * @note     There is only one task in MAP Demo APP, thus only one APP task is init here
 * @return   void
 */
void task_init(void)
{
    void *app_task_handle;

    os_msg_queue_create(&map_demo_io_queue_handle, "ioQ", MAP_DEMO_MAX_NUMBER_OF_IO_MESSAGE,
                        sizeof(T_IO_MSG));
    os_msg_queue_create(&map_demo_evt_queue_handle, "evtQ", MAP_DEMO_MAX_NUMBER_OF_EVENT_MESSAGE,
                        sizeof(unsigned char));

    os_task_create(&app_task_handle, "map_demo_main_task", map_demo_main_task, NULL, 1024 * 3, 1);
}

/**
 * @brief    Entry of APP code
 * @return   int (To avoid compile warning)
 */
int main(void)
{
    driver_init();
    task_init();
    framework_init();
    app_bt_gap_init();
    app_map_demo_init();
    app_map_demo_gap_init();
    app_map_demo_cmd_register();

    os_sched_start();

    return 0;
}
/** @} */ /* End of group MAP_DEMO_MAIN */
```

## src/app_console_msg.c
```c
/*
 * Copyright (c) 2026, Realtek Semiconductor Corporation
 *
 * SPDX-License-Identifier: LicenseRef-Realtek-5-Clause
 */

#include <string.h>
#include "trace.h"
#include "bt_types.h"
#include "os_mem.h"
#include "app_msg.h"
#include "app_console_msg.h"
#include "app_bt_map_demo_link.h"
#include "app_bt_map_demo_console.h"
#include "app_bt_map_demo.h"

void app_console_handle_msg(T_IO_MSG console_msg)
{
    uint16_t  subtype;
    uint16_t  id;
    uint16_t  action;
    uint8_t  *p;

    p       = console_msg.u.buf;
    subtype = console_msg.subtype;

    switch (subtype)
    {
    case IO_MSG_CONSOLE_STRING_RX:
        LE_STREAM_TO_UINT16(id, p);
        LE_STREAM_TO_UINT8(action, p);

        if (id == GAP_LEGACY_ID)
        {

        }
        else if (id == MAP_ID)
        {
            switch (action)
            {
            case MAP_DEMO_ACTION_CONNECT:
                {
                    memcpy(app_db.remote_addr, p, 6);
                    app_map_demo_connect(app_db.remote_addr);
                }
                break;

            case MAP_DEMO_ACTION_DISCONNECT:
                app_map_demo_disconnect(app_db.remote_addr);
                break;

            case MAP_DEMO_ACTION_MNS_ON:
                app_map_demo_msg_notification_set(app_db.remote_addr, true);
                break;

            case MAP_DEMO_ACTION_MNS_OFF:
                app_map_demo_msg_notification_set(app_db.remote_addr, false);
                break;

            case MAP_DEMO_ACTION_SET_FOLDER:
                {
                    uint8_t folder;

                    LE_STREAM_TO_UINT8(folder, p);
                    app_map_demo_folder_set(app_db.remote_addr, folder);
                }
                break;

            case MAP_DEMO_ACTION_GET_FOLDER_LISTING:
                app_map_demo_folder_listing_get(app_db.remote_addr);
                break;

            case MAP_DEMO_ACTION_GET_MSG_LISTING:
                app_map_demo_msg_listing_get(app_db.remote_addr);
                break;

            case MAP_DEMO_ACTION_GET_MSG:
                break;

            default:
                break;
            }
        }

        os_mem_free(console_msg.u.buf);
        break;

    default:
        break;
    }
}
```

## src/app_dlps.c
```c
/*
 * Copyright (c) 2026, Realtek Semiconductor Corporation
 *
 * SPDX-License-Identifier: LicenseRef-Realtek-5-Clause
 */

#include "trace.h"
#include "pm.h"
#include "io_dlps.h"
#include "section.h"
#include "rtl876x_uart.h"

static uint32_t dlps_bitmap;

RAM_TEXT_SECTION void app_dlps_enable(uint32_t bit)
{
    if (dlps_bitmap & bit)
    {
        APP_PRINT_TRACE3("app_dlps_enable: %08x %08x -> %08x", bit, dlps_bitmap,
                         (dlps_bitmap & ~bit));
    }
    dlps_bitmap &= ~bit;
}

RAM_TEXT_SECTION void app_dlps_disable(uint32_t bit)
{
    if ((dlps_bitmap & bit) == 0)
    {
        APP_PRINT_TRACE3("app_dlps_disable: %08x %08x -> %08x", bit, dlps_bitmap,
                         (dlps_bitmap | bit));
    }

    dlps_bitmap |= bit;
}

RAM_TEXT_SECTION bool app_dlps_check_callback(void)
{

    static uint16_t dlps_bitmap_pre;
    bool dlps_enter_en = false;
    if (dlps_bitmap == 0)
    {
        dlps_enter_en = true;
    }

    if (dlps_bitmap_pre != dlps_bitmap)
    {
        APP_PRINT_WARN2("app_dlps_check_callback: dlps_bitmap_pre 0x%x dlps_bitmap 0x%x", dlps_bitmap_pre,
                        dlps_bitmap);
    }
    dlps_bitmap_pre = dlps_bitmap;

    return dlps_enter_en;
}

/**
    * @brief   Need to handle message in this callback function,when App enter dlps mode
    * @param  void
    * @return void
    */
RAM_TEXT_SECTION void app_dlps_enter_callback(void)
{
    POWERMode lps_mode = power_mode_get();

    DBG_DIRECT("app_dlps_enter_callback: lps_mode %d", lps_mode);
}

RAM_TEXT_SECTION void app_dlps_exit_callback(void)
{

}

void app_dlps_init(void)
{
    /* register of call back function */
    power_check_cb_register(app_dlps_check_callback);

    power_stage_cb_register(app_dlps_enter_callback, POWER_STAGE_STORE);
    power_stage_cb_register(app_dlps_exit_callback, POWER_STAGE_RESTORE);
}
```

## src/app_flags.h
```c
/*
 * Copyright (c) 2026, Realtek Semiconductor Corporation
 *
 * SPDX-License-Identifier: LicenseRef-Realtek-5-Clause
 */

#ifndef _APP_FLAGS_H_
#define _APP_FLAGS_H_

/** @defgroup  BT_AUDIO_Config App Configuration
    * @brief This file is used to config app functions.
    * @{
    */
/*============================================================================*
 *                              Constants
 *============================================================================*/

/** @} */ /* End of group BT_AUDIO_Config */

#endif
```
