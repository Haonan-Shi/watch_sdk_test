## CMakeLists.txt
```
#
# Copyright (c) 2026, Realtek Semiconductor Corporation
#
# SPDX-License-Identifier: LicenseRef-Realtek-5-Clause
#

message(STATUS "CMAKELIST FOLDER: ${CMAKE_CURRENT_SOURCE_DIR}")

cmake_minimum_required(VERSION 3.20.0)

#===========version generation===========
include(${CMAKE_CURRENT_SOURCE_DIR}/../../cmake/version_generate.cmake)
generate_version()
#===========version generation===========
#===========post build===========
# post build should be called before find_package
include(${CMAKE_CURRENT_SOURCE_DIR}/../../cmake/post_build.cmake)
rtk_post_build()
#===========post build===========

find_package(Zephyr REQUIRED HINTS $ENV{ZEPHYR_BASE})
project(bt_iap_demo)

FILE(GLOB app_sources src/*.c)
target_sources(app PRIVATE
  ${app_sources}
  )

set(sources
    ${ZEPHYR_REALTEK_APP_MODULE_DIR}/common/console/transport/console_uart.c
    )

set(headers
    #header files from app
	  src/
    #header files from libs
    ${ZEPHYR_REALTEK_APP_MODULE_DIR}/../modules/hal/realtek/rtl87x3g/subsys/console/inc
    ${ZEPHYR_REALTEK_APP_MODULE_DIR}/common/console/transport
    ${ZEPHYR_REALTEK_APP_MODULE_DIR}/samples/bt_iap_demo
    ) 

foreach(header ${headers})
    if(EXISTS ${header})
        zephyr_include_directories(${header})
    else()
        message(FATAL_ERROR "header file directory does not exist: ${header}. Current cmakelist: ${CMAKE_CURRENT_SOURCE_DIR}")
    endif()
endforeach()

foreach(src ${sources})
    if(EXISTS ${src})
        target_sources(app PRIVATE ${src})
    else()
        message(FATAL_ERROR "source file does not exist: ${src}. Current cmakelist: ${CMAKE_CURRENT_SOURCE_DIR}")
    endif()
endforeach()

target_precompile_headers(app PUBLIC
	          ${CMAKE_CURRENT_SOURCE_DIR}/src/app_flags.h
			  )

target_include_directories(app PRIVATE src)
```

## prj.conf
```kconfig
# nothing here
CONFIG_HEAP_MEM_POOL_SIZE=2048
CONFIG_SERIAL=y
CONFIG_UART_ASYNC_API=y
CONFIG_REALTEK_SUBSYS_SYSM=y
CONFIG_REALTEK_SUBSYS_BTM=y
CONFIG_REALTEK_SUBSYS_CONSOLE=y
CONFIG_REALTEK_SUBSYS_REMOTE=y
CONFIG_REALTEK_SUBSYS_SYSM=y
```

## src/app_bt_iap_demo_app.c
```c
/*
 * Copyright (c) 2026, Realtek Semiconductor Corporation
 *
 * SPDX-License-Identifier: LicenseRef-Realtek-5-Clause
 */

#include <stdlib.h>
#include <string.h>
#include "trace.h"
#include "os_mem.h"
#include "rtl876x_rcc.h"
#include "rtl876x_i2c.h"
#include "platform_utils.h"
#include "bt_types.h"
#include "gap_br.h"
#include "console.h"
#include "btm.h"
#include "bt_sdp.h"
#include "bt_iap.h"
#include "app_bt_iap_demo_sdp.h"
#include "app_bt_iap_demo_app.h"
#include "app_bt_iap_demo_link.h"

#define CP_DEVICE_ADDRESS 0x10

#define MSG_BLUETOOTH_COMPONENT_INFO        0x4E01
#define MSG_START_BT_CONNECTION_UPDATES     0x4E03
#define MSG_BT_CONNECTION_UPDATE            0x4E04
#define MSG_STOP_BT_CONNECTION_UPDATES      0x4E05
#define MSG_START_CALL_STATE_UPDATES        0x4154
#define MSG_CALL_STATE_UPDATE               0x4155
#define MSG_STOP_CALL_STATE_UPDATES         0x4156
#define MSG_START_COMM_UPDATES              0x4157
#define MSG_MUTE_STATUS_UPDATE              0x4160

extern char *local_name;
extern uint8_t local_bd_addr[6];

I2C_TypeDef *p_i2c_cp = I2C0;

uint8_t remote_bd_addr[6];

/** @brief  IAP UUID */
static const T_BT_SDP_UUID_DATA rfcomm_service_uuid16 =
{
    .uuid_16 = UUID_RFCOMM
};

bool iap_demo_conn_start(uint8_t *bd_addr)
{
    APP_PRINT_TRACE0("iap_demo_conn_start");
    if (bt_sdp_discov_start(bd_addr, BT_SDP_UUID16, rfcomm_service_uuid16))
    {
        return true;
    }

    return false;
}

bool iap_demo_disconnect_start(void)
{
    T_IAP_DEMO_LINK *p_link;

    APP_PRINT_TRACE0("iap_demo_disconnect_start");

    p_link = iap_demo_find_link(remote_bd_addr);
    if (p_link != NULL)
    {
        return bt_iap_disconnect_req(remote_bd_addr);
    }

    return false;
}

/**
 * @brief     iAP Tx function for test.
 * @param[in] Remote BT address..
 * @return    void
 */
bool iap_demo_app_tx_data_test(void)
{
    T_IAP_DEMO_LINK *p_link;
    uint8_t iap_tx_data_test[15] = {0x01, 0x02, 0x03, 0x04, 0x05, 0x06, 0x08, 0x09, 0x0a};

    APP_PRINT_TRACE0("iap_demo_app_tx_data_test");
    p_link = iap_demo_find_link(remote_bd_addr);
    if (p_link != NULL)
    {
        if (p_link->session_connected == true)
        {
            char *temp_buff = "iAP Data Sent!\r\n";
            console_write((uint8_t *)temp_buff, strlen(temp_buff));

            return bt_iap_data_send(remote_bd_addr, p_link->session_id, iap_tx_data_test, 15);
        }
    }

    return false;
}

/**
 * @brief     iAP Rx function for test.
 * @param[in] Remote BT address..
 * @param[in] Pointer to iAP Rx buffer.
 * @param[in] iAP Rx buffer length.
 * @return    void
 */
static void iap_demo_app_rx_data_test(uint8_t *bd_addr, uint8_t *buf, uint16_t len)
{
    APP_PRINT_TRACE2("iap_demo_app_rx_data_test: bd_addr %s len %d", TRACE_BDADDR(bd_addr), len);
    for (uint16_t i = 0; i < len; i++)
    {
        APP_PRINT_TRACE2("iap_demo_app_rx_data_test: buf[i:%d] 0x%x", i, buf[i]);
    }

#if F_DLPS_EN
    bt_sniff_mode_enable(bd_addr, 784, 816, 0, 0);
#endif
}

void app_iap_cp_hw_init(void)
{
    //initilize GPIO PINs
    I2C_InitTypeDef I2C_InitStructure = {0};

    //Init I2C

    if (p_i2c_cp == I2C0)
    {
        RCC_PeriphClockCmd(APBPeriph_I2C0, APBPeriph_I2C0_CLOCK, ENABLE);
    }

    if (p_i2c_cp == I2C1)
    {
        RCC_PeriphClockCmd(APBPeriph_I2C1, APBPeriph_I2C1_CLOCK, ENABLE);
    }

    /* I2C configuration */
    I2C_StructInit(&I2C_InitStructure);
    I2C_InitStructure.I2C_ClockSpeed = 400000;
    I2C_InitStructure.I2C_DeviveMode = I2C_DeviveMode_Master;
    I2C_InitStructure.I2C_AddressMode = I2C_AddressMode_7BIT;
    I2C_InitStructure.I2C_SlaveAddress = CP_DEVICE_ADDRESS;
    I2C_InitStructure.I2C_Ack = I2C_Ack_Enable;

    /* I2C module Initialize */
    I2C_Init(p_i2c_cp, &I2C_InitStructure);
    /* I2C Peripheral Enable */
    I2C_Cmd(p_i2c_cp, ENABLE);

    I2C_INTConfig(p_i2c_cp, I2C_INT_TX_ABRT, ENABLE);
}

static bool app_iap_cp_check_i2c_flag(uint32_t flag)
{
    FlagStatus flag_status = RESET;
    volatile uint16_t retry_count = 1000;

    while (retry_count)
    {
        flag_status = I2C_GetFlagState(p_i2c_cp, flag);
        if (flag_status == SET)
        {
            //APP_PRINT_TRACE1("app_cp_check_i2c_flag: retry_count %d", retry_count);
            return true;
        }
        else
        {
            retry_count--;
        }
    }

    APP_PRINT_ERROR0("app_iap_cp_check_i2c_flag: 2 CP_CAUSE_TIMEOUT");
    return false;
}

static bool app_iap_cp_write(uint8_t start_addr, uint8_t *data, uint16_t length)
{
    int32_t ret = 0;
    uint8_t no_ack;
    uint16_t i, j;

    APP_PRINT_TRACE0("app_iap_cp_write");

    if (p_i2c_cp == NULL)
    {
        ret = 1;
        goto TAG_END;
    }

    I2C_SetSlaveAddress(p_i2c_cp, CP_DEVICE_ADDRESS);
    j = 100;

    //write device address(W) & start register address
    do
    {
        no_ack = 0;
        if (length == 0)
        {
            p_i2c_cp->IC_DATA_CMD = start_addr | (1 << 9);
        }
        else
        {
            p_i2c_cp->IC_DATA_CMD = start_addr;
        }

        //wait tx fifo empty
        if (app_iap_cp_check_i2c_flag(I2C_FLAG_TFE) == false)
        {
            ret = 2;
            goto TAG_END;
        }

        i = 200; //can not too short!!!!!
        while (1)
        {
            no_ack = I2C_CheckEvent(p_i2c_cp, ABRT_7B_ADDR_NOACK);
            i--;
            if (no_ack == 1 || i == 0)
            {
                break;
            }
        }

        if (no_ack)
        {
            //clear ABRT_7B_ADDR_NOACK bit
            I2C_ClearINTPendingBit(p_i2c_cp, I2C_INT_TX_ABRT);
            //delay min 500us and retry
            platform_delay_us(500);
            j--;
            if (j == 0)
            {
                break;
            }
        }
    }

    while (no_ack);

    //write data
    if (length > 0 && data != NULL)
    {
        while (length > 1)
        {
            p_i2c_cp->IC_DATA_CMD = *data++;
            //wait tx fifo empty
            if (app_iap_cp_check_i2c_flag(I2C_FLAG_TFE) == false)
            {
                ret = 3;
                goto TAG_END;
            }

            length--;
        }

        //stop
        p_i2c_cp->IC_DATA_CMD = ((*data++) | (1 << 9));
        if (app_iap_cp_check_i2c_flag(I2C_FLAG_TFE) == false)
        {
            ret = 4;
            goto TAG_END;
        }

    }

    return true;

TAG_END:
    APP_PRINT_TRACE1("app_iap_cp_write: ret: %d", -ret);
    return false;
}

static bool app_iap_cp_burst_read(uint8_t start_addr, uint8_t *pbuf, uint16_t length)
{
    int32_t ret = 0;
    uint8_t no_ack = 0;
    uint16_t i, j;

    APP_PRINT_TRACE0("app_iap_cp_burst_read");

    if (p_i2c_cp == NULL)
    {
        ret = 1;
        goto TAG_END;
    }

    //write start register address
    if (app_iap_cp_write(start_addr, NULL, 0) == false)
    {
        ret = 2;
        goto TAG_END;
    }

    I2C_SetSlaveAddress(p_i2c_cp, CP_DEVICE_ADDRESS);

    //read command
    j = 100;

    do
    {
        no_ack = 0;
        if (length == 1)
        {
            /* genarate stop signal */
            p_i2c_cp->IC_DATA_CMD = ((0x00) | (1 << 8) | (1 << 9));
        }
        else
        {
            p_i2c_cp->IC_DATA_CMD = (0x00) | (1 << 8);
        }

        //wait tx fifo empty
        if (app_iap_cp_check_i2c_flag(I2C_FLAG_TFE) == false)
        {
            ret = 3;
            goto TAG_END;
        }

        i = 100;
        while (1)
        {
            no_ack = I2C_CheckEvent(p_i2c_cp, ABRT_7B_ADDR_NOACK);
            i--;
            if (no_ack == 1 || i == 0)
            {
                break;
            }
        }

        if (no_ack)
        {
            //clear ABRT_7B_ADDR_NOACK bit
            I2C_ClearINTPendingBit(p_i2c_cp, I2C_INT_TX_ABRT);
            //delay min 500us and retry
            platform_delay_us(500);
            j--;
            if (j == 0)
            {
                break;
            }
        }
    }

    while (no_ack);

    while (length > 1)
    {
        if (length == 2)
        {
            /* genarate stop signal */
            p_i2c_cp->IC_DATA_CMD = ((0x00) | (1 << 8) | (1 << 9));
        }
        else
        {
            p_i2c_cp->IC_DATA_CMD = (0x00) | (1 << 8);
        }

        //wait rx fifo data
        if (app_iap_cp_check_i2c_flag(I2C_FLAG_RFNE) == false)
        {
            ret = 4;
            goto TAG_END;
        }

        *pbuf++ = I2C_ReceiveData(p_i2c_cp);
        length--;
    }

    //wait rx fifo data, last byte
    if (app_iap_cp_check_i2c_flag(I2C_FLAG_RFNE) == false)
    {
        ret = 5;
        goto TAG_END;
    }

    *pbuf++ = (uint8_t)p_i2c_cp->IC_DATA_CMD;

    return true;

TAG_END:
    APP_PRINT_TRACE1("app_iap_cp_burst_read: ret %d", -ret);
    return false;
}

static void app_iap_send_ident_info(uint8_t *bd_addr)
{
    uint8_t *p_buf;
    uint8_t *p;
    uint8_t *p_head;

    p_buf = malloc(300);
    if (p_buf == NULL)
    {
        return;
    }

    APP_PRINT_TRACE1("app_iap_send_ident_info: p_buf %p", p_buf);

    p_head = p_buf;

    p_buf = bt_iap2_prep_param(p_buf, BT_IAP_ID_NAME, local_name, strlen((const char *)local_name) + 1);

    char mudule_identifier[] = "1.0";
    p_buf = bt_iap2_prep_param(p_buf, BT_IAP_ID_MODEL_IDENTIFIER, mudule_identifier,
                               sizeof(mudule_identifier));

    char manufacturer[] = "realtek";
    p_buf = bt_iap2_prep_param(p_buf, BT_IAP_ID_MANUFACTURER, manufacturer, sizeof(manufacturer));

    char serial_num[] = "1.0";
    p_buf = bt_iap2_prep_param(p_buf, BT_IAP_ID_SERIAL_NUMBER, serial_num, sizeof(serial_num));

    char fw_version[6] = "1.0.0";
    p_buf = bt_iap2_prep_param(p_buf, BT_IAP_ID_FIRMWARE_VERSION, fw_version, sizeof(fw_version));

    char hw_version[6] = "2.0.0";
    p_buf = bt_iap2_prep_param(p_buf, BT_IAP_ID_HARDWARE_VERSION, hw_version, sizeof(hw_version));

    uint8_t msg_sent_by_accessory[8];
    p = msg_sent_by_accessory;
    BE_UINT16_TO_STREAM(p, MSG_BLUETOOTH_COMPONENT_INFO);
    BE_UINT16_TO_STREAM(p, MSG_START_BT_CONNECTION_UPDATES);
    BE_UINT16_TO_STREAM(p, MSG_STOP_BT_CONNECTION_UPDATES);
    BE_UINT16_TO_STREAM(p, BT_IAP_MSG_EA_PROTOCOL_SESSION_STATUS);
    //BE_UINT16_TO_STREAM(p, MSG_START_CALL_STATE_UPDATES);
    //BE_UINT16_TO_STREAM(p, MSG_STOP_CALL_STATE_UPDATES);
    //BE_UINT16_TO_STREAM(p, MSG_MUTE_STATUS_UPDATE);
    p_buf = bt_iap2_prep_param(p_buf, BT_IAP_ID_MESSAGES_SENT_BY_ACCESSORY, msg_sent_by_accessory,
                               sizeof(msg_sent_by_accessory));

    uint8_t msg_received_from_device[6];
    p = msg_received_from_device;
    BE_UINT16_TO_STREAM(p, BT_IAP_MSG_START_EA_PROTOCOL_SESSION);
    BE_UINT16_TO_STREAM(p, BT_IAP_MSG_STOP_EA_PROTOCOL_SESSION);
    BE_UINT16_TO_STREAM(p, MSG_BT_CONNECTION_UPDATE);
    //BE_UINT16_TO_STREAM(p, BT_IAP_MSG_EA_PROTOCOL_SESSION_STATUS);
    //BE_UINT16_TO_STREAM(p, MSG_CALL_STATE_UPDATE);
    p_buf = bt_iap2_prep_param(p_buf, BT_IAP_ID_MESSAGES_RECEIVED_FROM_DEVICE, msg_received_from_device,
                               sizeof(msg_received_from_device));

    //ID_POWER_SOURCETYPE
    uint8_t power_source = 0;
    p_buf = bt_iap2_prep_param(p_buf, BT_IAP_ID_POWER_SOURCETYPE, &power_source, sizeof(power_source));

    //ID_MAXIMUM_CURRENT_DRAWN_FROM_DEVICE

    uint16_t max_current_drawn_from_device = 0;
    p_buf = bt_iap2_prep_param(p_buf, BT_IAP_ID_MAXIMUM_CURRENT_DRAWN_FROM_DEVICE,
                               &max_current_drawn_from_device,
                               sizeof(max_current_drawn_from_device));


    //Supported EA protocol group
    {
        uint8_t *p = p_buf;
        p_buf = bt_iap2_prep_param(p_buf, BT_IAP_ID_SUPPORTED_EXTERNAL_ACCESSORY_PROTOCOL, NULL, 0);

        //group : EA_PROTOCOL_ID
        uint8_t ea_protocol_id = EA_PROTOCOL_ID_RTK;
        p_buf = bt_iap2_prep_param(p_buf, BT_IAP_EXT_ACC_PROTOCOL_ID, &ea_protocol_id,
                                   sizeof(ea_protocol_id));

        char ea_protocol_name[] = "com.rtk.datapath";
        p_buf = bt_iap2_prep_param(p_buf, BT_IAP_EXT_ACC_PROTOCOL_NAME, ea_protocol_name,
                                   sizeof(ea_protocol_name));

        //group EA_PROTOCOL_MATCHACTION
        uint8_t ea_protocol_match_action = 0x02;
        p_buf = bt_iap2_prep_param(p_buf, BT_IAP_EXT_ACC_PROTOCOL_MATCHACTION, &ea_protocol_match_action,
                                   sizeof(ea_protocol_match_action));

        //calculate total Length
        uint16_t total_len = p_buf - p;
        BE_UINT16_TO_STREAM(p, total_len);
    }

    //ID_PREFERRED_APP_MATCH_TEAM_ID
    char app_match_team_id[] = "C6P64J2MZX";
    p_buf = bt_iap2_prep_param(p_buf, BT_IAP_ID_PREFERRED_APP_MATCH_TEAM_ID, app_match_team_id,
                               sizeof(app_match_team_id));

    //ID_CURRENT_LANGUAGE
    char current_language[] = "en";
    p_buf = bt_iap2_prep_param(p_buf, BT_IAP_ID_CURRENT_LANGUAGE, current_language,
                               sizeof(current_language));

    //ID_SUPPORTED_LANGUAGE
    char supported_language[] = "en";
    p_buf = bt_iap2_prep_param(p_buf, BT_IAP_ID_SUPPORTED_LANGUAGE, &supported_language,
                               sizeof(supported_language));

    //BT_COMPONENT_ID group
    {
        uint8_t *p = p_buf;
        p_buf = bt_iap2_prep_param(p_buf, BT_IAP_ID_BLUETOOTH_TRANSPORT_COMPONENT, NULL, 0);

        //group : BT_COMPONENT_ID

        uint16_t component_id = 0x5442;
        p_buf = bt_iap2_prep_param(p_buf, BT_IAP_TRANSPORT_COMPONENT_IDENTIFIER, &component_id,
                                   sizeof(component_id));

        //group TRANSPORT_COMPONENT_NAME
        char acc_name[] = "component_name";
        p_buf = bt_iap2_prep_param(p_buf, BT_IAP_TRANSPORT_COMPONENT_NAME, acc_name, sizeof(acc_name));

        //group TRANSPORT_SUPPORTS_IAP2_CONNECTION
        p_buf = bt_iap2_prep_param(p_buf, BT_IAP_TRANSPORT_SUPPORTS_IAP2_CONNECTION, NULL, 0);

        uint8_t mac_addr[6] = {0x00};
        mac_addr[0] = local_bd_addr[5];
        mac_addr[1] = local_bd_addr[4];
        mac_addr[2] = local_bd_addr[3];
        mac_addr[3] = local_bd_addr[2];
        mac_addr[4] = local_bd_addr[1];
        mac_addr[5] = local_bd_addr[0];
        p_buf = bt_iap2_prep_param(p_buf, BT_IAP_BLUETOOTH_TRANSPORT_MEDIA_ACCESS_CONTROL_ADDRESS, mac_addr,
                                   sizeof(mac_addr));

        //calculate total Length
        uint16_t total_len = p_buf - p;
        BE_UINT16_TO_STREAM(p, total_len);
    }

    APP_PRINT_TRACE2("app_iap_send_ident_info: p_buf %p, p_head %p", p_buf, p_head);

    bt_iap_ident_info_send(bd_addr, p_head, p_buf - p_head);
    free(p_head);
}

/**
 * @brief    BT Manager iAP related events are handled in this function
 * @note     Then the event handling function shall be called according to the
 *           event_type of T_BT_EVENT.
 * @param[in] event_type BT manager event type
 * @param[in] event_buf  Pointer to BT manager event buffer.
 * @param[in] buf_len    BT manager event buffer length.
 * @return   void
 */
static void iap_demo_app_bt_cback(T_BT_EVENT event_type, void *event_buf, uint16_t buf_len)
{
    static bool bt_comp_info_send_flag = false;
    T_BT_EVENT_PARAM *param = event_buf;
    T_IAP_DEMO_LINK *p_link;
    bool handle = true;

    switch (event_type)
    {
    case BT_EVENT_IAP_CONN_IND:
        {
            uint16_t frame_size = param->iap_conn_ind.frame_size;

            p_link = iap_demo_find_link(param->iap_conn_ind.bd_addr);
            if (p_link == NULL)
            {
                APP_PRINT_ERROR0("iap_demo_app_bt_cback: no acl link found");
                return;
            }

            bt_iap_connect_cfm(p_link->bd_addr,  true, frame_size, IAP_DEMO_IAP_DEFAULT_CREDITS);
        }
        break;

    case BT_EVENT_IAP_CONN_CMPL:
        {
            p_link = iap_demo_find_link(param->iap_conn_cmpl.bd_addr);
            if (p_link != NULL)
            {
                memcpy(remote_bd_addr, param->iap_conn_cmpl.bd_addr, 6);
                p_link->rfc_iap_frame_size = param->iap_conn_cmpl.frame_size;
            }
        }
        break;

    case BT_EVENT_IAP_CONN_FAIL:
        break;

    case BT_EVENT_IAP_IDENTITY_INFO_REQ:
        {
            p_link = iap_demo_find_link(param->iap_identity_info_req.bd_addr);
            if (p_link != NULL)
            {
                app_iap_send_ident_info(param->iap_identity_info_req.bd_addr);
            }
        }
        break;

    case BT_EVENT_IAP_AUTHEN_CMPL:
        {
            p_link = iap_demo_find_link(param->iap_authen_cmpl.bd_addr);
            if (p_link != NULL)
            {
                if (param->iap_authen_cmpl.result == true)
                {
                    char *temp_buff = "iAP Connected!\r\n";
                    console_write((uint8_t *)temp_buff, strlen(temp_buff));

                    bt_comp_info_send_flag = true;
                    p_link->authen_flag = true;
                }
                else
                {
                    p_link->authen_flag = false;
                    bt_iap_disconnect_req(param->iap_authen_cmpl.bd_addr);
                }
            }
        }
        break;

    case BT_EVENT_IAP_DATA_SESSION_OPEN:
        {
            p_link = iap_demo_find_link(param->iap_data_session_open.bd_addr);
            if (p_link != NULL)
            {
                if (bt_comp_info_send_flag == true)
                {
                    bt_comp_info_send_flag = false;
                    bt_iap_comp_info_send(param->iap_data_session_open.bd_addr, 0x4254, true);
                }
                p_link->session_connected = true;
                p_link->session_id = param->iap_data_session_open.session_id;
            }
        }
        break;

    case BT_EVENT_IAP_DATA_SESSION_CLOSE:
        {
            p_link = iap_demo_find_link(param->iap_data_session_close.bd_addr);
            if (p_link != NULL)
            {
                p_link->session_connected = false;
                p_link->session_id = 0;
            }
        }
        break;

    case BT_EVENT_IAP_DATA_IND:
        {
            p_link = iap_demo_find_link(param->iap_data_ind.bd_addr);
            if (p_link == NULL)
            {
                APP_PRINT_ERROR0("iap_demo_app_bt_cback: no acl link found");
                return;
            }
            //iAP data recieved.
            iap_demo_app_rx_data_test(param->iap_data_ind.bd_addr, param->iap_data_ind.p_data,
                                      param->iap_data_ind.len);
            bt_iap_ack_send(param->iap_data_ind.bd_addr, param->iap_data_ind.dev_seq_num);
        }
        break;

    case BT_EVENT_IAP_DISCONN_CMPL:
        {
            p_link = iap_demo_find_link(param->iap_disconn_cmpl.bd_addr);
            if (p_link != NULL)
            {
                char *temp_buff = "iAP Disconnected!\r\n";
                console_write((uint8_t *)temp_buff, strlen(temp_buff));

                p_link->authen_flag = false;
                p_link->session_connected = false;
            }
        }
        break;

    default:
        handle = false;
        break;
    }

    if (handle == true)
    {
        APP_PRINT_INFO1("iap_demo_app_bt_cback: event_type 0x%04x", event_type);
    }
}

void iap_demo_app_init(void)
{
    APP_PRINT_INFO0("iap_demo_app_init");

    bt_iap_init(IAP_DEMO_RFC_IAP_CHANN_NUM, app_iap_cp_write, app_iap_cp_burst_read);

    bt_mgr_cback_register(iap_demo_app_bt_cback);
}
```

## src/app_bt_iap_demo_app.h
```c
/*
 * Copyright (c) 2026, Realtek Semiconductor Corporation
 *
 * SPDX-License-Identifier: LicenseRef-Realtek-5-Clause
 */

#ifndef _IAP_DEMO_APP_H_
#define _IAP_DEMO_APP_H_

#include <stdbool.h>

#ifdef __cplusplus
extern "C" {
#endif /* __cplusplus */

/** @defgroup IAP_DEMO_APP iAP Demo APP
  * @brief iAP Demo APP
  * @{
  */

/*============================================================================*
 *                         Macros
 *============================================================================*/
/** @addtogroup IAP_DEMO_APP_Exported_Macros iAP Demo APP Exported Macros
  * @brief
  * @{
  */

/**
* @brief Define iAP ExternalAccessoryProtocol identifuer.
* @note  All ExternalAccessoryProtocol identifuer must be unique.
*/
#define EA_PROTOCOL_ID_RTK      10

/**
* @brief Define iAP maximum link numbers.
* @note  only one iAP server channel exists in the unique link based on RFCOMM.
*/
#define IAP_DEMO_LINK_NUM 0x2

/** End of IAP_DEMO_APP_Exported_Macros
* @}
*/

/*============================================================================*
 *                         Functions
 *============================================================================*/
/** @defgroup IAP_DEMO_APP_Exported_Functions iAP Demo APP Exported Functions
  * @brief
  * @{
  */

/**
    * @brief  iAP cp init
    * @param  void
    * @return void
    */
void app_iap_cp_hw_init(void);

/**
    * @brief  iAP profile init
    * @param  void
    * @return void
    */
void iap_demo_app_init(void);

/**
    * @brief  Start iAP connect procedure
    * \param[in] bd_addr    Remote BT address.
    * @return void
    */
bool iap_demo_conn_start(uint8_t *bd_addr);

/**
    * @brief  Start iAP disconnect procedure
    * @param  void
    * @return void
    */
bool iap_demo_disconnect_start(void);

/**
    * @brief  Send iAP data
    * @param  void
    * @return void
    */
bool iap_demo_app_tx_data_test(void);

/** @} End of IAP_DEMO_APP_Exported_Functions */

/** @} End of IAP_DEMO_APP */

#ifdef __cplusplus
}
#endif /* __cplusplus */

#endif /* _IAP_DEMO_APP_H_ */
```

## src/app_bt_iap_demo_console.c
```c
/*
 * Copyright (c) 2026, Realtek Semiconductor Corporation
 *
 * SPDX-License-Identifier: LicenseRef-Realtek-5-Clause
 */

#include <stdio.h>
#include <stdlib.h>
#include <stdint.h>
#include <stdbool.h>
#include <string.h>
#include "trace.h"
#include "os_mem.h"
#include "cli.h"
#include "bt_types.h"
#include "app_io_msg.h"
#include "app_bt_iap_demo_console.h"

bool iap_demo_send_console_msg(T_IO_CONSOLE subtype, void *param_buf)
{
    T_IO_MSG msg;

    msg.type    = IO_MSG_TYPE_CONSOLE;
    msg.subtype = subtype;
    msg.u.buf   = param_buf;

    return app_io_send_msg(&msg);
}

bool console_iap(const char *cmd_str, char *buf, size_t buf_len)
{
    char       *subcmd;
    char       *p_param;
    int32_t     param_num;
    uint32_t    param_len;
    uint8_t     action;
    uint8_t     addr[6];
    uint8_t     i;
    void       *param_buf;

    param_num = cli_param_num_get(cmd_str);
    if (param_num < 1)
    {
        subcmd = (char *)cmd_str;
        goto err;
    }

    subcmd = (char *)cli_param_get(cmd_str, 1, &param_len);
    subcmd[param_len] = '\0';

    if (!strcmp(subcmd, "connect"))
    {
        action = APP_ACTION_IAP_CONNECT;
        p_param = subcmd + param_len + 1;

        for (i = 0; i < 6; i++)
        {
            addr[i] = (uint8_t)strtol(cli_param_get(p_param, i, &param_len), NULL, 0);
        }
    }
    else if (!strcmp(subcmd, "disconnect"))
    {
        action = APP_ACTION_IAP_DISCONNECT;
    }
    else if (!strcmp(subcmd, "data_send"))
    {
        action = APP_ACTION_IAP_DATA_SEND;
    }
    else
    {
        goto err;
    }

    param_buf = malloc(40);
    if (param_buf != NULL)
    {
        uint8_t    *p;

        p = param_buf;
        LE_UINT16_TO_STREAM(p, IAP_ID);
        LE_UINT8_TO_STREAM(p, action);
        if (action == APP_ACTION_IAP_CONNECT)
        {
            ARRAY_TO_STREAM(p, addr, 6);
        }

        if (iap_demo_send_console_msg(IO_MSG_CONSOLE_STRING_RX, param_buf) == false)
        {
            free(param_buf);
            goto err;
        }

        snprintf(buf, buf_len, "iap %s from console.\r\n", subcmd);
    }

    return false;

err:
    snprintf(buf, buf_len, "Invalid param %s (iap connect/disconnect/data_send).\r\n", subcmd);
    return false;
}

static T_CLI_CMD app_cmd_iap =
{
    NULL,           /* Next command pointed to NULL. */
    NULL,           /* Next subcommand. */
    "iap",         /* The command string to type. */
    "\r\niap:\r\n iap connect\r\n iap disconnect\r\n iap data_send\r\n\r\n",
    console_iap,   /* The function to run. */
    -1              /* Zero or more parameters are expected. */
};

void app_iap_cmd_register(void)
{
    cli_cmd_register(&app_cmd_iap);
}
```

## src/app_bt_iap_demo_console.h
```c
/*
 * Copyright (c) 2026, Realtek Semiconductor Corporation
 *
 * SPDX-License-Identifier: LicenseRef-Realtek-5-Clause
 */

#ifndef _BT_AUDIO_CONSOLE_H_
#define _BT_AUDIO_CONSOLE_H_

#ifdef __cplusplus
extern "C" {
#endif /* __cplusplus */

/** @defgroup APP_BT_AUDIO_CONSOLE BT Audio Console
* @brief BT Audio command
* @{
*/

typedef enum
{
    GAP_LEGACY_ID         = 0x0001,
    IAP_ID                = 0x0002,
} T_BT_AUDIO_CMD_ID;

#define APP_ACTION_IAP_CONNECT           0x01
#define APP_ACTION_IAP_DISCONNECT        0x02
#define APP_ACTION_IAP_DATA_SEND         0x03

void app_iap_cmd_register(void);

/** @} End of APP_BT_AUDIO_CONSOLE */

#ifdef __cplusplus
}
#endif /* __cplusplus */

#endif /* _BT_AUDIO_CONSOLE_H_ */
```

## src/app_bt_iap_demo_gap.c
```c
/*
 * Copyright (c) 2026, Realtek Semiconductor Corporation
 *
 * SPDX-License-Identifier: LicenseRef-Realtek-5-Clause
 */

#include <string.h>
#include "trace.h"
#include "gap.h"
#include "btm.h"
#include "bt_bond.h"
#include "bt_iap.h"
#include "gap_br.h"
#include "app_bt_iap_demo_gap.h"
#include "app_bt_iap_demo_sdp.h"
#include "app_bt_iap_demo_link.h"

static bool is_iap_sdp_ok = false;
static uint8_t remote_server_channel = 0;
uint8_t iap_uuid[16] = {0x00, 0x00, 0x00, 0x00, 0xde, 0xca, 0xfa, 0xde, 0xde, 0xca, 0xde, 0xaf, 0xde, 0xca, 0xca, 0xfe};
/**
 * @brief    BT Manager Gap related events are handled in this function
 * @note     Then the event handling function shall be called according to the
 *           event_type of T_BT_EVENT.
 * @param[in] event_type BT manager event type
 * @param[in] event_buf  Pointer to BT manager event buffer.
 * @param[in] buf_len    BT manager event buffer length.
 * @return   void
 */
static void iap_demo_gap_bt_cback(T_BT_EVENT event_type, void *event_buf, uint16_t buf_len)
{
    T_BT_EVENT_PARAM *param = event_buf;
    T_IAP_DEMO_LINK *p_link;
    bool handle = true;

    switch (event_type)
    {
    case BT_EVENT_READY:
        {
            bt_device_mode_set(BT_DEVICE_MODE_DISCOVERABLE_CONNECTABLE);
        }
        break;

    case BT_EVENT_INQUIRY_RESULT:
        {
        }
        break;

    case BT_EVENT_ACL_CONN_IND:
        {
            p_link = iap_demo_find_link(param->acl_conn_ind.bd_addr);
            if (p_link != NULL)
            {
                bt_acl_conn_reject(param->acl_conn_ind.bd_addr, BT_ACL_REJECT_UNACCEPTABLE_ADDR);
            }
            else
            {
                bt_acl_conn_accept(param->acl_conn_ind.bd_addr, BT_LINK_ROLE_SLAVE);

            }
        }
        break;

    case BT_EVENT_LINK_KEY_REQ:
        {
            uint8_t link_key[16];
            T_BT_LINK_KEY_TYPE type;

            if (bt_bond_key_get(param->link_key_req.bd_addr, link_key, (uint8_t *)&type))
            {
                bt_link_key_cfm(param->link_key_req.bd_addr, true, type, link_key);
            }
            else
            {
                bt_link_key_cfm(param->link_key_req.bd_addr, false, type, link_key);
            }
        }
        break;

    case BT_EVENT_LINK_PIN_CODE_REQ:
        {
            uint8_t pin_code[4] = {1, 2, 3, 4};
            bt_link_pin_code_cfm(param->link_pin_code_req.bd_addr, pin_code, 4, true);
        }
        break;

    case BT_EVENT_LINK_KEY_INFO:
        {
            bt_bond_key_set(param->link_key_info.bd_addr, param->link_key_info.link_key,
                            param->link_key_info.key_type);
        }
        break;

    case BT_EVENT_LINK_USER_CONFIRMATION_REQ:
        {
            gap_br_user_cfm_req_cfm(param->link_user_confirmation_req.bd_addr, GAP_CFM_CAUSE_ACCEPT);
        }
        break;

    case BT_EVENT_ACL_CONN_SUCCESS:
        {
            iap_demo_alloc_link(param->acl_conn_success.bd_addr);
            bt_device_mode_set(BT_DEVICE_MODE_IDLE);
        }
        break;

    case BT_EVENT_ACL_CONN_DISCONN:
        {
            p_link = iap_demo_find_link(param->acl_conn_disconn.bd_addr);
            if (p_link != NULL)
            {
                iap_demo_free_link(p_link);
            }
            bt_device_mode_set(BT_DEVICE_MODE_DISCOVERABLE_CONNECTABLE);
        }
        break;

    case BT_EVENT_SDP_ATTR_INFO:
        {
            if (param->sdp_attr_info.info.srv_class_uuid_type == BT_SDP_UUID128)
            {
                if (!memcmp(param->sdp_attr_info.info.srv_class_uuid_data.uuid_128, iap_uuid, 16))
                {
                    is_iap_sdp_ok = true;
                    remote_server_channel = param->sdp_attr_info.info.server_channel;
                }
            }
        }
        break;

    case BT_EVENT_SDP_DISCOV_CMPL:
        {
            if (is_iap_sdp_ok)
            {
                if (param->sdp_discov_cmpl.cause == 0x00)
                {
                    bt_iap_connect_req(param->sdp_discov_cmpl.bd_addr, remote_server_channel,
                                       IAP_DEMO_IAP_DEFAULT_MTU_SIZE, IAP_DEMO_IAP_DEFAULT_CREDITS);
                }
            }
        }
        break;

    default:
        handle = false;
        break;
    }

    if (handle == true)
    {
        APP_PRINT_INFO1("iap_demo_gap_bt_cback: event_type 0x%04x", event_type);
    }
}

void iap_demo_gap_init(void)
{
    APP_PRINT_INFO0("iap_demo_gap_init");
    bt_mgr_cback_register(iap_demo_gap_bt_cback);
}
```

## src/app_bt_iap_demo_gap.h
```c
/*
 * Copyright (c) 2026, Realtek Semiconductor Corporation
 *
 * SPDX-License-Identifier: LicenseRef-Realtek-5-Clause
 */

#ifndef _IAP_DEMO_GAP_H_
#define _IAP_DEMO_GAP_H_

#ifdef __cplusplus
extern "C" {
#endif /* __cplusplus */

/** @defgroup IAP_DEMO_GAP iAP Demo Gap
  * @brief iAP Demo Gap
  * @{
  */

/*============================================================================*
 *                              Functions
 *============================================================================*/
/** @defgroup IAP_DEMO_GAP_Exported_Functions iAP Demo Gap Functions
    * @{
    */
/**
    * @brief  gap module init.
    * @param  void
    * @return void
    */
void iap_demo_gap_init(void);

/** @} End of IAP_DEMO_GAP_Exported_Functions */

/** @} End of IAP_DEMO_GAP */

#ifdef __cplusplus
}
#endif /* __cplusplus */

#endif /* _IAP_DEMO_GAP_H_ */
```

## src/app_bt_iap_demo_link.c
```c
/*
 * Copyright (c) 2026, Realtek Semiconductor Corporation
 *
 * SPDX-License-Identifier: LicenseRef-Realtek-5-Clause
 */

#include <string.h>
#include "app_bt_iap_demo_link.h"

static T_IAP_DEMO_APP_DB app_db;//APP SPP data base.

T_IAP_DEMO_LINK *iap_demo_find_link(uint8_t *bd_addr)
{
    T_IAP_DEMO_LINK *p_link = NULL;
    uint8_t        i;

    if (bd_addr != NULL)
    {
        for (i = 0; i < IAP_DEMO_MAX_BR_LINK_NUM; i++)
        {
            if (app_db.iap_link[i].used == true &&
                !memcmp(app_db.iap_link[i].bd_addr, bd_addr, 6))
            {
                p_link = &app_db.iap_link[i];
                break;
            }
        }
    }

    return p_link;
}

T_IAP_DEMO_LINK *iap_demo_alloc_link(uint8_t *bd_addr)
{
    T_IAP_DEMO_LINK *p_link = NULL;
    uint8_t        i;

    if (bd_addr != NULL)
    {
        for (i = 0; i < IAP_DEMO_MAX_BR_LINK_NUM; i++)
        {
            if (app_db.iap_link[i].used == false)
            {
                p_link = &app_db.iap_link[i];

                p_link->used = true;
                p_link->id   = i;
                memcpy(p_link->bd_addr, bd_addr, 6);
                break;
            }
        }
    }

    return p_link;
}

bool iap_demo_free_link(T_IAP_DEMO_LINK *p_link)
{
    if (p_link != NULL)
    {
        if (p_link->used == true)
        {
            memset(p_link, 0, sizeof(T_IAP_DEMO_LINK));
            return true;
        }
    }

    return false;
}
```

## src/app_bt_iap_demo_link.h
```c
/*
 * Copyright (c) 2026, Realtek Semiconductor Corporation
 *
 * SPDX-License-Identifier: LicenseRef-Realtek-5-Clause
 */

#ifndef _IAP_DEMO_LINK_H_
#define _IAP_DEMO_LINK_H_

#include <stdint.h>
#include <stdbool.h>

#ifdef __cplusplus
extern "C" {
#endif /* __cplusplus */

/** @defgroup IAP_DEMO_LINK iAP Demo APP Link
  * @brief iAP Demo APP Link
  * @{
  */

/*============================================================================*
 *                         Macros
 *============================================================================*/
/** @addtogroup IAP_DEMO_LINK_Exported_Macros iAP Demo Link Macros
  * @brief
  * @{
  */

/** @brief  Define links number. range: 0-4 */
#define IAP_DEMO_MAX_BR_LINK_NUM                 4

/** End of IAP_DEMO_LINK_Exported_Macros
* @}
*/

/*============================================================================*
 *                         Types
 *============================================================================*/
/** @defgroup IAP_DEMO_LINK_Exported_Types iAP Demo Link Types
  * @brief
  * @{
  */

/**  @brief  APP's Bluetooth BR/EDR link connection database */
typedef struct
{
    uint8_t         bd_addr[6];
    bool            used;
    uint8_t         id;

    uint16_t        rfc_iap_frame_size;//iap tx/rx mtu size.
    bool            authen_flag;
    bool            session_connected;
    uint16_t        session_id;
} T_IAP_DEMO_LINK;

/**  @brief  App define global app data structure */
typedef struct
{
    T_IAP_DEMO_LINK               iap_link[IAP_DEMO_MAX_BR_LINK_NUM];
} T_IAP_DEMO_APP_DB;
/** End of IAP_DEMO_LINK_Exported_Types
* @}
*/

/*============================================================================*
 *                         Functions
 *============================================================================*/
/** @defgroup IAP_DEMO_LINK_Exported_Functions iAP Demo Link Exported Functions
  * @brief
  * @{
  */

/**
 * @brief     Find the APP iAP data instance with Remote BT address.
 * @param[in] bd_addr Remote BT address.
 * @return    APP iAP data instance. If returned handle is NULL, the APP iAP
 *            data instance was failed to create.
 */
T_IAP_DEMO_LINK *iap_demo_find_link(uint8_t *bd_addr);

/**
 * @brief     Allocate the APP iAP data instance with Remote BT address.
 * @param[in] bd_addr Remote BT address.
 * @return    APP iAP data instance. If returned handle is NULL, the APP iAP
 *            data instance was failed to create.
 */
T_IAP_DEMO_LINK *iap_demo_alloc_link(uint8_t *bd_addr);

/**
 * @brief     Free the APP iAP data instance with Remote BT address.
 * @param[in] bd_addr Remote BT address.
 * @return    APP iAP data instance. If returned handle is NULL, the APP iAP
 *            data instance was failed to create.
 */
bool iap_demo_free_link(T_IAP_DEMO_LINK *p_link);

/** @} End of IAP_DEMO_LINK_Exported_Functions */

/** @} End of IAP_DEMO_LINK */

#ifdef __cplusplus
}
#endif /* __cplusplus */

#endif /* _IAP_DEMO_LINK_H_ */
```

## src/app_bt_iap_demo_main.c
```c
/*
 * Copyright (c) 2026, Realtek Semiconductor Corporation
 *
 * SPDX-License-Identifier: LicenseRef-Realtek-5-Clause
 */

#include <string.h>
#include "trace.h"
#include "rtl876x_pinmux.h"
#include "gap.h"
#include "gap_br.h"
#include "os_mem.h"
#include "os_sched.h"
#include "btm.h"
#include "sysm.h"
#include "remote.h"
#include "console_uart.h"
#include "app_bt_iap_demo_task.h"
#include "app_bt_iap_demo_gap.h"
#include "app_bt_iap_demo_app.h"
#include "app_bt_iap_demo_sdp.h"
#include "app_bt_iap_demo_console.h"
#include "rtl876x_uart.h"
#if F_DLPS_EN
#include "pm.h"
#endif

/** @defgroup  IAP_DEMO_MAIN iAP Demo Main
    * @brief Main file to initialize hardware and BT stack and start task scheduling
    * @{
    */

#define IAP_DEMO_DEFAULT_PAGESCAN_WINDOW             0x12
#define IAP_DEMO_DEFAULT_PAGESCAN_INTERVAL           0x800 //0x800
#define IAP_DEMO_DEFAULT_PAGE_TIMEOUT                0x4000
#define IAP_DEMO_DEFAULT_SUPVISIONTIMEOUT            0x1f40 //0x7D00
#define IAP_DEMO_DEFAULT_INQUIRYSCAN_WINDOW          0x12
#define IAP_DEMO_DEFAULT_INQUIRYSCAN_INTERVAL        0x800 //0x1000

#define PLAYBACK_POOL_SIZE                  (13*1024)
#define VOICE_POOL_SIZE                     (2*1024)
#define RECORD_POOL_SIZE                    (1*1024)
#define NOTIFICATION_POOL_SIZE              (8*1024)

#define IAP_DEMO_CP_DAT           P0_2
#define IAP_DEMO_CP_CLK           P0_3

#define CONSOLE_UART_RX_BUFFER_SIZE         300

const uint8_t local_bd_addr[6]  = {0x11, 0x22, 0x56, 0x34, 0x56, 0x77};
const char *local_name = "iAP demo app";

/*============================================================================*
 *                              Functions
 *============================================================================*/
/**
  * @brief  Initialize gap bond manager related parameters
  * @return void
  */
static void app_bt_gap_init(void)
{
    uint32_t class_of_device = (uint32_t)(0x18 | (0x04 << 8) | (0x24 << 16));
    uint16_t supervision_timeout = IAP_DEMO_DEFAULT_SUPVISIONTIMEOUT;

    uint16_t link_policy = GAP_LINK_POLICY_ROLE_SWITCH | GAP_LINK_POLICY_SNIFF_MODE;

    uint8_t radio_mode = GAP_RADIO_MODE_NONE_DISCOVERABLE;
    bool limited_discoverable = false;
    bool auto_accept_acl = false;

    uint8_t pagescan_type = GAP_PAGE_SCAN_TYPE_INTERLACED;
    uint16_t pagescan_interval = IAP_DEMO_DEFAULT_PAGESCAN_INTERVAL;
    uint16_t pagescan_window = IAP_DEMO_DEFAULT_PAGESCAN_WINDOW;
    uint16_t page_timeout = IAP_DEMO_DEFAULT_PAGE_TIMEOUT;

    uint8_t inquiryscan_type = GAP_INQUIRY_SCAN_TYPE_STANDARD;
    uint16_t inquiryscan_window = IAP_DEMO_DEFAULT_INQUIRYSCAN_WINDOW;
    uint16_t inquiryscan_interval = IAP_DEMO_DEFAULT_INQUIRYSCAN_INTERVAL;
    uint8_t inquiry_mode = GAP_INQUIRY_MODE_EXTENDED_RESULT;

    uint8_t pair_mode = GAP_PAIRING_MODE_PAIRABLE;
    uint16_t auth_flags = GAP_AUTHEN_BIT_GENERAL_BONDING_FLAG | GAP_AUTHEN_BIT_SC_FLAG;
    uint8_t io_cap = GAP_IO_CAP_NO_INPUT_NO_OUTPUT;
    uint8_t oob_enable = false;
    uint8_t bt_mode = GAP_BT_MODE_21ENABLED;

    gap_lib_init();

    gap_br_set_param(GAP_BR_PARAM_NAME, strlen((const char *)local_name) + 1, (void *)local_name);
    gap_set_bd_addr((uint8_t *)local_bd_addr);
    gap_br_cfg_accept_role(0);

    gap_set_param(GAP_PARAM_BOND_PAIRING_MODE, sizeof(uint8_t), &pair_mode);
    gap_set_param(GAP_PARAM_BOND_AUTHEN_REQUIREMENTS_FLAGS, sizeof(uint16_t), &auth_flags);
    gap_set_param(GAP_PARAM_BOND_IO_CAPABILITIES, sizeof(uint8_t), &io_cap);
    gap_set_param(GAP_PARAM_BOND_OOB_ENABLED, sizeof(uint8_t), &oob_enable);

    gap_br_set_param(GAP_BR_PARAM_BT_MODE, sizeof(uint8_t), &bt_mode);
    gap_br_set_param(GAP_BR_PARAM_COD, sizeof(uint32_t), &class_of_device);
    gap_br_set_param(GAP_BR_PARAM_LINK_POLICY, sizeof(uint16_t), &link_policy);
    gap_br_set_param(GAP_BR_PARAM_SUPV_TOUT, sizeof(uint16_t), &supervision_timeout);
    gap_br_set_param(GAP_BR_PARAM_AUTO_ACCEPT_ACL, sizeof(bool), &auto_accept_acl);


    gap_br_set_param(GAP_BR_PARAM_RADIO_MODE, sizeof(uint8_t), &radio_mode);
    gap_br_set_param(GAP_BR_PARAM_LIMIT_DISCOV, sizeof(bool), &limited_discoverable);

    gap_br_set_param(GAP_BR_PARAM_PAGE_SCAN_TYPE, sizeof(uint8_t), &pagescan_type);
    gap_br_set_param(GAP_BR_PARAM_PAGE_SCAN_INTERVAL, sizeof(uint16_t), &pagescan_interval);
    gap_br_set_param(GAP_BR_PARAM_PAGE_SCAN_WINDOW, sizeof(uint16_t), &pagescan_window);
    gap_br_set_param(GAP_BR_PARAM_PAGE_TIMEOUT, sizeof(uint16_t), &page_timeout);

    gap_br_set_param(GAP_BR_PARAM_INQUIRY_SCAN_TYPE, sizeof(uint8_t), &inquiryscan_type);
    gap_br_set_param(GAP_BR_PARAM_INQUIRY_SCAN_INTERVAL, sizeof(uint16_t), &inquiryscan_interval);
    gap_br_set_param(GAP_BR_PARAM_INQUIRY_SCAN_WINDOW, sizeof(uint16_t), &inquiryscan_window);
    gap_br_set_param(GAP_BR_PARAM_INQUIRY_MODE, sizeof(uint8_t), &inquiry_mode);
}

/**
 * @brief    Contains the initialization of framework
 * @return   void
 */
static void framework_init(void)
{
    /* System Manager */
    sys_mgr_init(iap_demo_evt_queue_handle);

    /* RemoteController Manager */
    remote_mgr_init(REMOTE_SESSION_ROLE_SINGLE);

    /* Bluetooth Manager */
    bt_mgr_init();
}

/**
 * @brief    Contains the initialization of pinmux settings and pad settings
 * @note     All the pinmux settings and pad settings shall be initiated in this function,
 *           but if legacy driver is used, the initialization of pinmux setting and pad setting
 *           should be peformed with the IO initializing.
 * @return   void
 */
void board_init(void)
{
    /* Console UART pins are owned by devicetree (realtek,console-uart / uart3
     * pinctrl); the Zephyr UART driver configures them. */
    Pinmux_Config(IAP_DEMO_CP_DAT, I2C0_DAT);
    //Pad_Config(IAP_DEMO_CP_DAT,
    //PAD_SW_MODE, PAD_IS_PWRON, PAD_PULL_DOWN, PAD_OUT_DISABLE, PAD_OUT_LOW);

    Pinmux_Config(IAP_DEMO_CP_CLK, I2C0_CLK);
    //Pad_Config(IAP_DEMO_CP_CLK,
    //PAD_SW_MODE, PAD_IS_PWRON, PAD_PULL_DOWN, PAD_OUT_DISABLE, PAD_OUT_LOW);

    Pad_Config(IAP_DEMO_CP_DAT,
               PAD_PINMUX_MODE, PAD_IS_PWRON, PAD_PULL_UP, PAD_OUT_DISABLE, PAD_OUT_LOW);
    Pad_Config(IAP_DEMO_CP_CLK,
               PAD_PINMUX_MODE, PAD_IS_PWRON, PAD_PULL_UP, PAD_OUT_DISABLE, PAD_OUT_LOW);
    Pad_PullConfigValue(IAP_DEMO_CP_DAT, PAD_STRONG_PULL);
    Pad_PullConfigValue(IAP_DEMO_CP_CLK, PAD_STRONG_PULL);
}

/**
 * @brief    Contains the initialization of peripherals
 * @note     Both new architecture driver and legacy driver initialization method can be used
 * @return   void
 */
static void driver_init(void)
{
    T_CONSOLE_PARAM console_param;
    T_CONSOLE_OP    console_op;
    T_CONSOLE_UART_CONFIG console_uart_config;
    memset(&console_param, 0x00, sizeof(T_CONSOLE_PARAM));
    memset(&console_op, 0x00, sizeof(T_CONSOLE_OP));
    memset(&console_uart_config, 0x00, sizeof(T_CONSOLE_UART_CONFIG));

    /* Pinmux, baud rate and wakeup pins are owned by the Zephyr UART driver
     * (devicetree). Only the transport-level parameters are set here. */
    console_uart_config.one_wire_uart_support = false; // one-wire uart not support in zephyr uart
    console_uart_config.callback = NULL;
    console_uart_config.uart_dma_rx_buffer_size = CONSOLE_UART_RX_BUFFER_SIZE;
    console_uart_config_init(&console_uart_config);

    console_param.tx_buf_size   = 512;
    console_param.rx_buf_size   = 512;

    console_op.init = console_uart_init;
    console_op.write = console_uart_write;

    console_init(&console_param, &console_op);
    console_set_mode(CONSOLE_MODE_STRING);

    app_iap_cp_hw_init();
}

/**
 * @brief    Contains the initialization of all tasks
 * @note     There is only one task in BLE Peripheral APP, thus only one APP task is init here
 * @return   void
 */
void task_init(void)
{
    iap_demo_task_init();
}

/**
 * @brief    Contains the power mode settings
 * @return   void
 */
void pwr_mgr_init(void)
{
#if F_DLPS_EN
    bt_power_mode_set(BTPOWER_DEEP_SLEEP);
    power_mode_set(POWER_DLPS_MODE);
#endif
}


/**
 * @brief    Entry of APP code
 * @return   int (To avoid compile warning)
 */
int main(void)
{
    board_init();
    driver_init();
    task_init();

    framework_init();
    app_bt_gap_init();
    iap_demo_gap_init();
    iap_demo_sdp_init();
    iap_demo_app_init();
    app_iap_cmd_register();

    os_sched_start();

    return 0;
}
/** @} */ /* End of group IAP_DEMO_MAIN */
```

## src/app_bt_iap_demo_sdp.c
```c
/*
 * Copyright (c) 2026, Realtek Semiconductor Corporation
 *
 * SPDX-License-Identifier: LicenseRef-Realtek-5-Clause
 */

#include <stdint.h>
#include "trace.h"
#include "gap_br.h"
#include "app_bt_iap_demo_sdp.h"
#include "bt_sdp.h"

/**
  * @brief  iAP local SDP record.
  * @return void
  */
static const uint8_t iap_demo_sdp_record[] =
{
    SDP_DATA_ELEM_SEQ_HDR,
    0x4F,
    //attribute SDP_ATTR_SRV_CLASS_ID_LIST
    SDP_UNSIGNED_TWO_BYTE,
    (uint8_t)(SDP_ATTR_SRV_CLASS_ID_LIST >> 8),
    (uint8_t)SDP_ATTR_SRV_CLASS_ID_LIST,
    SDP_DATA_ELEM_SEQ_HDR,
    0x11,
    SDP_UUID128_HDR,
    0x00, 0x00, 0x00, 0x00, 0xde, 0xca, 0xfa, 0xde, 0xde, 0xca, 0xde, 0xaf, 0xde, 0xca, 0xca, 0xff,

    //attribute SDP_ATTR_PROTO_DESC_LIST
    SDP_UNSIGNED_TWO_BYTE,
    (uint8_t)(SDP_ATTR_PROTO_DESC_LIST >> 8),
    (uint8_t)SDP_ATTR_PROTO_DESC_LIST,
    SDP_DATA_ELEM_SEQ_HDR,
    0x0c,
    SDP_DATA_ELEM_SEQ_HDR,
    03,
    SDP_UUID16_HDR,
    (uint8_t)(UUID_L2CAP >> 8),
    (uint8_t)UUID_L2CAP,
    SDP_DATA_ELEM_SEQ_HDR,
    0x05,
    SDP_UUID16_HDR,
    (uint8_t)(UUID_RFCOMM >> 8),
    (uint8_t)UUID_RFCOMM,
    SDP_UNSIGNED_ONE_BYTE,
    IAP_DEMO_RFC_IAP_CHANN_NUM,

    //attribute SDP_ATTR_BROWSE_GROUP_LIST
    SDP_UNSIGNED_TWO_BYTE,
    (uint8_t)(SDP_ATTR_BROWSE_GROUP_LIST >> 8),
    (uint8_t)SDP_ATTR_BROWSE_GROUP_LIST,
    SDP_DATA_ELEM_SEQ_HDR,
    0x03,
    SDP_UUID16_HDR,
    (uint8_t)(UUID_PUBLIC_BROWSE_GROUP >> 8),
    (uint8_t)UUID_PUBLIC_BROWSE_GROUP,

    //attribute SDP_ATTR_LANG_BASE_ATTR_ID_LIST
    SDP_UNSIGNED_TWO_BYTE,
    (uint8_t)(SDP_ATTR_LANG_BASE_ATTR_ID_LIST >> 8),
    (uint8_t)SDP_ATTR_LANG_BASE_ATTR_ID_LIST,
    SDP_DATA_ELEM_SEQ_HDR,
    0x09,
    SDP_UNSIGNED_TWO_BYTE,
    (uint8_t)(SDP_LANG_ENGLISH >> 8),
    (uint8_t)SDP_LANG_ENGLISH,
    SDP_UNSIGNED_TWO_BYTE,
    (uint8_t)(SDP_CHARACTER_UTF8 >> 8),
    (uint8_t)SDP_CHARACTER_UTF8,
    SDP_UNSIGNED_TWO_BYTE,
    (uint8_t)(SDP_BASE_LANG_OFFSET >> 8),
    (uint8_t)SDP_BASE_LANG_OFFSET,

    //attribute SDP_ATTR_SRV_NAME
    SDP_UNSIGNED_TWO_BYTE,
    (uint8_t)((SDP_ATTR_SRV_NAME + SDP_BASE_LANG_OFFSET) >> 8),
    (uint8_t)(SDP_ATTR_SRV_NAME + SDP_BASE_LANG_OFFSET),
    SDP_STRING_HDR,
    0x0C,
    0x57, 0x69, 0x72, 0x65, 0x6c, 0x65, 0x73, 0x73, 0x20, 0x69, 0x41, 0x50 //"Wireless iAP"
};

void iap_demo_sdp_init(void)
{
    APP_PRINT_INFO0("iap_demo_sdp_init");

    bt_sdp_record_add((void *)iap_demo_sdp_record);
}
```

## src/app_bt_iap_demo_sdp.h
```c
/*
 * Copyright (c) 2026, Realtek Semiconductor Corporation
 *
 * SPDX-License-Identifier: LicenseRef-Realtek-5-Clause
 */

#ifndef _IAP_DEMO_SDP_H_
#define _IAP_DEMO_SDP_H_

#ifdef __cplusplus
extern "C" {
#endif /* __cplusplus */

/** @defgroup IAP_DEMO_SDP iAP Demo SDP
* @brief iAP Demo SDP
* @{
*/

/*============================================================================*
 *                         Macros
 *============================================================================*/
/** @addtogroup IAP_DEMO_SDP_Exported_Macros iAP Demo SDP Exported Macros
  * @brief
  * @{
  */

/**
* @brief Define iAP default l2cap mtu size
* @note  iAP application may send tx data lower than iAP mtu size at a time
*/
#define IAP_DEMO_IAP_DEFAULT_MTU_SIZE 1012
/**
* @brief Define iAP default local tx window size
* @note  iAP application should send tx data when iAP link credit is not zero
*
*/
#define IAP_DEMO_IAP_DEFAULT_CREDITS 7
/**
* @brief Define iAP local server channel
* @note  iAP service num may be different in different iAP applications
*
*/
#define IAP_DEMO_RFC_IAP_CHANN_NUM 0x3

/** End of IAP_DEMO_SDP_Exported_Macros
* @}
*/

/*============================================================================*
 *                         Functions
 *============================================================================*/
/** @defgroup IAP_DEMO_SDP_Exported_Functions iAP Demo SDP Exported Functions
  * @brief
  * @{
  */

/**
    * @brief  iAP SDP init
    * @param  void
    * @return void
    */
void iap_demo_sdp_init(void);

/** @} End of IAP_DEMO_SDP_Exported_Functions */

/** @} End of IAP_DEMO_SDP */

#ifdef __cplusplus
}
#endif /* __cplusplus */

#endif /* _IAP_DEMO_SDP_H_ */
```
