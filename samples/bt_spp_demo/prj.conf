## CMakeLists.txt
```
#
# Copyright (c) 2026, Realtek Semiconductor Corporation
#
# SPDX-License-Identifier: LicenseRef-Realtek-5-Clause
#

message(STATUS "CMAKELIST FOLDER: ${CMAKE_CURRENT_SOURCE_DIR}")

cmake_minimum_required(VERSION 3.20.0)

#===========version generation===========
include(${CMAKE_CURRENT_SOURCE_DIR}/../../cmake/version_generate.cmake)
generate_version()
#===========version generation===========
#===========post build===========
# post build should be called before find_package
include(${CMAKE_CURRENT_SOURCE_DIR}/../../cmake/post_build.cmake)
rtk_post_build()
#===========post build===========

find_package(Zephyr REQUIRED HINTS $ENV{ZEPHYR_BASE})
project(bt_spp_demo)

FILE(GLOB app_sources src/*.c)
target_sources(app PRIVATE
  ${app_sources}
  )

target_precompile_headers(app PUBLIC 
	          ${CMAKE_CURRENT_SOURCE_DIR}/src/app_flags.h
			  )
    
target_include_directories(app PRIVATE src)
```

## prj.conf
```kconfig
# nothing here
CONFIG_SERIAL=y
CONFIG_HEAP_MEM_POOL_SIZE=2048
CONFIG_UART_ASYNC_API=y
CONFIG_REALTEK_SUBSYS_AUDIO=y
CONFIG_REALTEK_SUBSYS_BTM=y
CONFIG_REALTEK_SUBSYS_CONSOLE=y
CONFIG_REALTEK_SUBSYS_REMOTE=y
CONFIG_REALTEK_SUBSYS_SYSM=y
```

## src/app_bt_spp_demo_app.c
```c
/*
 * Copyright (c) 2026, Realtek Semiconductor Corporation
 *
 * SPDX-License-Identifier: LicenseRef-Realtek-5-Clause
 */

#include <stdio.h>
#include <string.h>
#include "trace.h"
#include "bt_types.h"
#include "gap_br.h"
#include "btm.h"
#include "bt_spp.h"
#include "app_bt_spp_demo_sdp.h"
#include "app_bt_spp_demo_app.h"
#include "app_bt_spp_demo_link.h"
#include "console.h"

/* SPP UUID */
static const uint8_t spp_demo_service_class_uuid128[16] =
{
    0x00, 0x00, 0x11, 0x01, 0x00, 0x00, 0x10, 0x00, 0x80, 0x00, 0x00, 0x80, 0x5f, 0x9b, 0x34, 0xfb
};

static void spp_demo_app_bt_cback(T_BT_EVENT event_type, void *event_buf, uint16_t buf_len)
{
    T_BT_EVENT_PARAM *param = event_buf;
    T_SPP_DEMO_LINK  *p_link;
    T_SPP_SERVICE    *service;
    bool              handle = true;

    switch (event_type)
    {
    case BT_EVENT_SPP_CONN_CMPL:
        {
            p_link = spp_demo_find_link(param->spp_conn_cmpl.bd_addr);
            if (p_link != NULL)
            {
                service = spp_demo_find_service(param->spp_conn_cmpl.bd_addr,
                                                param->spp_conn_cmpl.local_server_chann);
                if (service == NULL)
                {
                    service = spp_demo_alloc_service(param->spp_conn_cmpl.bd_addr,
                                                     param->spp_conn_cmpl.local_server_chann);
                    if (service != NULL)
                    {
                        char console_buf[110];

                        service->credit = param->spp_conn_cmpl.link_credit;
                        service->frame_size = param->spp_conn_cmpl.frame_size;

                        sprintf((char *)console_buf,
                                "SPP Connected: addr 0x%02x::0x%02x::0x%02x::0x%02x::0x%02x::0x%02x, local_server_chann 0x%02x \r\n",
                                param->spp_conn_cmpl.bd_addr[0],
                                param->spp_conn_cmpl.bd_addr[1],
                                param->spp_conn_cmpl.bd_addr[2],
                                param->spp_conn_cmpl.bd_addr[3],
                                param->spp_conn_cmpl.bd_addr[4],
                                param->spp_conn_cmpl.bd_addr[5],
                                param->spp_conn_cmpl.local_server_chann);

                        console_write((uint8_t *)console_buf, strlen(console_buf));
                    }
                }

                bt_device_mode_set(BT_DEVICE_MODE_DISCOVERABLE_CONNECTABLE);
            }
        }
        break;

    case BT_EVENT_SPP_CREDIT_RCVD:
        {
            service = spp_demo_find_service(param->spp_credit_rcvd.bd_addr,
                                            param->spp_credit_rcvd.local_server_chann);
            if (service != NULL)
            {
                service->credit = param->spp_credit_rcvd.link_credit;
            }
        }
        break;

    case BT_EVENT_SPP_DATA_IND:
        {
            service = spp_demo_find_service(param->spp_data_ind.bd_addr,
                                            param->spp_data_ind.local_server_chann);
            if (service != NULL)
            {
                char console_buf[110];

                bt_spp_credits_give(param->spp_data_ind.bd_addr, param->spp_data_ind.local_server_chann, 1);

                sprintf((char *)console_buf,
                        "SPP receive data from addr 0x%02x::0x%02x::0x%02x::0x%02x::0x%02x::0x%02x, local_server_chann 0x%02x \r\n",
                        param->spp_data_ind.bd_addr[0],
                        param->spp_data_ind.bd_addr[1],
                        param->spp_data_ind.bd_addr[2],
                        param->spp_data_ind.bd_addr[3],
                        param->spp_data_ind.bd_addr[4],
                        param->spp_data_ind.bd_addr[5],
                        param->spp_data_ind.local_server_chann);

                console_write((uint8_t *)console_buf, strlen(console_buf));
                console_write(param->spp_data_ind.data, param->spp_data_ind.len);
            }
        }
        break;

    case BT_EVENT_SPP_CONN_IND:
        {
            p_link = spp_demo_find_link(param->spp_conn_ind.bd_addr);
            if (p_link != NULL)
            {
                service = spp_demo_find_service(param->spp_conn_ind.bd_addr,
                                                param->spp_conn_ind.local_server_chann);

                if (service == NULL)
                {
                    bt_spp_connect_cfm(p_link->bd_addr,
                                       param->spp_conn_ind.local_server_chann,
                                       true,
                                       param->spp_conn_ind.frame_size,
                                       SPP_DEMO_SPP_DEFAULT_CREDITS);
                }
                else
                {
                    bt_spp_connect_cfm(p_link->bd_addr,
                                       param->spp_conn_ind.local_server_chann,
                                       false,
                                       param->spp_conn_ind.frame_size,
                                       SPP_DEMO_SPP_DEFAULT_CREDITS);
                }
            }
        }
        break;

    case BT_EVENT_SPP_DISCONN_CMPL:
        {
            service = spp_demo_find_service(param->spp_disconn_cmpl.bd_addr,
                                            param->spp_disconn_cmpl.local_server_chann);
            if (service != NULL)
            {
                spp_demo_free_service(param->spp_disconn_cmpl.bd_addr, service);
            }
        }
        break;

    default:
        handle = false;
        break;
    }

    if (handle == true)
    {
        APP_PRINT_INFO1("spp_demo_app_bt_cback: event_type 0x%04x", event_type);
    }
}

void spp_demo_app_tx_data(uint8_t *bd_addr, uint8_t *buf, uint8_t len)
{
    T_SPP_DEMO_LINK *p_link;

    p_link = spp_demo_find_link(bd_addr);
    if (p_link != NULL)
    {
        T_SPP_SERVICE *service;

        service = os_queue_peek(&p_link->service_list, 0);
        while (service != NULL)
        {
            APP_PRINT_TRACE3("spp_demo_app_tx_data: spp_credit %d, local_server_chann %d, len %d",
                             service->credit, service->local_server_chann, len);

            if (service->credit)
            {
                if (bt_spp_data_send(bd_addr,
                                     service->local_server_chann,
                                     buf,
                                     len,
                                     false))
                {
                    char console_buf[110];

                    service->credit--;

                    sprintf((char *)console_buf,
                            "SPP send data to addr 0x%02x::0x%02x::0x%02x::0x%02x::0x%02x::0x%02x, local_server_chann 0x%02x \r\n",
                            bd_addr[0],
                            bd_addr[1],
                            bd_addr[2],
                            bd_addr[3],
                            bd_addr[4],
                            bd_addr[5],
                            service->local_server_chann);

                    console_write((uint8_t *)console_buf, strlen(console_buf));
                    console_write(buf, len);
                }
            }

            service = service->next;
        }
    }
}

void spp_demo_app_connect_req(uint8_t *bd_addr)
{
    T_GAP_UUID_DATA uuid;
    T_GAP_UUID_TYPE uuid_type = GAP_UUID16;

    uuid.uuid_16 = UUID_RFCOMM;
    gap_br_start_sdp_discov(bd_addr, uuid_type, uuid);
}

void spp_demo_app_disconnect_all_req(uint8_t *bd_addr)
{
    T_SPP_DEMO_LINK *p_link;

    p_link = spp_demo_find_link(bd_addr);
    if (p_link != NULL)
    {
        bt_spp_disconnect_all_req(bd_addr);
    }
}

void spp_demo_app_disconnect_req(uint8_t *bd_addr, uint8_t local_server_chann)
{
    T_SPP_DEMO_LINK *p_link;

    p_link = spp_demo_find_link(bd_addr);
    if (p_link != NULL)
    {
        bt_spp_disconnect_req(bd_addr, local_server_chann);
    }
}

void spp_demo_app_init(void)
{
    spp_demo_int();
    bt_spp_init();
    bt_spp_service_register((uint8_t *)spp_demo_service_class_uuid128, SPP_DEMO_RFC_SPP_CHANN_NUM);
    bt_mgr_cback_register(spp_demo_app_bt_cback);
    bt_spp_ertm_mode_set(false);
}
```

## src/app_bt_spp_demo_app.h
```c
/*
 * Copyright (c) 2026, Realtek Semiconductor Corporation
 *
 * SPDX-License-Identifier: LicenseRef-Realtek-5-Clause
 */

#ifndef _SPP_DEMO_APP_H_
#define _SPP_DEMO_APP_H_

#ifdef __cplusplus
extern "C" {
#endif /* __cplusplus */

void spp_demo_app_init(void);

void spp_demo_app_tx_data(uint8_t *bd_addr, uint8_t *buf, uint8_t len);

void spp_demo_app_connect_req(uint8_t *bd_addr);

void spp_demo_app_disconnect_all_req(uint8_t *bd_addr);

void spp_demo_app_disconnect_req(uint8_t *bd_addr, uint8_t local_server_chann);

#ifdef __cplusplus
}
#endif /* __cplusplus */

#endif /* _SPP_DEMO_APP_H_ */
```

## src/app_bt_spp_demo_console.c
```c
/*
 * Copyright (c) 2026, Realtek Semiconductor Corporation
 *
 * SPDX-License-Identifier: LicenseRef-Realtek-5-Clause
 */

#include <stdio.h>
#include <stdlib.h>
#include <stdint.h>
#include <stdbool.h>
#include <string.h>
#include "trace.h"
#include "cli.h"
#include "bt_types.h"
#include "app_io_msg.h"
#include "app_bt_spp_demo_console.h"

bool app_spp_demo_send_msg(T_IO_CONSOLE subtype, void *param_buf)
{
    T_IO_MSG msg;

    msg.type    = IO_MSG_TYPE_CONSOLE;
    msg.subtype = subtype;
    msg.u.buf   = param_buf;

    return app_io_send_msg(&msg);
}

bool console_spp(const char *cmd_str, char *buf, size_t buf_len)
{
    char       *subcmd;
    char       *p_param;
    int32_t     param_num;
    uint32_t    param_len;
    uint8_t     action;
    uint8_t     addr[6];
    uint8_t     i;
    uint8_t     local_server_chann;
    void       *param_buf;
    char       *spp_data;
    uint8_t     data_len = 0;
    uint8_t    *temp_buf;

    param_num = cli_param_num_get(cmd_str);
    if (param_num < 1)
    {
        subcmd = (char *)cmd_str;
        goto err;
    }

    subcmd = (char *)cli_param_get(cmd_str, 1, &param_len);
    subcmd[param_len] = '\0';

    if (!strcmp(subcmd, "connect"))
    {
        if (param_num != 7)
        {
            goto err;
        }

        p_param = subcmd + param_len + 1;

        for (i = 0; i < 6; i++)
        {
            addr[i] = (uint8_t)strtol(cli_param_get(p_param, i, &param_len), NULL, 0);
        }

        action = SPP_DEMO_ACTION_CONNECT;
    }
    else if (!strcmp(subcmd, "disconnect"))
    {
        if (param_num != 8)
        {
            goto err;
        }

        p_param = subcmd + param_len + 1;
        local_server_chann = (uint8_t)strtol(cli_param_get(p_param, 0, &param_len), NULL, 0);

        p_param += param_len + 1;
        for (i = 0; i < 6; i++)
        {
            addr[i] = (uint8_t)strtol(cli_param_get(p_param, i, &param_len), NULL, 0);
        }

        action = SPP_DEMO_ACTION_DISCONNECT;
    }
    else if (!strcmp(subcmd, "disconnect_all"))
    {
        if (param_num != 7)
        {
            goto err;
        }

        p_param = subcmd + param_len + 1;

        for (i = 0; i < 6; i++)
        {
            addr[i] = (uint8_t)strtol(cli_param_get(p_param, i, &param_len), NULL, 0);
        }

        action = SPP_DEMO_ACTION_DISCONNECT_ALL;
    }
    else if (!strcmp(subcmd, "send_data"))
    {
        p_param = subcmd + param_len + 1;
        spp_data = p_param;

        for (i = 0; i < 6; i++)
        {
            addr[i] = (uint8_t)strtol(cli_param_get(p_param, i, &param_len), NULL, 0);
            spp_data = spp_data + param_len + 1;
        }

        data_len = param_num - 7;
        temp_buf = malloc(sizeof(uint8_t) * data_len);
        if (temp_buf != NULL)
        {
            for (i = 0; i < data_len; i++)
            {
                temp_buf[i] = (uint8_t)strtol(cli_param_get(spp_data, i, &param_len), NULL, 0);
            }
        }

        action = SPP_DEMO_ACTION_SEND_DATA;
    }
    else
    {
        goto err;
    }

    param_buf = malloc(40 + data_len);
    if (param_buf != NULL)
    {
        uint8_t    *p;

        p = param_buf;
        LE_UINT16_TO_STREAM(p, SPP_ID);
        LE_UINT8_TO_STREAM(p, action);

        if (action == SPP_DEMO_ACTION_DISCONNECT)
        {
            LE_UINT8_TO_STREAM(p, local_server_chann);
        }

        ARRAY_TO_STREAM(p, addr, 6);

        if (action == SPP_DEMO_ACTION_SEND_DATA)
        {
            LE_UINT8_TO_STREAM(p, data_len);
            ARRAY_TO_STREAM(p, temp_buf, data_len);
            free(temp_buf);
        }

        if (app_spp_demo_send_msg(IO_MSG_CONSOLE_STRING_RX, param_buf) == false)
        {
            free(param_buf);
            goto err;
        }

        snprintf(buf, buf_len, "SPP %s from spp demo.\r\n", subcmd);
    }

    return false;

err:
    snprintf(buf, buf_len, "Invalid param %s.\r\n", subcmd);
    return false;
}

static T_CLI_CMD spp_demo_cmd =
{
    NULL,           /* Next command pointed to NULL. */
    NULL,           /* Next subcommand. */
    "spp",          /* The command string to type. */
    "\r\nspp:\r\n spp demo start\r\n\r\n",
    console_spp,    /* The function to run. */
    -1              /* Zero or more parameters are expected. */
};

void app_spp_demo_cmd_register(void)
{
    cli_cmd_register(&spp_demo_cmd);
}
```

## src/app_bt_spp_demo_console.h
```c
/*
 * Copyright (c) 2026, Realtek Semiconductor Corporation
 *
 * SPDX-License-Identifier: LicenseRef-Realtek-5-Clause
 */

#ifndef _SPP_DEMO_CONSOLE_H_
#define _SPP_DEMO_CONSOLE_H_

#ifdef __cplusplus
extern "C" {
#endif /* __cplusplus */

typedef enum
{
    GAP_ID = 0x0001,
    SPP_ID = 0x0002,
} T_SPP_DEMO_CMD_ID;

#define SPP_DEMO_ACTION_CONNECT             0x01
#define SPP_DEMO_ACTION_DISCONNECT          0x02
#define SPP_DEMO_ACTION_DISCONNECT_ALL      0x03
#define SPP_DEMO_ACTION_SEND_DATA           0x04

void app_spp_demo_cmd_register(void);


#ifdef __cplusplus
}
#endif /* __cplusplus */

#endif
```

## src/app_bt_spp_demo_gap.c
```c
/*
 * Copyright (c) 2026, Realtek Semiconductor Corporation
 *
 * SPDX-License-Identifier: LicenseRef-Realtek-5-Clause
 */

#include <string.h>
#include "trace.h"
#include "gap.h"
#include "btm.h"
#include "bt_bond.h"
#include "bt_spp.h"
#include "gap_br.h"
#include "app_bt_spp_demo_gap.h"
#include "app_bt_spp_demo_sdp.h"
#include "app_bt_spp_demo_link.h"

static bool is_spp_sdp_ok = false;
static uint8_t remote_server_channel = 0;
static uint8_t local_server_chann = 0;

static void spp_demo_gap_bt_cback(T_BT_EVENT event_type, void *event_buf, uint16_t buf_len)
{
    T_BT_EVENT_PARAM *param = event_buf;
    T_SPP_DEMO_LINK *p_link;
    bool handle = true;

    switch (event_type)
    {
    case BT_EVENT_READY:
        {

        }
        break;

    case BT_EVENT_INQUIRY_RESULT:
        {

        }
        break;

    case BT_EVENT_ACL_CONN_IND:
        {
            p_link = spp_demo_find_link(param->acl_conn_ind.bd_addr);
            if (p_link != NULL)
            {
                bt_acl_conn_reject(param->acl_conn_ind.bd_addr, BT_ACL_REJECT_UNACCEPTABLE_ADDR);
            }
            else
            {
                bt_acl_conn_accept(param->acl_conn_ind.bd_addr, BT_LINK_ROLE_SLAVE);
            }
        }
        break;

    case BT_EVENT_LINK_KEY_REQ:
        {
            uint8_t link_key[16];
            T_BT_LINK_KEY_TYPE type;

            if (bt_bond_key_get(param->link_key_req.bd_addr, link_key, (uint8_t *)&type))
            {
                bt_link_key_cfm(param->link_key_req.bd_addr, true, type, link_key);
            }
            else
            {
                bt_link_key_cfm(param->link_key_req.bd_addr, false, type, link_key);
            }
        }
        break;

    case BT_EVENT_LINK_PIN_CODE_REQ:
        {
            uint8_t pin_code[4] = {1, 2, 3, 4};
            bt_link_pin_code_cfm(param->link_pin_code_req.bd_addr, pin_code, 4, true);
        }
        break;

    case BT_EVENT_LINK_KEY_INFO:
        break;

    case BT_EVENT_LINK_USER_CONFIRMATION_REQ:
        {
            gap_br_user_cfm_req_cfm(param->link_user_confirmation_req.bd_addr, GAP_CFM_CAUSE_ACCEPT);
        }
        break;

    case BT_EVENT_ACL_CONN_SUCCESS:
        {
            spp_demo_alloc_link(param->acl_conn_success.bd_addr);
        }
        break;

    case BT_EVENT_ACL_CONN_DISCONN:
        {
            p_link = spp_demo_find_link(param->acl_conn_disconn.bd_addr);
            if (p_link != NULL)
            {
                spp_demo_free_link(p_link);
            }
        }
        break;

    case BT_EVENT_SDP_ATTR_INFO:
        {
            p_link = spp_demo_find_link(param->sdp_attr_info.bd_addr);
            if (p_link != NULL)
            {
                uint8_t temp_local_server_chann = 0;

                if (bt_spp_registered_uuid_check((T_BT_SPP_UUID_TYPE)param->sdp_attr_info.info.srv_class_uuid_type,
                                                 (T_BT_SPP_UUID_DATA *)(&param->sdp_attr_info.info.srv_class_uuid_data), &temp_local_server_chann))
                {
                    is_spp_sdp_ok = true;
                    local_server_chann = temp_local_server_chann;
                    remote_server_channel = param->sdp_attr_info.info.server_channel;
                }
            }
        }
        break;

    case BT_EVENT_SDP_DISCOV_CMPL:
        {
            p_link = spp_demo_find_link(param->sdp_discov_cmpl.bd_addr);
            if (p_link != NULL)
            {
                if (is_spp_sdp_ok)
                {
                    if (param->sdp_discov_cmpl.cause == 0x00)
                    {
                        is_spp_sdp_ok = false;
                        bt_spp_connect_req(param->sdp_discov_cmpl.bd_addr, remote_server_channel,
                                           SPP_DEMO_SPP_DEFAULT_MTU_SIZE,
                                           SPP_DEMO_SPP_DEFAULT_CREDITS,
                                           local_server_chann);
                    }
                }
            }
        }
        break;

    default:
        handle = false;
        break;
    }

    if (handle == true)
    {
        APP_PRINT_INFO1("spp_demo_gap_bt_cback: event_type 0x%04x", event_type);
    }
}

void spp_demo_gap_init(void)
{
    bt_mgr_cback_register(spp_demo_gap_bt_cback);
}
```

## src/app_bt_spp_demo_gap.h
```c
/*
 * Copyright (c) 2026, Realtek Semiconductor Corporation
 *
 * SPDX-License-Identifier: LicenseRef-Realtek-5-Clause
 */

#ifndef _SPP_DEMO_GAP_H_
#define _SPP_DEMO_GAP_H_

#ifdef __cplusplus
extern "C" {
#endif /* __cplusplus */

/** @defgroup SPP_DEMO_GAP SPP Demo Gap
  * @brief SPP Demo Gap
  * @{
  */

/*============================================================================*
 *                              Functions
 *============================================================================*/
/** @defgroup SPP_DEMO_GAP_Exported_Functions SPP Demo Gap Functions
    * @{
    */
/**
    * @brief  gap module init.
    * @param  void
    * @return void
    */
void spp_demo_gap_init(void);

/** @} End of SPP_DEMO_GAP_Exported_Functions */

/** @} End of SPP_DEMO_GAP */

#ifdef __cplusplus
}
#endif /* __cplusplus */

#endif /* _SPP_DEMO_GAP_H_ */
```

## src/app_bt_spp_demo_link.c
```c
/*
 * Copyright (c) 2026, Realtek Semiconductor Corporation
 *
 * SPDX-License-Identifier: LicenseRef-Realtek-5-Clause
 */

#include <string.h>
#include <stdlib.h>
#include <stdint.h>
#include <stdbool.h>
#include "trace.h"
#include "bt_types.h"
#include "os_queue.h"
#include "app_bt_spp_demo_link.h"

typedef struct t_spp_demo_app_db
{
    T_OS_QUEUE link_list;
} T_SPP_DEMO_APP_DB;

static T_SPP_DEMO_APP_DB *app_db;

T_SPP_SERVICE *spp_demo_find_service(uint8_t bd_addr[6],
                                     uint8_t local_server_chann)
{
    T_SPP_DEMO_LINK *link;
    T_SPP_SERVICE   *service = NULL;

    link = os_queue_peek(&app_db->link_list, 0);
    while (link != NULL)
    {
        if (!memcmp(link->bd_addr, bd_addr, 6))
        {
            service = os_queue_peek(&link->service_list, 0);
            while (service != NULL)
            {
                if (service->local_server_chann == local_server_chann)
                {
                    return service;
                }

                service = service->next;
            }
        }

        link = link->next;
    }

    return service;
}

T_SPP_SERVICE *spp_demo_alloc_service(uint8_t *bd_addr, uint8_t local_server_chann)
{
    T_SPP_DEMO_LINK *link;
    T_SPP_SERVICE   *service = NULL;

    link = spp_demo_find_link(bd_addr);
    if (link != NULL)
    {
        service = calloc(1, (sizeof(T_SPP_SERVICE)));
        if (service != NULL)
        {
            service->local_server_chann = local_server_chann;
            os_queue_in(&link->service_list, service);
        }
    }

    return service;
}

void spp_demo_free_service(uint8_t *bd_addr, T_SPP_SERVICE *service)
{
    T_SPP_DEMO_LINK *link;

    link = spp_demo_find_link(bd_addr);
    if (link != NULL)
    {
        if (os_queue_delete(&link->service_list, service) == true)
        {
            free(service);
        }
    }
}

T_SPP_DEMO_LINK *spp_demo_find_link(uint8_t *bd_addr)
{
    T_SPP_DEMO_LINK *link;

    link = os_queue_peek(&app_db->link_list, 0);
    while (link != NULL)
    {
        if (!memcmp(link->bd_addr, bd_addr, 6))
        {
            break;
        }

        link = link->next;
    }

    return link;
}

T_SPP_DEMO_LINK *spp_demo_alloc_link(uint8_t *bd_addr)
{
    T_SPP_DEMO_LINK *link;

    link = calloc(1, sizeof(T_SPP_DEMO_LINK));
    if (link != NULL)
    {
        memcpy(link->bd_addr, bd_addr, 6);
        os_queue_in(&app_db->link_list, link);
    }

    return link;
}

void spp_demo_free_link(T_SPP_DEMO_LINK *link)
{
    T_SPP_SERVICE *service;

    service = os_queue_out(&link->service_list);
    while (service != NULL)
    {
        spp_demo_free_service(link->bd_addr, service);
        service = os_queue_out(&link->service_list);
    }

    if (os_queue_delete(&app_db->link_list, link) == true)
    {
        free(link);
    }
}

void spp_demo_int(void)
{
    app_db = calloc(1, sizeof(T_SPP_DEMO_APP_DB));
}
```

## src/app_bt_spp_demo_link.h
```c
/*
 * Copyright (c) 2026, Realtek Semiconductor Corporation
 *
 * SPDX-License-Identifier: LicenseRef-Realtek-5-Clause
 */

#ifndef _SPP_DEMO_LINK_H_
#define _SPP_DEMO_LINK_H_

#include <stdint.h>
#include <stdbool.h>
#include "os_queue.h"

#ifdef __cplusplus
extern "C" {
#endif /* __cplusplus */

typedef struct t_spp_service
{
    struct t_spp_service   *next;
    uint16_t                frame_size;
    uint8_t                 credit;
    uint8_t                 local_server_chann;
} T_SPP_SERVICE;

typedef struct t_spp_demo_link
{
    struct t_spp_demo_link *next;
    uint8_t                 bd_addr[6];
    T_OS_QUEUE              service_list;
} T_SPP_DEMO_LINK;

T_SPP_SERVICE *spp_demo_find_service(uint8_t bd_addr[6],
                                     uint8_t local_server_chann);

T_SPP_SERVICE *spp_demo_alloc_service(uint8_t *bd_addr, uint8_t local_server_chann);

void spp_demo_free_service(uint8_t *bd_addr, T_SPP_SERVICE *service);

T_SPP_DEMO_LINK *spp_demo_find_link(uint8_t *bd_addr);

T_SPP_DEMO_LINK *spp_demo_alloc_link(uint8_t *bd_addr);

void spp_demo_free_link(T_SPP_DEMO_LINK *link);

void spp_demo_int(void);

#ifdef __cplusplus
}
#endif /* __cplusplus */

#endif /* _SPP_DEMO_LINK_H_ */
```

## src/app_bt_spp_demo_main.c
```c
/*
 * Copyright (c) 2026, Realtek Semiconductor Corporation
 *
 * SPDX-License-Identifier: LicenseRef-Realtek-5-Clause
 */

#include "os_task.h"
#include "os_mem.h"
#include "os_sched.h"
#include "os_msg.h"
#include "trace.h"
#include "rtl876x_pinmux.h"
#include "rtl876x_uart.h"
#include "gap.h"
#include "gap_br.h"
#include "btm.h"
#include "sysm.h"
#include "remote.h"
#include "app_msg.h"
#include "app_io_msg.h"
#include "hrp_uart.h"
#include "app_bt_spp_demo_console.h"
#include "app_bt_spp_demo_gap.h"
#include "app_bt_spp_demo_app.h"
#include "app_bt_spp_demo_sdp.h"

#define SPP_DEMO_UART_TX          P3_1
#define SPP_DEMO_UART_RX          P3_0

#define SPP_DEMO_DEFAULT_PAGESCAN_WINDOW             0x12
#define SPP_DEMO_DEFAULT_PAGESCAN_INTERVAL           0x800
#define SPP_DEMO_DEFAULT_PAGE_TIMEOUT                0x4000
#define SPP_DEMO_DEFAULT_SUPVISIONTIMEOUT            0x1f40
#define SPP_DEMO_DEFAULT_INQUIRYSCAN_WINDOW          0x12
#define SPP_DEMO_DEFAULT_INQUIRYSCAN_INTERVAL        0x800

#define SPP_DEMO_MAX_NUMBER_OF_GAP_MESSAGE     0x20
#define SPP_DEMO_MAX_NUMBER_OF_IO_MESSAGE      0x20
#define SPP_DEMO_MAX_NUMBER_OF_EVENT_MESSAGE   (SPP_DEMO_MAX_NUMBER_OF_GAP_MESSAGE + SPP_DEMO_MAX_NUMBER_OF_IO_MESSAGE)

#define CONSOLE_UART_RX_BUFFER_SIZE         300

#if SPP_DEMO_SERVER_ROLE
static uint8_t bd_addr_spp_server[6]  = {0x11, 0x22, 0x66, 0x77, 0x77, 0x88};
#else
static uint8_t bd_addr_spp_client[6]  = {0x11, 0x22, 0x55, 0x77, 0x88, 0x99};
#endif

void *spp_demo_evt_queue_handle;
void *spp_demo_io_queue_handle;


static void app_bt_gap_init(void)
{
    uint32_t class_of_device = (uint32_t)(0x18 | (0x04 << 8) | (0x24 << 16));
    uint16_t supervision_timeout = SPP_DEMO_DEFAULT_SUPVISIONTIMEOUT;

    uint16_t link_policy = GAP_LINK_POLICY_ROLE_SWITCH | GAP_LINK_POLICY_SNIFF_MODE;

    uint8_t radio_mode = GAP_RADIO_MODE_VISIBLE_CONNECTABLE;
    bool limited_discoverable = false;
    bool auto_accept_acl = false;

    uint8_t pagescan_type = GAP_RADIO_MODE_VISIBLE_CONNECTABLE;
    uint16_t pagescan_interval = SPP_DEMO_DEFAULT_PAGESCAN_INTERVAL;
    uint16_t pagescan_window = SPP_DEMO_DEFAULT_PAGESCAN_WINDOW;
    uint16_t page_timeout = SPP_DEMO_DEFAULT_PAGE_TIMEOUT;

    uint8_t inquiryscan_type = GAP_INQUIRY_SCAN_TYPE_STANDARD;
    uint16_t inquiryscan_window = SPP_DEMO_DEFAULT_INQUIRYSCAN_WINDOW;
    uint16_t inquiryscan_interval = SPP_DEMO_DEFAULT_INQUIRYSCAN_INTERVAL;
    uint8_t inquiry_mode = GAP_INQUIRY_MODE_EXTENDED_RESULT;

    uint8_t pair_mode = GAP_PAIRING_MODE_PAIRABLE;
    uint16_t auth_flags = GAP_AUTHEN_BIT_GENERAL_BONDING_FLAG | GAP_AUTHEN_BIT_SC_FLAG;
    uint8_t io_cap = GAP_IO_CAP_NO_INPUT_NO_OUTPUT;
    uint8_t oob_enable = false;
    uint8_t bt_mode = GAP_BT_MODE_21ENABLED;

    gap_lib_init();

    gap_set_param(GAP_PARAM_BOND_PAIRING_MODE, sizeof(uint8_t), &pair_mode);
    gap_set_param(GAP_PARAM_BOND_AUTHEN_REQUIREMENTS_FLAGS, sizeof(uint16_t), &auth_flags);
    gap_set_param(GAP_PARAM_BOND_IO_CAPABILITIES, sizeof(uint8_t), &io_cap);
    gap_set_param(GAP_PARAM_BOND_OOB_ENABLED, sizeof(uint8_t), &oob_enable);

    gap_br_set_param(GAP_BR_PARAM_BT_MODE, sizeof(uint8_t), &bt_mode);
    gap_br_set_param(GAP_BR_PARAM_COD, sizeof(uint32_t), &class_of_device);
    gap_br_set_param(GAP_BR_PARAM_LINK_POLICY, sizeof(uint16_t), &link_policy);
    gap_br_set_param(GAP_BR_PARAM_SUPV_TOUT, sizeof(uint16_t), &supervision_timeout);
    gap_br_set_param(GAP_BR_PARAM_AUTO_ACCEPT_ACL, sizeof(bool), &auto_accept_acl);

    gap_br_set_param(GAP_BR_PARAM_RADIO_MODE, sizeof(uint8_t), &radio_mode);
    gap_br_set_param(GAP_BR_PARAM_LIMIT_DISCOV, sizeof(bool), &limited_discoverable);

    gap_br_set_param(GAP_BR_PARAM_PAGE_SCAN_TYPE, sizeof(uint8_t), &pagescan_type);
    gap_br_set_param(GAP_BR_PARAM_PAGE_SCAN_INTERVAL, sizeof(uint16_t), &pagescan_interval);
    gap_br_set_param(GAP_BR_PARAM_PAGE_SCAN_WINDOW, sizeof(uint16_t), &pagescan_window);
    gap_br_set_param(GAP_BR_PARAM_PAGE_TIMEOUT, sizeof(uint16_t), &page_timeout);

    gap_br_set_param(GAP_BR_PARAM_INQUIRY_SCAN_TYPE, sizeof(uint8_t), &inquiryscan_type);
    gap_br_set_param(GAP_BR_PARAM_INQUIRY_SCAN_INTERVAL, sizeof(uint16_t), &inquiryscan_interval);
    gap_br_set_param(GAP_BR_PARAM_INQUIRY_SCAN_WINDOW, sizeof(uint16_t), &inquiryscan_window);
    gap_br_set_param(GAP_BR_PARAM_INQUIRY_MODE, sizeof(uint8_t), &inquiry_mode);

#if SPP_DEMO_SERVER_ROLE
    gap_set_bd_addr(bd_addr_spp_server);
    gap_br_set_param(GAP_BR_PARAM_NAME, GAP_DEVICE_NAME_LEN, "spp server");
    gap_br_cfg_accept_role(0);
#else
    gap_set_bd_addr(bd_addr_spp_client);
    gap_br_set_param(GAP_BR_PARAM_NAME, GAP_DEVICE_NAME_LEN, "spp client");
    gap_br_cfg_accept_role(1);
#endif
}

static void framework_init(void)
{
    sys_mgr_init(spp_demo_evt_queue_handle);
    remote_mgr_init(REMOTE_SESSION_ROLE_SINGLE);
    bt_mgr_init();
}

static void driver_init(void)
{
    T_CONSOLE_PARAM console_param;
    T_CONSOLE_OP    console_op;

    console_param.tx_buf_size   = 512;
    console_param.rx_buf_size   = 512;
    console_param.tx_wakeup_pin = SPP_DEMO_UART_TX;
    console_param.rx_wakeup_pin = SPP_DEMO_UART_RX;

    console_op.init = hrp_uart_init;
    console_op.tx_wakeup_enable = NULL;
    console_op.rx_wakeup_enable = NULL;
    console_op.write = hrp_uart_tx;
    console_op.wakeup = NULL;

    console_init(&console_param, &console_op);
    console_set_mode(CONSOLE_MODE_STRING);
}

void spp_demo_main_task(void *p_param)
{
    uint8_t event;

    gap_start_bt_stack(spp_demo_evt_queue_handle, spp_demo_io_queue_handle,
                       SPP_DEMO_MAX_NUMBER_OF_GAP_MESSAGE);

    while (true)
    {
        if (os_msg_recv(spp_demo_evt_queue_handle, &event, 0xFFFFFFFF) == true)
        {
            if (EVENT_GROUP(event) == EVENT_GROUP_IO)
            {
                T_IO_MSG io_msg;

                if (os_msg_recv(spp_demo_io_queue_handle, &io_msg, 0) == true)
                {
                    if (event == EVENT_IO_TO_APP)
                    {
                        app_io_handle_msg(io_msg);
                    }
                }
            }
            else if (EVENT_GROUP(event) == EVENT_GROUP_STACK)
            {
                gap_handle_msg(event);
            }
            else if (EVENT_GROUP(event) == EVENT_GROUP_FRAMEWORK)
            {
                sys_mgr_event_handle(event);
            }
        }
    }
}

void task_init(void)
{
    void *app_task_handle;

    os_msg_queue_create(&spp_demo_io_queue_handle, "ioQ", SPP_DEMO_MAX_NUMBER_OF_IO_MESSAGE,
                        sizeof(T_IO_MSG));
    os_msg_queue_create(&spp_demo_evt_queue_handle, "evtQ", SPP_DEMO_MAX_NUMBER_OF_EVENT_MESSAGE,
                        sizeof(unsigned char));

    os_task_create(&app_task_handle, "spp_demo_main_task", spp_demo_main_task, NULL, 1024 * 3, 1);
}

int main(void)
{
    driver_init();
    task_init();
    framework_init();
    app_bt_gap_init();
    spp_demo_gap_init();
    spp_demo_sdp_init();
    spp_demo_app_init();
    app_spp_demo_cmd_register();

    os_sched_start();

    return 0;
}
```

## src/app_bt_spp_demo_sdp.c
```c
/*
 * Copyright (c) 2026, Realtek Semiconductor Corporation
 *
 * SPDX-License-Identifier: LicenseRef-Realtek-5-Clause
 */

#include <stdint.h>
#include "trace.h"
#include "gap_br.h"
#include "app_bt_spp_demo_sdp.h"
#include "bt_sdp.h"

/**
  * @brief  SPP local SDP record.
  * @return void
  */
const uint8_t spp_demo_sdp_record[] =
{
    SDP_DATA_ELEM_SEQ_HDR,
    0x4C,
    //attribute SDP_ATTR_SRV_CLASS_ID_LIST
    SDP_UNSIGNED_TWO_BYTE,
    (uint8_t)(SDP_ATTR_SRV_CLASS_ID_LIST >> 8),
    (uint8_t)SDP_ATTR_SRV_CLASS_ID_LIST,
    SDP_DATA_ELEM_SEQ_HDR,
    0x03,
    SDP_UUID16_HDR,
    (uint8_t)(UUID_SERIAL_PORT >> 8),
    (uint8_t)(UUID_SERIAL_PORT),

    //attribute SDP_ATTR_PROTO_DESC_LIST
    SDP_UNSIGNED_TWO_BYTE,
    (uint8_t)(SDP_ATTR_PROTO_DESC_LIST >> 8),
    (uint8_t)SDP_ATTR_PROTO_DESC_LIST,
    SDP_DATA_ELEM_SEQ_HDR,
    0x0c,
    SDP_DATA_ELEM_SEQ_HDR,
    03,
    SDP_UUID16_HDR,
    (uint8_t)(UUID_L2CAP >> 8),
    (uint8_t)UUID_L2CAP,
    SDP_DATA_ELEM_SEQ_HDR,
    0x05,
    SDP_UUID16_HDR,
    (uint8_t)(UUID_RFCOMM >> 8),
    (uint8_t)UUID_RFCOMM,
    SDP_UNSIGNED_ONE_BYTE,
    SPP_DEMO_RFC_SPP_CHANN_NUM,

    //attribute SDP_ATTR_BROWSE_GROUP_LIST
    SDP_UNSIGNED_TWO_BYTE,
    (uint8_t)(SDP_ATTR_BROWSE_GROUP_LIST >> 8),
    (uint8_t)SDP_ATTR_BROWSE_GROUP_LIST,
    SDP_DATA_ELEM_SEQ_HDR,
    0x03,
    SDP_UUID16_HDR,
    (uint8_t)(UUID_PUBLIC_BROWSE_GROUP >> 8),
    (uint8_t)UUID_PUBLIC_BROWSE_GROUP,

    //attribute SDP_ATTR_LANG_BASE_ATTR_ID_LIST
    SDP_UNSIGNED_TWO_BYTE,
    (uint8_t)(SDP_ATTR_LANG_BASE_ATTR_ID_LIST >> 8),
    (uint8_t)SDP_ATTR_LANG_BASE_ATTR_ID_LIST,
    SDP_DATA_ELEM_SEQ_HDR,
    0x09,
    SDP_UNSIGNED_TWO_BYTE,
    (uint8_t)(SDP_LANG_ENGLISH >> 8),
    (uint8_t)SDP_LANG_ENGLISH,
    SDP_UNSIGNED_TWO_BYTE,
    (uint8_t)(SDP_CHARACTER_UTF8 >> 8),
    (uint8_t)SDP_CHARACTER_UTF8,
    SDP_UNSIGNED_TWO_BYTE,
    (uint8_t)(SDP_BASE_LANG_OFFSET >> 8),
    (uint8_t)SDP_BASE_LANG_OFFSET,

    //attribute SDP_ATTR_PROFILE_DESC_LIST
    SDP_UNSIGNED_TWO_BYTE,
    (uint8_t)(SDP_ATTR_PROFILE_DESC_LIST >> 8),
    (uint8_t)SDP_ATTR_PROFILE_DESC_LIST,
    SDP_DATA_ELEM_SEQ_HDR,
    0x08,
    SDP_DATA_ELEM_SEQ_HDR,
    0x06,
    SDP_UUID16_HDR,
    (uint8_t)(UUID_SERIAL_PORT >> 8),
    (uint8_t)UUID_SERIAL_PORT,
    SDP_UNSIGNED_TWO_BYTE,
    0x01,//version 1.2
    0x02,

    //attribute SDP_ATTR_SRV_NAME
    SDP_UNSIGNED_TWO_BYTE,
    (uint8_t)((SDP_ATTR_SRV_NAME + SDP_BASE_LANG_OFFSET) >> 8),
    (uint8_t)(SDP_ATTR_SRV_NAME + SDP_BASE_LANG_OFFSET),
    SDP_STRING_HDR,
    0x0B,
    0x73, 0x65, 0x72, 0x69, 0x61, 0x6c, 0x20, 0x70, 0x6f, 0x72, 0x74 //"serial port"
};

void spp_demo_sdp_init(void)
{
    bt_sdp_record_add((void *)spp_demo_sdp_record);
}
```

## src/app_bt_spp_demo_sdp.h
```c
/*
 * Copyright (c) 2026, Realtek Semiconductor Corporation
 *
 * SPDX-License-Identifier: LicenseRef-Realtek-5-Clause
 */

#ifndef _SPP_DEMO_SDP_H_
#define _SPP_DEMO_SDP_H_

#ifdef __cplusplus
extern "C" {
#endif /* __cplusplus */

/** @defgroup SPP_DEMO_SDP SPP Demo SDP
* @brief SPP Demo SDP
* @{
*/

/*============================================================================*
 *                         Macros
 *============================================================================*/
/** @addtogroup SPP_DEMO_SDP_Exported_Macros SPP Demo SDP Exported Macros
  * @brief
  * @{
  */

/**
* @brief Define SPP default l2cap mtu size
* @note  SPP application may send tx data lower than SPP mtu size at a time
*/
#define SPP_DEMO_SPP_DEFAULT_MTU_SIZE 1012
/**
* @brief Define SPP default local tx window size
* @note  SPP application should send tx data when SPP link credit is not zero
*
*/
#define SPP_DEMO_SPP_DEFAULT_CREDITS 7
/**
* @brief Define SPP local server channel
* @note  SPP service num may be different in different SPP applications
*
*/
#define SPP_DEMO_RFC_SPP_CHANN_NUM 0x3

/**
* @brief Define vendor SPP local server channel
* @note  SPP service num may be different in different SPP applications
*
*/
#define SPP_DEMO_RFC_VENDOR_SPP_CHANN_NUM 0x4

/** End of SPP_DEMO_SDP_Exported_Macros
* @}
*/

/*============================================================================*
 *                         Functions
 *============================================================================*/
/** @defgroup SPP_DEMO_SDP_Exported_Functions SPP Demo SDP Exported Functions
  * @brief
  * @{
  */

/**
    * @brief  SPP SDP init
    * @param  void
    * @return void
    */
void spp_demo_sdp_init(void);

/** @} End of SPP_DEMO_SDP_Exported_Functions */

/** @} End of SPP_DEMO_SDP */

#ifdef __cplusplus
}
#endif /* __cplusplus */

#endif /* _SPP_DEMO_SDP_H_ */
```

## src/app_console_msg.c
```c
/*
 * Copyright (c) 2026, Realtek Semiconductor Corporation
 *
 * SPDX-License-Identifier: LicenseRef-Realtek-5-Clause
 */

#include <string.h>
#include <stdlib.h>
#include "trace.h"
#include "bt_types.h"
#include "app_msg.h"
#include "app_console_msg.h"
#include "app_bt_spp_demo_console.h"
#include "app_bt_spp_demo_app.h"

void app_console_handle_msg(T_IO_MSG console_msg)
{
    uint16_t  subtype;
    uint16_t  id;
    uint16_t  action;
    uint8_t  *p;

    p       = console_msg.u.buf;
    subtype = console_msg.subtype;

    switch (subtype)
    {
    case IO_MSG_CONSOLE_STRING_RX:
        LE_STREAM_TO_UINT16(id, p);
        LE_STREAM_TO_UINT8(action, p);

        if (id == GAP_ID)
        {

        }
        else if (id == SPP_ID)
        {
            switch (action)
            {
            case SPP_DEMO_ACTION_CONNECT:
                {
                    spp_demo_app_connect_req(p);
                }
                break;

            case SPP_DEMO_ACTION_DISCONNECT:
                {
                    uint8_t local_server_chann;

                    LE_STREAM_TO_UINT8(local_server_chann, p);
                    spp_demo_app_disconnect_req(p, local_server_chann);
                }
                break;

            case SPP_DEMO_ACTION_DISCONNECT_ALL:
                spp_demo_app_disconnect_all_req(p);
                break;

            case SPP_DEMO_ACTION_SEND_DATA:
                {
                    uint8_t  addr[6];
                    uint8_t  i;
                    uint8_t  data_len;

                    for (i = 0; i < 6; i++)
                    {
                        LE_STREAM_TO_UINT8(addr[i], p);
                    }

                    LE_STREAM_TO_UINT8(data_len, p);

                    spp_demo_app_tx_data(addr, p, data_len);
                }
                break;

            default:
                break;
            }
        }

        free(console_msg.u.buf);
        break;

    default:
        break;
    }
}
```
