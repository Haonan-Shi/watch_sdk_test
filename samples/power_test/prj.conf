## CMakeLists.txt
```
#
# Copyright (c) 2026, Realtek Semiconductor Corporation
#
# SPDX-License-Identifier: LicenseRef-Realtek-5-Clause
#

message(STATUS "CMAKELIST FOLDER: ${CMAKE_CURRENT_SOURCE_DIR}")

cmake_minimum_required(VERSION 3.20.0)

#===========version generation===========
include(${CMAKE_CURRENT_SOURCE_DIR}/../../cmake/version_generate.cmake)
generate_version()
#===========version generation===========
#===========post build===========
# post build should be called before find_package
include(${CMAKE_CURRENT_SOURCE_DIR}/../../cmake/post_build.cmake)
rtk_post_build()
#===========post build===========

find_package(Zephyr REQUIRED HINTS $ENV{ZEPHYR_BASE})
project(power_test)

# app sources (non-recursive glob)
FILE(GLOB app_sources src/*.c src/power_test/*.c)
target_sources(app PRIVATE
  ${app_sources}
  )

# flash_map.h selected by the applied flash-size snippet (e.g. -S flash_8M_bank0);
# defaults to 16M when no flash snippet is given, matching bt_audio_trx.
set(flash_map_source_dir src/flashmap/single_bank_16M)
foreach(snippet ${SNIPPET})
  if(snippet MATCHES "flash_4M")
    set(flash_map_source_dir src/flashmap/4M)
    break()
  elseif(snippet MATCHES "flash_8M")
    set(flash_map_source_dir src/flashmap/8M)
    break()
  elseif(snippet MATCHES "flash_16M")
    set(flash_map_source_dir src/flashmap/16M)
    break()
  endif()
endforeach()
message(STATUS "flash map dir: ${flash_map_source_dir}")

set(sources
   )

set(headers
    #header files from app
    src/
    src/power_test
    ${flash_map_source_dir}
    #header files from libs
    ${ZEPHYR_REALTEK_APP_MODULE_DIR}/../modules/hal/realtek/rtl87x3g/subsys/audio/inc
    ${ZEPHYR_REALTEK_APP_MODULE_DIR}/../modules/hal/realtek/rtl87x3g/subsys/console/inc
    ${ZEPHYR_REALTEK_APP_MODULE_DIR}/../modules/hal/realtek/rtl87x3g/subsys/bluetooth/ble_mgr/inc
    ${ZEPHYR_REALTEK_APP_MODULE_DIR}/common/console/transport
    ${ZEPHYR_REALTEK_APP_MODULE_DIR}/samples/power_test
    )

foreach(header ${headers})
    if(EXISTS ${header})
        zephyr_include_directories(${header})
    else()
        message(FATAL_ERROR "header file directory does not exist: ${header}. Current cmakelist: ${CMAKE_CURRENT_SOURCE_DIR}")
    endif()
endforeach()

foreach(src ${sources})
    if(EXISTS ${src})
        target_sources(app PRIVATE ${src})
    else()
        message(FATAL_ERROR "source file does not exist: ${src}. Current cmakelist: ${CMAKE_CURRENT_SOURCE_DIR}")
    endif()
endforeach()

target_include_directories(app PRIVATE src)
```

## prj.conf
```kconfig
# nothing here
CONFIG_PM=y
CONFIG_SERIAL=y
CONFIG_UART_ASYNC_API=y
CONFIG_REALTEK_SUBSYS_SYSM=y
CONFIG_REALTEK_SUBSYS_CONSOLE=y
CONFIG_REALTEK_SUBSYS_REMOTE=y
CONFIG_REALTEK_SUBSYS_BTM=y
CONFIG_REALTEK_SUBSYS_AUDIO=y
CONFIG_REALTEK_SUBSYS_GAP=y
CONFIG_REALTEK_SUBSYS_BLE_MGR=y
CONFIG_HEAP_MEM_POOL_SIZE=1024

#----------------- Zephyr Shell (replaces RTK console) --------------------#
# core shell over serial backend
CONFIG_SHELL=y
CONFIG_SHELL_BACKEND_SERIAL=y
CONFIG_PRINTK=y

# zephyr log via shell backend; keep RTK log off so it does not fight the UART
CONFIG_LOG=y
CONFIG_SHELL_LOG_BACKEND=y
CONFIG_LOG_BACKEND_UART=n
CONFIG_LOG_RTK=n

# shell sizing (matches applications/watch shell snippet)
CONFIG_SHELL_STACK_SIZE=16384
CONFIG_SHELL_CMD_BUFF_SIZE=256
CONFIG_SHELL_ARGC_MAX=20
CONFIG_SHELL_BACKEND_SERIAL_TX_RING_BUFFER_SIZE=1024
CONFIG_SHELL_BACKEND_SERIAL_RX_RING_BUFFER_SIZE=256
CONFIG_SHELL_HISTORY=y
CONFIG_SHELL_HISTORY_BUFFER=512
CONFIG_SHELL_TAB=y
CONFIG_SHELL_TAB_AUTOCOMPLETION=y
```

## boards/rtl87x3g_sample.overlay
```dts
/*
 * Copyright (c) 2026, Realtek Semiconductor Corporation
 *
 * SPDX-License-Identifier: LicenseRef-Realtek-5-Clause
 */

/ {
    chosen {
        zephyr,console = &uart2;
        zephyr,shell-uart = &uart2;
    };
};

/* Zephyr shell / console UART (pins come from the board's uart2_default) */
&uart2 {
    status = "okay";
    current-speed = <921600>;
};
```

## src/app_console_msg.c
```c
/*
 * Copyright (c) 2026, Realtek Semiconductor Corporation
 *
 * SPDX-License-Identifier: LicenseRef-Realtek-5-Clause
 */

#include "bt_types.h"
#include "trace.h"
#include "os_mem.h"
#include "app_msg.h"
#include "app_console_msg.h"
#include "power_test.h"
#include "pm.h"
#include "gap_br.h"
#include "power_test_dvfs.h"
#include "bt_bond.h"
#include "power_test_app_hfp_ag.h"
#include "power_test_rf_power.h"
#include "power_test_flash.h"

extern void power_test_set_mode(uint16_t action, uint8_t *buf);

void app_console_handle_msg(T_IO_MSG console_msg)
{
    uint16_t  subtype;
    uint16_t  id;
    uint16_t  action;
    uint8_t  *p;

    p       = console_msg.u.buf;
    subtype = console_msg.subtype;
    switch (subtype)
    {
    case IO_MSG_CONSOLE_STRING_RX:
        LE_STREAM_TO_UINT16(id, p);

        if (id == POWER_STATE_ID)
        {
            LE_STREAM_TO_UINT16(action, p);
            power_test_set_mode(action, console_msg.u.buf);
        }
#ifndef CONFIG_SOC_SERIES_RTL8773E
        else if (id == DVFS_ID)
        {
            LE_STREAM_TO_UINT16(action, p);
            power_test_set_dvfs(action, console_msg.u.buf);
        }
#endif
        else if (id == CPU_FREQ_ID)
        {
            LE_STREAM_TO_UINT16(action, p);
            power_test_set_cpu_freq(action, console_msg.u.buf);
        }
        else if (id == DSP1_FREQ_ID)
        {
            LE_STREAM_TO_UINT16(action, p);
            power_test_set_dsp1_freq(action, console_msg.u.buf);
        }
        else if (id == PLATFORM_ID)
        {
            LE_STREAM_TO_UINT16(action, p);
            power_test_flash_action((T_POWER_TEST_FLASH_CMD)action, console_msg.u.buf);
        }
#ifdef CONFIG_SOC_SERIES_RTL8773D
        else if (id == MCLK2_ID)
        {
            LE_STREAM_TO_UINT16(action, p);
            power_test_set_mclk2(action, console_msg.u.buf);
        }
#endif
        else if (id == CLOCK_32K_ID)
        {
            LE_STREAM_TO_UINT16(action, p);
            power_test_set_32k(action, console_msg.u.buf);
        }
        else if (id == TX_POWER_ID)
        {
            uint8_t     br_1M, edr_2M, edr_3M, le_1M, le_2M;
            LE_STREAM_TO_UINT8(br_1M, p);
            LE_STREAM_TO_UINT8(edr_2M, p);
            LE_STREAM_TO_UINT8(edr_3M, p);
            LE_STREAM_TO_UINT8(le_1M, p);
            LE_STREAM_TO_UINT8(le_2M, p);
            power_test_set_tx_power(br_1M, edr_2M, edr_3M, le_1M, le_2M, console_msg.u.buf);
        }
        else if (id == CONT_TX_ID)
        {
            uint8_t tx_power, packet_type;
            LE_STREAM_TO_UINT8(tx_power, p);
            LE_STREAM_TO_UINT8(packet_type, p);
            power_test_cont_tx(tx_power, packet_type, console_msg.u.buf);
        }
        else if (id == PACKET_RX_ID)
        {
            uint8_t packet_type;
            LE_STREAM_TO_UINT8(packet_type, p);
            power_test_packet_rx(packet_type, console_msg.u.buf);
        }
        else if (id == GAP_LEGACY_ID)
        {
            LE_STREAM_TO_UINT8(action, p);
            DBG_DIRECT("app_console_handle_msg action %d", action);
            switch (action)
            {
            case POWER_TEST_CMD_INQUIRY_SCAN_PARAM_SET:
                {
                    uint8_t  type;
                    uint16_t interval;
                    uint16_t window;

                    LE_STREAM_TO_UINT8(type, p);
                    LE_STREAM_TO_UINT16(interval, p);
                    LE_STREAM_TO_UINT16(window, p);
                    gap_br_cfg_inquiry_scan_param(type, interval, window);
                }
                break;

            case POWER_TEST_CMD_PAGE_SCAN_PARAM_SET:
                {
                    uint8_t  type;
                    uint16_t interval;
                    uint16_t window;
                    uint16_t page_timeout;

                    LE_STREAM_TO_UINT8(type, p);
                    LE_STREAM_TO_UINT16(interval, p);
                    LE_STREAM_TO_UINT16(window, p);
                    LE_STREAM_TO_UINT16(page_timeout, p);
                    gap_br_set_param(GAP_BR_PARAM_PAGE_TIMEOUT, sizeof(uint16_t), &page_timeout);
                    gap_br_cfg_page_scan_param(type, interval, window);
                }
                break;

            case POWER_TEST_CMD_RADIO_MODE_SET:
                {
                    uint8_t  radio_mode;

                    LE_STREAM_TO_UINT8(radio_mode, p);
                    gap_br_set_radio_mode(radio_mode, false, 0);
                }
                break;

            case POWER_TEST_CMD_SNIFF_ENTER:
                {
                    uint16_t min_interval;
                    uint16_t max_interval;
                    uint16_t sniff_attempt;
                    uint16_t sniff_timeout;

                    LE_STREAM_TO_UINT16(min_interval, p);
                    LE_STREAM_TO_UINT16(max_interval, p);
                    LE_STREAM_TO_UINT16(sniff_attempt, p);
                    LE_STREAM_TO_UINT16(sniff_timeout, p);
                    gap_br_enter_sniff_mode(p,
                                            min_interval,
                                            max_interval,
                                            sniff_attempt,
                                            sniff_timeout);
                }
                break;

            case POWER_TEST_CMD_SNIFF_EXIT:
                gap_br_exit_sniff_mode(p);
                break;

            case POWER_TEST_CMD_LINK_DEAULT_POLICY_SET:
                {
                    uint8_t  link_policy;

                    LE_STREAM_TO_UINT8(link_policy, p);
                    gap_br_cfg_default_link_policy(link_policy);
                }
                break;

            case POWER_TEST_CMD_LINK_POLICY_SET:
                {
                    uint8_t  link_policy;

                    LE_STREAM_TO_UINT8(link_policy, p);
                    gap_br_cfg_acl_link_policy(p, link_policy);
                }
                break;

            case POWER_TEST_CMD_INQUIRY_START:
                {
                    uint8_t inquiry_timeout;

                    LE_STREAM_TO_UINT8(inquiry_timeout, p);
                    gap_br_start_inquiry(false, inquiry_timeout);
                }
                break;

            case POWER_TEST_CMD_INQUIRY_STOP:
                gap_br_stop_inquiry();
                break;

            case POWER_TEST_CMD_PAGE_START:
                {
                    T_GAP_UUID_DATA uuid_data;

                    uuid_data.uuid_16 = UUID_HANDSFREE;
                    gap_br_start_sdp_discov(p, GAP_UUID16, uuid_data);
                }
                break;

            case POWER_TEST_CMD_PAGE_STOP:
                gap_br_stop_sdp_discov(p);
                break;

            case POWER_TEST_CMD_HFP_AG_CONN:
                app_power_test_connect_hfp_ag(p, true);
                break;

            case POWER_TEST_CMD_HFP_AG_DISCON:
                app_power_test_disconnect_hfp_ag(p, true);
                break;

            case POWER_TEST_CMD_LEGACY_DISCONNECT:
                gap_br_send_acl_disconn_req(p);
                break;

            case POWER_TEST_CMD_REMOVE_BOND:
                bt_bond_delete(p);
                break;

            default:
                break;
            }
            free(console_msg.u.buf);
        }
        else if (id == GAP_LE_ID)
        {
            LE_STREAM_TO_UINT8(action, p);
            power_handle_le_cmd(action);
        }
        break;
    default:
        break;
    }
}
```

## src/app_console_msg.h
```c
/*
 * Copyright (c) 2026, Realtek Semiconductor Corporation
 *
 * SPDX-License-Identifier: LicenseRef-Realtek-5-Clause
 */

#ifndef _APP_CONSOLE_MSG_H_
#define _APP_CONSOLE_MSG_H_

#include <stdint.h>
#include <stdbool.h>
#include "app_msg.h"

#ifdef __cplusplus
extern "C" {
#endif /* __cplusplus */

/** @defgroup APP_CONSOLE_MSG App Console Msg
  * @brief App Console Msg
  * @{
  */

/**
    * @brief  Handle a console (UART CLI) message and dispatch the parsed command.
    * @param  console_msg @ref T_IO_MSG
    * @return none
    */
void app_console_handle_msg(T_IO_MSG console_msg);

/** End of APP_CONSOLE_MSG
* @}
*/

#ifdef __cplusplus
}
#endif /* __cplusplus */

#endif /* _APP_CONSOLE_MSG_H_ */
```

## src/app_dlps.c
```c
/*
 * Copyright (c) 2026, Realtek Semiconductor Corporation
 *
 * SPDX-License-Identifier: LicenseRef-Realtek-5-Clause
 */

#include "board.h"
#include "trace.h"
#include "pm.h"
#include "platform_utils.h"
#include "os_timer.h"
#include "io_dlps.h"
#include "section.h"
#include "power_test.h"
#include "rtl876x_uart.h"
#include "rtl876x_pinmux.h"
#ifdef CONFIG_SOC_SERIES_RTL87X3G
#include "indirect_access.h"
#endif

#if F_APP_PSRAM_ENABLE
#include "module_psram.h"
#endif

#ifdef CONFIG_SOC_SERIES_RTL8773D
typedef enum
{
    PLATFORM_POWEROFF       = 0,   /**< Power off  */
    PLATFORM_POWERDOWN      = 1,   /**< Power down */
    PLATFORM_DLPS_PFM       = 2,   /**< DLPS (PFM) */
    //PLATFORM_DLPS_RET       = 3,   /**< DLPS (RET) */     // RTL87x3D not support
    PLATFORM_LPS_PFM        = 4,   /**< LPS        */
    PLATFORM_ACTIVE         = 5,   /**< Active     */
    PLATFORM_POWER_MODE_MAX = 6
} PlatformPowerMode;
#else
typedef enum
{
    PLATFORM_POWEROFF                       = 0,   /**< Power off  */
    PLATFORM_POWERDOWN                      = 1,   /**< Power down */
    PLATFORM_DLPS_PFM                       = 2,   /**< DLPS (PFM) */
    PLATFORM_DLPS_RET                       = 3,   /**< DLPS (RET) */
    PLATFORM_LPS_PFM                        = 4,   /**< LPS        */
    PLATFORM_ACTIVE                         = 5,   /**< Active     */
    PLATFORM_POWER_MODE_MAX                 = 6
} PlatformPowerMode;
#endif

static uint32_t dlps_bitmap;                /**< dlps locking bitmap */

extern void platform_pm_set_power_mode(PlatformPowerMode pf_power_mode_user);

/**
* @brief Console uart use cpu mode tx
*
* @param data Pointer to the buffer to be tx
* @param len length of the buffer
* @retval none
*/
void console_uart_direct(uint8_t *data, uint32_t len)
{
    uint32_t blkcount  = len / UART_TX_FIFO_SIZE;
    uint32_t remainder = len % UART_TX_FIFO_SIZE;
    uint32_t i = 0;

    while (UART_GetFlagState(UART0, UART_FLAG_THR_TSR_EMPTY) != SET);
    for (i = 0; i < blkcount; ++i)
    {
        UART_SendData(UART0, data + UART_TX_FIFO_SIZE * i, UART_TX_FIFO_SIZE);
        /* wait tx fifo empty */
        while (UART_GetFlagState(UART0, UART_FLAG_THR_TSR_EMPTY) != SET);
    }

    while (UART_GetFlagState(UART0, UART_FLAG_THR_TSR_EMPTY) != SET);
    /* send left bytes */
    if (remainder)
    {
        UART_SendData(UART0, data + UART_TX_FIFO_SIZE * i, remainder);
        /* wait tx fifo empty */
        while (UART_GetFlagState(UART0, UART_FLAG_THR_TSR_EMPTY) != SET);
    }
}

RAM_TEXT_SECTION void app_dlps_enable(uint32_t bit)
{
    if (dlps_bitmap & bit)
    {
        APP_PRINT_TRACE3("app_dlps_enable: %08x %08x -> %08x", bit, dlps_bitmap,
                         (dlps_bitmap & ~bit));
    }
    dlps_bitmap &= ~bit;
}

RAM_TEXT_SECTION void app_dlps_disable(uint32_t bit)
{
    if ((dlps_bitmap & bit) == 0)
    {
        APP_PRINT_TRACE3("app_dlps_disable: %08x %08x -> %08x", bit, dlps_bitmap,
                         (dlps_bitmap | bit));
    }

    dlps_bitmap |= bit;
}

RAM_TEXT_SECTION bool app_dlps_check_callback(void)
{

    static uint16_t dlps_bitmap_pre;
    bool dlps_enter_en = false;
    if (dlps_bitmap == 0)
    {
        dlps_enter_en = true;
    }

    if (dlps_bitmap_pre != dlps_bitmap)
    {
        APP_PRINT_WARN2("app_dlps_check_callback: dlps_bitmap_pre 0x%x dlps_bitmap 0x%x", dlps_bitmap_pre,
                        dlps_bitmap);
    }
    dlps_bitmap_pre = dlps_bitmap;

    return dlps_enter_en;
}

/**
    * @brief   Need to handle message in this callback function,when App enter dlps mode
    * @param  void
    * @return void
    */
RAM_TEXT_SECTION void app_dlps_enter_callback(void)
{
    static uint8_t dlps_console_response = 1;
    POWERMode lps_mode = power_mode_get();

#if (F_APP_PSRAM_ENABLE == 1)
    app_psram_enter_dlps();
#endif

    /* prevent send response when test ble or BREDR*/
    // if (dlps_console_response)
    // {
    //     char buf[15] = {0};
    //     snprintf(buf, 15, "lps_mode %d", lps_mode);
    //     console_uart_direct((uint8_t *)buf, 15);
    //     dlps_console_response = 0;

    //     Pad_PowerOrShutDownValue(P2_1, PAD_SHUTDOWN);
    //     Pad_PowerOrShutDownValue(P2_4, PAD_SHUTDOWN);
    //     Pad_PowerOrShutDownValue(P2_0, PAD_SHUTDOWN);
    //     Pad_PowerOrShutDownValue(P3_0, PAD_SHUTDOWN);
    //     Pad_PowerOrShutDownValue(P3_1, PAD_SHUTDOWN);
    //     UART_INTConfig(UART0, UART_INT_RD_AVA | UART_INT_IDLE, DISABLE);
    // }

    DBG_DIRECT("app_dlps_enter_callback: lps_mode %d", lps_mode);
}

RAM_TEXT_SECTION void app_dlps_exit_callback(void)
{
    APP_PRINT_INFO4("dump aon reg. 0x126 = 0x%x, 0x128 = 0x%x, 0x130 = 0x%x, 0x132 = 0x%x",
                    btaon_fast_read_safe(0x126), btaon_fast_read_safe(0x128), btaon_fast_read_safe(0x130),
                    btaon_fast_read_safe(0x132));

#if (F_APP_PSRAM_ENABLE == 1)
    app_psram_exit_dlps();
#endif
}

void app_dlps_init(void)
{
    // io_dlps_register();

    /* register of call back function */
    power_check_cb_register(app_dlps_check_callback);

    power_stage_cb_register(app_dlps_enter_callback, POWER_STAGE_STORE);
    power_stage_cb_register(app_dlps_exit_callback, POWER_STAGE_RESTORE);

    SYSBLKCTRL->u_208.BITS_208.r_DSP_CLK_SRC_EN = 0;
    bt_power_mode_set(BTPOWER_DEEP_SLEEP);

    /*To aviod enter dlps after boot */
    power_mode_set(POWER_ACTIVE_MODE);

}

void power_test_set_mode(uint16_t action, uint8_t *buf)
{
    if (action < POWER_TEST_CMD_STATE_MAX_INDEX)
    {
        if (action == POWER_TEST_CMD_SET_BT_MAC_ACTIVE)
        {
            APP_PRINT_TRACE0("power test bt active");
            bt_power_mode_set(BTPOWER_ACTIVE);
            return;
        }
#ifdef CONFIG_SOC_SERIES_RTL8773D
        /* open dsp clock, pro3 can't close when enter power down because will access dsp register */
        SYSBLKCTRL->u_208.BITS_208.r_DSP_CLK_SRC_EN = 1;
#endif
        bt_power_mode_set(BTPOWER_DEEP_SLEEP);

        if (action == POWER_TEST_CMD_SET_LPS)
        {
            APP_PRINT_TRACE0("power test set lps");
            power_mode_set(POWER_LPS_MODE);
        }
        else if (action == POWER_TEST_CMD_SET_DLPS)
        {
            APP_PRINT_TRACE0("power test set dlps");
            power_mode_set(POWER_DLPS_MODE);
        }
#ifndef CONFIG_SOC_SERIES_RTL8773D
        else if (action == POWER_TEST_CMD_SET_DLPS_RET)
        {
            APP_PRINT_TRACE0("power test set dlps ret");
            platform_pm_set_power_mode(PLATFORM_DLPS_RET);
        }
#endif
        else if (action == POWER_TEST_CMD_SET_DLPS_PFM)
        {
            APP_PRINT_TRACE0("power test set dlps pfm");
            platform_pm_set_power_mode(PLATFORM_DLPS_PFM);
        }
        else if (action == POWER_TEST_CMD_SET_POWER_DOWN)
        {
            APP_PRINT_TRACE0("power test set power down");
            power_mode_set(POWER_POWERDOWN_MODE);
        }
        else if (action == POWER_TEST_CMD_SET_POWER_OFF)
        {
            APP_PRINT_TRACE0("power test set power off");
            power_mode_set(POWER_SHIP_MODE);
        }
        else if (action == POWER_TEST_CMD_SET_BT_MAC_SELLP)
        {
            APP_PRINT_TRACE0("power test set bt mac sleep");
        }

        if ((action == POWER_TEST_CMD_SET_POWER_DOWN) || (action == POWER_TEST_CMD_SET_POWER_OFF))
        {
            // power_stop_all_non_excluded_timer();
        }
    }
    else
    {
        APP_PRINT_TRACE0("power test mode cmd error");
    }
    if (buf != NULL)
    {
        free(buf);
    }
}
```

## src/app_dlps.h
```c
/*
 * Copyright (c) 2026, Realtek Semiconductor Corporation
 *
 * SPDX-License-Identifier: LicenseRef-Realtek-5-Clause
 */

#ifndef _APP_DLPS_H_
#define _APP_DLPS_H_

#include <stdint.h>
#include <stdbool.h>
#include "rtl876x_pinmux.h"

#ifdef __cplusplus
extern "C" {
#endif /* __cplusplus */

/** @defgroup APP_DLPS App Dlps
  * @brief handle device dlps mode related process
  * @{
  */

/*============================================================================*
 *                              Macros
 *============================================================================*/
/** @defgroup APP_DLPS_Exported_Macros App Dlps Macros
   * @{
   */
#define APP_DLPS_ENTER_CHECK_UART_RX            0x00000001
#define APP_DLPS_ENTER_CHECK_UART_TX            0x00000002
#define APP_DLPS_ENTER_CHECK_GPIO               0x00000004
#define APP_DLPS_ENTER_CHECK_APP                0x00000008
#define APP_DLPS_ENTER_CHECK_MFB_KEY            0x00000010
#define APP_DLPS_ENTER_CHECK_RSV1               0x00000020
#define APP_DLPS_ENTER_CHECK_RSV2               0x00000040
#define APP_DLPS_ENTER_CHECK_LED                0x00000080
#define APP_DLPS_ENTER_CHECK_ADAPTOR            0x00000100
#define APP_DLPS_ENTER_CHECK_QDEC               0x00000200
#define APP_DLPS_ENTER_CHECK_RSV3               0x00000400
#define APP_DLPS_ENTER_CHECK_PLAYBACK           0x00000800
#define APP_DLPS_ENTER_CHECK_USB                0x00001000
#define APP_DLPS_ENTER_CHECK_LINEIN             0x00002000
#define APP_DLPS_ENTER_CHECK_ADP_VOLTAGE        0x00004000
#define APP_DLPS_ENTER_CHECK_WAIT_RESET         0x00008000
/** End of APP_DLPS_Exported_Macros
    * @}
    */

/**
    * @brief  enable dlps by clearing a specific bit in the locking bitmap
    * @param  bit lock bit
    * @return none
    */
void app_dlps_enable(uint32_t bit);

/**
    * @brief  disable dlps by setting a specific bit in the locking bitmap
    * @param  bit lock bit
    * @return none
    */
void app_dlps_disable(uint32_t bit);

/**
    * @brief  dlps enter check callback
    * @return true if allowed to enter dlps
    */
bool app_dlps_check_callback(void);

/**
    * @brief  dlps enter callback
    * @return none
    */
void app_dlps_enter_callback(void);

/**
    * @brief  dlps exit callback
    * @return none
    */
void app_dlps_exit_callback(void);

/**
    * @brief  dlps module init
    * @return none
    */
void app_dlps_init(void);

/**
    * @brief  set the platform power mode according to a console action
    * @param  action power-mode action id
    * @param  buf    message buffer to free after handling
    * @return none
    */
void power_test_set_mode(uint16_t action, uint8_t *buf);

/** End of APP_DLPS
* @}
*/

#ifdef __cplusplus
}
#endif /* __cplusplus */

#endif /* _APP_DLPS_H_ */
```

## src/app_io_msg.c
```c
/*
 * Copyright (c) 2026, Realtek Semiconductor Corporation
 *
 * SPDX-License-Identifier: LicenseRef-Realtek-5-Clause
 */
#include "os_sync.h"
#include "os_msg.h"
#include "trace.h"
#include "app_console_msg.h"
#include "power_test_le.h"
extern void *audio_io_queue_handle;
extern void *audio_evt_queue_handle;

bool  app_io_msg_send(T_IO_MSG *io_msg)
{
    T_EVENT_TYPE  event;
    bool ret = false;
    event = EVENT_IO_TO_APP;

    if (os_msg_send(audio_io_queue_handle, io_msg, 0) == true)
    {
        ret = os_msg_send(audio_evt_queue_handle, &event, 0);
    }

    return ret;
}



void app_io_msg_handler(T_IO_MSG io_driver_msg_recv)
{
    uint16_t msgtype = io_driver_msg_recv.type;

    switch (msgtype)
    {
    case IO_MSG_TYPE_CONSOLE:
        app_console_handle_msg(io_driver_msg_recv);
        break;

    case IO_MSG_TYPE_BT_STATUS:
        power_ble_handle_gap_msg(&io_driver_msg_recv);
        break;
    default:
        break;
    }
}
```

## src/app_io_msg.h
```c
/*
 * Copyright (c) 2026, Realtek Semiconductor Corporation
 *
 * SPDX-License-Identifier: LicenseRef-Realtek-5-Clause
 */

#ifndef _APP_IO_MSG_H_
#define _APP_IO_MSG_H_

#include <stdint.h>
#include <stdbool.h>
#include "app_msg.h"

#ifdef __cplusplus
extern "C" {
#endif /* __cplusplus */

/** @defgroup APP_IO_MSG App IO Msg
  * @brief App IO Msg
  * @{
  */

/**
    * @brief  Send an IO message to the application task queue.
    * @param  io_msg @ref T_IO_MSG
    * @return true on success, false otherwise
    */
bool app_io_msg_send(T_IO_MSG *io_msg);

/**
    * @brief  Dispatch a received IO message to the proper handler by type.
    * @param  io_driver_msg_recv @ref T_IO_MSG
    * @return void
    */
void app_io_msg_handler(T_IO_MSG io_driver_msg_recv);

/** End of APP_IO_MSG
* @}
*/

#ifdef __cplusplus
}
#endif /* __cplusplus */

#endif /* _APP_IO_MSG_H_ */
```

## src/app_main.c
```c
/*
 * Copyright (c) 2026, Realtek Semiconductor Corporation
 *
 * SPDX-License-Identifier: LicenseRef-Realtek-5-Clause
 */
#include <stdint.h>
#include <string.h>
#include "board.h"
#include "os_msg.h"
#include "os_task.h"
#include "os_queue.h"
#include "os_sched.h"
#include "rtl876x_pinmux.h"
#include "gap.h"
#include "gap_br.h"
#include "btm.h"
#include "sysm.h"
#include "remote.h"
#include "audio.h"
#include "trace.h"
#include "power_test.h"
#include "app_msg.h"
#include "app_io_msg.h"
#include "app_dlps.h"
#ifdef CONFIG_SOC_SERIES_RTL8773D
#if F_APP_EXTERNAL_BUCK_SUPPORT
#include "dvfs_api.h"
#include "ext_buck.h"
#include "app_buck_tps62860.h"
#else
#include "dvfs_api.h"
#include "pm.h"
#endif
#else
#include "pm.h"
#endif
#include "power_test_sdp.h"
#include "power_test_app.h"
#include "power_test_app_a2dp.h"
#include "power_test_app_avrcp.h"
#include "power_test_app_hfp.h"
#include "power_test_app_hfp_ag.h"
#include "power_test_flash.h"
#include "ble_mgr.h"
#ifdef CONFIG_SOC_SERIES_RTL87X3G
#include "rtl876x_uart.h"
#endif

#if (F_APP_PSRAM_ENABLE == 1)
#include "module_psram.h"
#endif

#define POWER_TEST_DEFAULT_PAGESCAN_WINDOW             0x12
#define POWER_TEST_DEFAULT_PAGESCAN_INTERVAL           0x800 //0x800
#define POWER_TEST_DEFAULT_PAGE_TIMEOUT                0xFA00 //40s
#define POWER_TEST_DEFAULT_SUPVISIONTIMEOUT            0x7D00 //20s
#define POWER_TEST_DEFAULT_INQUIRYSCAN_WINDOW          0x12
#define POWER_TEST_DEFAULT_INQUIRYSCAN_INTERVAL        0x1000 //0x1000

#define PLAYBACK_POOL_SIZE                  (13*1024)
#define VOICE_POOL_SIZE                     (2*1024)
#define RECORD_POOL_SIZE                    (1*1024)
#define NOTIFICATION_POOL_SIZE              (8*1024)

#define MAX_NUMBER_OF_GAP_MESSAGE       0x20    //!< indicate BT stack message queue size
#define MAX_NUMBER_OF_IO_MESSAGE        0x40    //!< indicate io queue size, extra 0x20 for data uart
#define MAX_NUMBER_OF_GAP_TIMER         0x10    //!< indicate gap timer queue size
#define MAX_NUMBER_OF_DSP_MSG           0x20    //!< number of dsp message reserved for DSP message handling.
#define MAX_NUMBER_OF_CODEC_MSG         0x20    //!< number of codec message reserved for CODEC message handling.
#define MAX_NUMBER_OF_SYS_MSG           0x20    //!< indicate SYS timer queue size
#define MAX_NUMBER_OF_LOADER_MSG        0x10    //!< indicate Bin Loader queue size
/** indicate rx event queue size*/
#define MAX_NUMBER_OF_RX_EVENT      \
    (MAX_NUMBER_OF_GAP_MESSAGE + MAX_NUMBER_OF_IO_MESSAGE  +  MAX_NUMBER_OF_DSP_MSG + MAX_NUMBER_OF_CODEC_MSG + MAX_NUMBER_OF_GAP_TIMER + MAX_NUMBER_OF_SYS_MSG + MAX_NUMBER_OF_LOADER_MSG)

void *power_test_queue_handle;
void *audio_evt_queue_handle;
void *audio_io_queue_handle;

/**
  * @brief  Initialize gap bond manager related parameters
  * @return void
  */
static void app_bt_gap_init(void)
{
    uint32_t class_of_device = (uint32_t)(0x18 | (0x04 << 8) | (0x24 << 16));
    uint16_t supervision_timeout = POWER_TEST_DEFAULT_SUPVISIONTIMEOUT;

    uint16_t link_policy = GAP_LINK_POLICY_DISABLE_ALL;

    uint8_t radio_mode = GAP_RADIO_MODE_NONE_DISCOVERABLE;
    bool limited_discoverable = false;
    bool auto_accept_acl = false;

    uint8_t pagescan_type = GAP_PAGE_SCAN_TYPE_INTERLACED;
    uint16_t pagescan_interval = POWER_TEST_DEFAULT_PAGESCAN_INTERVAL;
    uint16_t pagescan_window = POWER_TEST_DEFAULT_PAGESCAN_WINDOW;
    uint16_t page_timeout = POWER_TEST_DEFAULT_PAGE_TIMEOUT;

    uint8_t inquiryscan_type = GAP_INQUIRY_SCAN_TYPE_INTERLACED;
    uint16_t inquiryscan_window = POWER_TEST_DEFAULT_INQUIRYSCAN_WINDOW;
    uint16_t inquiryscan_interval = POWER_TEST_DEFAULT_INQUIRYSCAN_INTERVAL;
    uint8_t inquiry_mode = GAP_INQUIRY_MODE_EXTENDED_RESULT;

    uint8_t pair_mode = GAP_PAIRING_MODE_PAIRABLE;
    uint16_t auth_flags = GAP_AUTHEN_BIT_GENERAL_BONDING_FLAG | GAP_AUTHEN_BIT_SC_FLAG;
    uint8_t io_cap = GAP_IO_CAP_NO_INPUT_NO_OUTPUT;
    uint8_t oob_enable = false;
    uint8_t bt_mode = GAP_BT_MODE_21ENABLED;

    gap_lib_init();

    gap_br_set_param(GAP_BR_PARAM_NAME, GAP_DEVICE_NAME_LEN, "power_test");

    //1: to be slave when accept the acl connect request by default.
    gap_br_cfg_accept_role(0);

    gap_set_param(GAP_PARAM_BOND_PAIRING_MODE, sizeof(uint8_t), &pair_mode);
    gap_set_param(GAP_PARAM_BOND_AUTHEN_REQUIREMENTS_FLAGS, sizeof(uint16_t), &auth_flags);
    gap_set_param(GAP_PARAM_BOND_IO_CAPABILITIES, sizeof(uint8_t), &io_cap);
    gap_set_param(GAP_PARAM_BOND_OOB_ENABLED, sizeof(uint8_t), &oob_enable);

    gap_br_set_param(GAP_BR_PARAM_BT_MODE, sizeof(uint8_t), &bt_mode);
    gap_br_set_param(GAP_BR_PARAM_COD, sizeof(uint32_t), &class_of_device);
    gap_br_set_param(GAP_BR_PARAM_LINK_POLICY, sizeof(uint16_t), &link_policy);
    gap_br_set_param(GAP_BR_PARAM_SUPV_TOUT, sizeof(uint16_t), &supervision_timeout);
    gap_br_set_param(GAP_BR_PARAM_AUTO_ACCEPT_ACL, sizeof(bool), &auto_accept_acl);


    gap_br_set_param(GAP_BR_PARAM_RADIO_MODE, sizeof(uint8_t), &radio_mode);
    gap_br_set_param(GAP_BR_PARAM_LIMIT_DISCOV, sizeof(bool), &limited_discoverable);

    gap_br_set_param(GAP_BR_PARAM_PAGE_SCAN_TYPE, sizeof(uint8_t), &pagescan_type);
    gap_br_set_param(GAP_BR_PARAM_PAGE_SCAN_INTERVAL, sizeof(uint16_t), &pagescan_interval);
    gap_br_set_param(GAP_BR_PARAM_PAGE_SCAN_WINDOW, sizeof(uint16_t), &pagescan_window);
    gap_br_set_param(GAP_BR_PARAM_PAGE_TIMEOUT, sizeof(uint16_t), &page_timeout);

    gap_br_set_param(GAP_BR_PARAM_INQUIRY_SCAN_TYPE, sizeof(uint8_t), &inquiryscan_type);
    gap_br_set_param(GAP_BR_PARAM_INQUIRY_SCAN_INTERVAL, sizeof(uint16_t), &inquiryscan_interval);
    gap_br_set_param(GAP_BR_PARAM_INQUIRY_SCAN_WINDOW, sizeof(uint16_t), &inquiryscan_window);
    gap_br_set_param(GAP_BR_PARAM_INQUIRY_MODE, sizeof(uint8_t), &inquiry_mode);

    power_ble_gap_param_init();
}

/**
 * @brief    Contains the initialization of framework
 * @return   void
 */
void framework_init(void)
{
    /* System Manager */
    sys_mgr_init(audio_evt_queue_handle);

    /* RemoteController Manager */
    remote_mgr_init(REMOTE_SESSION_ROLE_SINGLE);

    /* Bluetooth Manager */
    bt_mgr_init();

    /* Audio Manager */
    audio_mgr_init(PLAYBACK_POOL_SIZE, VOICE_POOL_SIZE, RECORD_POOL_SIZE, NOTIFICATION_POOL_SIZE);
}

static void board_init(void)
{
    /*use zephyr shell*/

#ifdef CONFIG_SOC_SERIES_RTL8773D
#if F_APP_EXTERNAL_BUCK_SUPPORT
    Pinmux_Config(ADC_1, I2C0_DAT);
    Pinmux_Config(ADC_0, I2C0_CLK);

    Pad_Config(ADC_1, PAD_PINMUX_MODE, PAD_IS_PWRON, PAD_PULL_NONE, PAD_OUT_DISABLE, PAD_OUT_LOW);
    Pad_Config(ADC_0, PAD_PINMUX_MODE, PAD_IS_PWRON, PAD_PULL_NONE, PAD_OUT_DISABLE, PAD_OUT_LOW);
    Pad_PullConfigValue(ADC_1, PAD_STRONG_PULL);
    Pad_PullConfigValue(ADC_0, PAD_STRONG_PULL);
#else
    Pad_Config(ADC_1, PAD_SW_MODE, PAD_IS_PWRON, PAD_PULL_UP, PAD_OUT_DISABLE, PAD_OUT_LOW);
    Pad_Config(ADC_0, PAD_SW_MODE, PAD_IS_PWRON, PAD_PULL_UP, PAD_OUT_DISABLE, PAD_OUT_LOW);
#endif
#endif
}

#ifdef CONFIG_SOC_SERIES_RTL8773D
#if !F_APP_EXTERNAL_BUCK_SUPPORT
bool ext_buck_set_voltage_empty_func(DVFSVDDMode dvfs_volt)
{
    return true;
}
#endif
#endif

static void driver_init(void)
{
#ifdef CONFIG_SOC_SERIES_RTL8773D
#if F_APP_EXTERNAL_BUCK_SUPPORT
    app_buck_tps62860_init(P5_1);
    ext_buck_vcore2_enable();
#else
    dvfs_register_voltage_func(DVFS_LOW_VDD, ext_buck_set_voltage_empty_func);
#endif
#endif

    /*
     * Console/CLI is provided by the Zephyr shell (see prj.conf + the board
     * overlay's zephyr,shell-uart). The RTK console_uart transport and
     * cli_cmd_register front-end have been replaced by SHELL_CMD_REGISTER.
     */
}

static void app_task(void *pvParameters)
{
    uint8_t event;

    gap_start_bt_stack(audio_evt_queue_handle, audio_io_queue_handle, MAX_NUMBER_OF_GAP_TIMER);

    while (true)
    {
        if (os_msg_recv(audio_evt_queue_handle, &event, 0xFFFFFFFF) == true)
        {
            //DBG_DIRECT("audio_evt_queue_handle 0x%x event 0x%x 0x%x", audio_evt_queue_handle, &event, event);
            if (EVENT_GROUP(event) == EVENT_GROUP_IO)
            {
                T_IO_MSG io_msg;

                if (os_msg_recv(audio_io_queue_handle, &io_msg, 0) == true)
                {
                    if (event == EVENT_IO_TO_APP)
                    {
                        app_io_msg_handler(io_msg);
                    }
                }
            }
            else if (EVENT_GROUP(event) == EVENT_GROUP_STACK)
            {
                gap_handle_msg(event);
            }
            else if (EVENT_GROUP(event) == EVENT_GROUP_FRAMEWORK)
            {
                //sys_mgr_event_handle(event);
            }

        }
    }
}

void app_ble_gap_init(void)
{
    le_register_app_cb(power_ble_gap_cb);

    BLE_MGR_PARAMS param      = {0};
    param.ble_ext_adv.enable  = true;
    param.ble_ext_adv.adv_num = 2;
    param.ble_conn.enable     = true;
    param.ble_conn.link_num   = 2;
    ble_mgr_init(&param);
    power_le_init_adv_param();
}

int main(void)
{
    __enable_irq();
    void *app_task_handle;

    DBG_DIRECT("power test project");

    os_msg_queue_create(&audio_io_queue_handle, "audio ioQ", MAX_NUMBER_OF_IO_MESSAGE,
                        sizeof(T_IO_MSG));
    os_msg_queue_create(&audio_evt_queue_handle, "audio evtQ", MAX_NUMBER_OF_RX_EVENT,
                        sizeof(unsigned char));

    board_init();
    driver_init();

    app_bt_gap_init();
    app_dlps_init();
    framework_init();
#if (F_APP_PSRAM_ENABLE == 1)
    app_psram_init();
#endif
    power_test_sdp_init();
    app_power_test_init();
    app_power_test_hfp_ag_init();
    app_power_test_hfp_init();
    app_power_test_avrcp_init();
    app_power_test_a2dp_init();
    app_ble_gap_init();
    os_task_create(&app_task_handle, "app_task", app_task, NULL, 1024 * 3, 1);

    return 0;
}
```
