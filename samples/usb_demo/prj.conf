## CMakeLists.txt
```
#
# Copyright (c) 2026, Realtek Semiconductor Corporation
#
# SPDX-License-Identifier: LicenseRef-Realtek-5-Clause
#

message(STATUS "CMAKELIST FOLDER: ${CMAKE_CURRENT_SOURCE_DIR}")

cmake_minimum_required(VERSION 3.20.0)

#===========version generation===========
include(${CMAKE_CURRENT_SOURCE_DIR}/../../cmake/version_generate.cmake)
generate_version()
#===========version generation===========
#===========post build===========
# post build should be called before find_package
include(${CMAKE_CURRENT_SOURCE_DIR}/../../cmake/post_build.cmake)
rtk_post_build()
#===========post build===========

find_package(Zephyr REQUIRED HINTS $ENV{ZEPHYR_BASE})
project(usb_demo)

FILE(GLOB app_sources
		  src/*.c
		  src/fatfs/*.c
		  src/key/*.c
		  src/usb/*.c
		  src/usb_audio/*.c
		  src/usb/audio/*.c
		  src/usb_host/*.c
		  )
target_sources(app PRIVATE
  ${app_sources}
  )



if(CONFIG_REALTEK_USB_AUDIO_ENABLE)
target_sources(app PRIVATE 
			src/usb/hid/usb_hid.c
			src/usb_hid/app_usb_hid.c)
elseif(CONFIG_REALTEK_USB_HID_MOUSE_ENABLE)
add_compile_definitions(USB_HID_MOUSE_EN=1)
target_sources(app PRIVATE 
			src/usb/hid/usb_hid_mouse.c
			src/usb_hid_mouse/app_usb_hid_mouse.c)
elseif(CONFIG_REALTEK_USB_HID_KEYBOARD_ENABLE)
add_compile_definitions(USB_HID_KEYBOARD_EN=1)
target_sources(app PRIVATE 
			src/usb/hid/usb_hid.c
			src/usb_hid/app_usb_hid.c)
endif()
  
set(headers
	  src/
	  src/fatfs/
	  src/key/
	  src/usb/
	  src/usb/audio/
	  src/usb/hid/
	  src/usb_audio/
	  src/usb_hid/
	  src/usb_hid_mouse/
	  src/usb_host/
	)


foreach(header ${headers})
    if(EXISTS ${header})
        zephyr_include_directories(${header})
    else()
        message(FATAL_ERROR "header file directory does not exist: ${header}. Current cmakelist: ${CMAKE_CURRENT_SOURCE_DIR}")
    endif()
endforeach()

foreach(src ${sources})
    if(EXISTS ${src})
        target_sources(app PRIVATE ${src})
    else()
        message(FATAL_ERROR "source file does not exist: ${src}. Current cmakelist: ${CMAKE_CURRENT_SOURCE_DIR}")
    endif()
endforeach()

target_precompile_headers(app PUBLIC
	          ${CMAKE_CURRENT_SOURCE_DIR}/src/app_flags.h
			  )

target_include_directories(app PRIVATE src)
```

## Kconfig
```
#
# Copyright (c) 2026, Realtek Semiconductor Corporation
#
# SPDX-License-Identifier: LicenseRef-Realtek-5-Clause
#

menu "Realtek usb_demo Application"

config REALTEK_USB_AUDIO_ENABLE
            bool "Select USB Audio Demo"
            default y
            help
                Select USB Audio Demo.
				
config REALTEK_USB_HID_MOUSE_ENABLE
            bool "Select USB HID Mouse Demo"
            default n
            help
                Select USB HID Mouse Demo.

config REALTEK_USB_HID_KEYBOARD_ENABLE
            bool "Select USB HID Keyboard Demo"
            default n
            help
                Select USB HID Keyboard Demo.
endmenu

menu "Zephyr Kernel"
source "Kconfig.zephyr"
endmenu
```

## prj.conf
```kconfig
CONFIG_REALTEK_SUBSYS_USB=y
CONFIG_REALTEK_SUBSYS_AUDIO=y
CONFIG_REALTEK_SUBSYS_SYSM=y
CONFIG_REALTEK_SUBSYS_REMOTE=y
CONFIG_REALTEK_SUBSYS_BTM=y

CONFIG_REALTEK_USB_AUDIO_ENABLE=n
CONFIG_REALTEK_USB_HID_MOUSE_ENABLE=n
CONFIG_REALTEK_USB_HID_KEYBOARD_ENABLE=y

# Needed by src/key/gpio_key.c
CONFIG_GPIO=y
```

## boards/rtl87x3g_sample.overlay
```dts
/*
 * Copyright (c) 2026, Realtek Semiconductor Corporation
 *
 * SPDX-License-Identifier: LicenseRef-Realtek-5-Clause
 */

/* gpioa is disabled by default in the board dts.
 * src/key/gpio_key.c uses P1_0 (pad 8 = GPIOA7) as the demo key.
 */
&gpioa {
	status = "okay";
};
```

## src/app_flags.h
```c
/*
 * Copyright (c) 2026, Realtek Semiconductor Corporation
 *
 * SPDX-License-Identifier: LicenseRef-Realtek-5-Clause
 */


#ifndef _APP_FLAGS_H_
#define _APP_FLAGS_H_

//----- [Peripheral related] -----
#define F_APP_HIFI4_SUPPORT                 0
// #define F_APP_USB_AUDIO_SUPPORT             1
// #define F_APP_USB_HID_SUPPORT               1

#if CONFIG_REALTEK_USB_AUDIO_ENABLE
#undef F_APP_USB_AUDIO_SUPPORT
#define F_APP_USB_AUDIO_SUPPORT             1
#undef F_APP_USB_HID_SUPPORT
#define F_APP_USB_HID_SUPPORT               1
#endif

#if  CONFIG_REALTEK_USB_HID_MOUSE_ENABLE || CONFIG_REALTEK_USB_HID_KEYBOARD_ENABLE
#undef F_APP_USB_AUDIO_SUPPORT
#define F_APP_USB_AUDIO_SUPPORT             0
#undef F_APP_USB_HID_SUPPORT
#define F_APP_USB_HID_SUPPORT               1
#define GPIO_KEY_EN                         1
#endif

#if F_APP_USB_AUDIO_SUPPORT & (CONFIG_SOC_SERIES_RTL8773D || TARGET_RTL8773DFL)
#undef F_APP_HIFI4_SUPPORT
#define F_APP_HIFI4_SUPPORT                             1

#endif

#endif
```

## src/app_io_msg.c
```c
/*
 * Copyright (c) 2026, Realtek Semiconductor Corporation
 *
 * SPDX-License-Identifier: LicenseRef-Realtek-5-Clause
 */

#include "os_sync.h"
#include "os_msg.h"
#include "trace.h"
#include "app_main.h"
#include "section.h"

#if F_APP_USB_AUDIO_SUPPORT || F_APP_USB_HID_SUPPORT
#include "app_usb.h"
#endif
#if CONFIG_REALTEK_USB_HOST_ENABLE
#include "app_usbh_msc.h"
#endif
RAM_TEXT_SECTION bool app_io_msg_send(T_IO_MSG *io_msg)
{
    T_EVENT_TYPE event = EVENT_IO_TO_APP;
    bool ret = false;

    if (os_msg_send(audio_io_queue_handle, io_msg, 0) == true)
    {
        ret = os_msg_send(audio_evt_queue_handle, &event, 0);
    }

    if (ret == false)
    {
        APP_PRINT_ERROR3("app_io_msg_send failed: type 0x%x, subtype 0x%x, param 0x%x",
                         io_msg->type, io_msg->subtype, io_msg->u.param);
    }

    return ret;
}

void app_io_handle_msg(T_IO_MSG io_driver_msg_recv)
{
    uint16_t msgtype = io_driver_msg_recv.type;

    switch (msgtype)
    {
    case IO_MSG_TYPE_GPIO:
        {
            switch (io_driver_msg_recv.subtype)
            {
            case IO_MSG_GPIO_KEY:
                {
#if GPIO_KEY_EN
                    extern void app_key_handle_msg(T_IO_MSG * io_driver_msg_recv);
                    app_key_handle_msg(&io_driver_msg_recv);
#endif
                }
                break;

            case IO_MSG_GPIO_UART_WAKE_UP:
                {
//                    app_transfer_handle_msg(&io_driver_msg_recv);
                }
                break;

            case IO_MSG_GPIO_CHARGER:
                {
//                    app_charger_handle_msg(&io_driver_msg_recv);
                }
                break;

            case IO_MSG_GPIO_ADAPTOR_PLUG:
            case IO_MSG_GPIO_ADAPTOR_UNPLUG:
                {
//                    app_adp_msg_handler(io_driver_msg_recv.subtype);
                }
                break;


            default:
                break;
            }
        }
        break;



#if F_APP_CONSOLE_SUPPORT
    case IO_MSG_TYPE_CONSOLE:
        {
            app_console_handle_msg(io_driver_msg_recv);
        }
        break;
#endif

#if CONFIG_REALTEK_USB_HOST_ENABLE
    case IO_MSG_TYPE_USBH_MSC:
        {
            app_usbh_msg_handle(&io_driver_msg_recv);
        }
        break;
#else
#if F_APP_USB_AUDIO_SUPPORT || F_APP_USB_HID_SUPPORT
    case IO_MSG_TYPE_USB_UAC:
        {
            app_usb_msg_handle(&io_driver_msg_recv);
        }
        break;
#endif
    case IO_MSG_TYPE_USB_HID:
        {

        }
        break;
#endif

    default:
        break;
    }
}
```

## src/app_io_msg.h
```c
/*
 * Copyright (c) 2026, Realtek Semiconductor Corporation
 *
 * SPDX-License-Identifier: LicenseRef-Realtek-5-Clause
 */

#ifndef _APP_IO_MSG_H_
#define _APP_IO_MSG_H_

#include <stdbool.h>
#include "app_msg.h"

#ifdef __cplusplus
extern "C" {
#endif /* __cplusplus */

/** @defgroup USB_APP_IO_MSG App IO Msg
  * @brief App IO Msg
  * @{
  */
bool app_io_msg_send(T_IO_MSG *io_msg);

/**
    * @brief  All the application events are pre-handled in this function.
    *         All the io messages are sent to this function.
    *         Then the event handling function shall be called according to the message type.
    * @param  io_driver_msg_recv The T_IO_MSG from peripherals or BT stack state machine.
    * @return void
    */
void app_io_handle_msg(T_IO_MSG io_driver_msg_recv);

/** End of USB_APP_IO_MSG
* @}
*/

#ifdef __cplusplus
}
#endif /* __cplusplus */

#endif /* _APP_IO_MSG_H_ */
```

## src/app_ipc.c
```c
/*
 * Copyright (c) 2026, Realtek Semiconductor Corporation
 *
 * SPDX-License-Identifier: LicenseRef-Realtek-5-Clause
 */

#include <stdint.h>
#include <stdbool.h>
#include <string.h>
#include <stdlib.h>
#include "os_queue.h"
#include "trace.h"
#include "app_ipc.h"

#define TOPIC_CHANN_NUM     10

typedef struct t_app_ipc_topic_item
{
    struct t_app_ipc_topic_item *p_next;
    P_APP_IPC_CBACK              cback;
} T_APP_IPC_TOPIC_ITEM;

typedef struct
{
    const char *topic;
    T_OS_QUEUE subscriber_list;
    bool used;
} T_APP_IPC_TOPIC_CHANN;

typedef struct
{
    T_APP_IPC_TOPIC_CHANN topic_chann[TOPIC_CHANN_NUM];
} T_APP_IPC;

static T_APP_IPC app_ipc;

bool app_ipc_init(void)
{
    memset(&app_ipc, 0, sizeof(app_ipc));

    return true;
}

bool app_ipc_publish(const char *topic, uint32_t event, void *msg)
{
    T_APP_IPC_TOPIC_ITEM *item;
    uint8_t i;

    for (i = 0; i < TOPIC_CHANN_NUM; i++)
    {
        if (app_ipc.topic_chann[i].used == true &&
            !strcmp(app_ipc.topic_chann[i].topic, topic))
        {
            item = os_queue_peek(&app_ipc.topic_chann[i].subscriber_list, 0);
            while (item != NULL)
            {
                if (item->cback != NULL)
                {
                    item->cback(event, msg);
                }

                item = item->p_next;
            }

            break;
        }
    }

    return true;
}

T_APP_IPC_HANDLE app_ipc_subscribe(const char *topic, P_APP_IPC_CBACK cback)
{
    T_APP_IPC_TOPIC_ITEM *item;
    uint8_t i;

    for (i = 0; i < TOPIC_CHANN_NUM; i++)
    {
        if (app_ipc.topic_chann[i].used == true &&
            !strcmp(app_ipc.topic_chann[i].topic, topic))
        {
            item = malloc(sizeof(T_APP_IPC_TOPIC_ITEM));
            if (item != NULL)
            {
                item->cback = cback;
                os_queue_in(&app_ipc.topic_chann[i].subscriber_list, item);
                return (T_APP_IPC_HANDLE)item;
            }
            else
            {
                return NULL;
            }
        }
    }

    for (i = 0; i < TOPIC_CHANN_NUM; i++)
    {
        if (app_ipc.topic_chann[i].used == false)
        {
            item = malloc(sizeof(T_APP_IPC_TOPIC_ITEM));
            if (item != NULL)
            {
                app_ipc.topic_chann[i].used = true;
                app_ipc.topic_chann[i].topic = topic;

                item->cback = cback;
                os_queue_in(&app_ipc.topic_chann[i].subscriber_list, item);
                return (T_APP_IPC_HANDLE)item;
            }
            else
            {
                return NULL;
            }
        }
    }

    return NULL;
}

bool app_ipc_unsubscribe(T_APP_IPC_HANDLE handle)
{
    T_APP_IPC_TOPIC_ITEM *item;
    uint8_t i;

    item = (T_APP_IPC_TOPIC_ITEM *)handle;

    for (i = 0; i < TOPIC_CHANN_NUM; i++)
    {
        if (app_ipc.topic_chann[i].used == true)
        {
            if (os_queue_delete(&app_ipc.topic_chann[i].subscriber_list, item) == true)
            {
                free(item);

                if (app_ipc.topic_chann[i].subscriber_list.count == 0)
                {
                    app_ipc.topic_chann[i].used = false;
                    app_ipc.topic_chann[i].topic = NULL;
                }

                return true;
            }
        }
    }

    return false;
}
```

## src/app_ipc.h
```c
/*
 * Copyright (c) 2026, Realtek Semiconductor Corporation
 *
 * SPDX-License-Identifier: LicenseRef-Realtek-5-Clause
 */

#ifndef _APP_IPC_H_
#define _APP_IPC_H_

#include <stdint.h>
#include <stdbool.h>

#ifdef __cplusplus
extern "C" {
#endif /* __cplusplus */

/** @defgroup  USB_DEMO_IPC USB App IPC
* @brief
* @{
*/

typedef void *T_APP_IPC_HANDLE;

typedef void (*P_APP_IPC_CBACK)(uint32_t event, void *msg);

bool app_ipc_init(void);

bool app_ipc_publish(const char *topic, uint32_t event, void *msg);

T_APP_IPC_HANDLE app_ipc_subscribe(const char *topic, P_APP_IPC_CBACK cback);

bool app_ipc_unsubscribe(T_APP_IPC_HANDLE handle);

/** @} */ /* End of group USB_DEMO_IPC */

#ifdef __cplusplus
}
#endif /* __cplusplus */

#endif /* _APP_IPC_H_ */
```

## src/app_main.c
```c
/*
 * Copyright (c) 2026, Realtek Semiconductor Corporation
 *
 * SPDX-License-Identifier: LicenseRef-Realtek-5-Clause
 */

/*============================================================================*
 *                              Header Files
 *============================================================================*/

#include <stdint.h>
#include <string.h>
#include "os_mem.h"
#include "os_sched.h"
#include "os_msg.h"
#include "os_task.h"
#include "os_sched.h"
#include "app_flags.h"
#include "rtl876x_pinmux.h"
#include "rtl876x_gpio.h"
#include "trace.h"
#include "audio.h"
#include "sysm.h"
#include "remote.h"
#include "btm.h"
#include "app_timer.h"
#include "app_main.h"
#include "app_io_msg.h"
#include "board.h"
#include "app_usb.h"
#if F_APP_HIFI4_SUPPORT
#include "app_buck_tps62860.h"
#include "app_buck_apw7564.h"
#endif

/** @defgroup  USB_DEMO_APP_MAIN App Main
    * @brief Main file to initialize hardware and framework and start task scheduling
    * @{
    */

/*============================================================================*
 *                              Macros
 *============================================================================*/

#define MAX_NUMBER_OF_GAP_MESSAGE       0x20    //!< indicate BT stack message queue size
#define MAX_NUMBER_OF_IO_MESSAGE        0x40    //!< indicate io queue size, extra 0x20 for data uart
#define MAX_NUMBER_OF_GAP_TIMER         0x10    //!< indicate gap timer queue size
#define MAX_NUMBER_OF_DSP_MSG           0x20    //!< number of dsp message reserved for DSP message handling.
#define MAX_NUMBER_OF_CODEC_MSG         0x20    //!< number of codec message reserved for CODEC message handling.
#define MAX_NUMBER_OF_SYS_MSG           0x20    //!< indicate SYS timer queue size

#define MAX_NUMBER_OF_APP_TIMER_MODULE  0x30    //!< indicate app timer module size

/** indicate rx event queue size*/
#define MAX_NUMBER_OF_RX_EVENT      \
    (MAX_NUMBER_OF_GAP_MESSAGE + MAX_NUMBER_OF_IO_MESSAGE  +  MAX_NUMBER_OF_DSP_MSG + MAX_NUMBER_OF_CODEC_MSG + MAX_NUMBER_OF_GAP_TIMER + MAX_NUMBER_OF_SYS_MSG)

/*============================================================================*
 *                              Variables
 *============================================================================*/

void *audio_evt_queue_handle;
void *audio_io_queue_handle;

T_APP_DB app_db;

/*============================================================================*
 *                              Functions
 *============================================================================*/
#if GPIO_KEY_EN
extern void key_init(void);
#endif
/**
 * @brief    Contains the initialization of pinmux settings and pad settings
 * @note     All the pinmux settings and pad settings shall be initiated in this function,
 *           but if legacy driver is used, the initialization of pinmux setting and pad setting
 *           should be peformed with the IO initializing.
 * @return   void
 */
static void board_init(void)
{
#if F_APP_HIFI4_SUPPORT & (CONFIG_SOC_SERIES_RTL8773D || TARGET_RTL8773DFL)
    Pinmux_Config(I2C_0_DAT_PINMUX, I2C0_DAT);
    Pinmux_Config(I2C_0_CLK_PINMUX, I2C0_CLK);

    Pad_Config(I2C_0_DAT_PINMUX,
               PAD_PINMUX_MODE, PAD_IS_PWRON, PAD_PULL_UP, PAD_OUT_DISABLE, PAD_OUT_LOW);
    Pad_Config(I2C_0_CLK_PINMUX,
               PAD_PINMUX_MODE, PAD_IS_PWRON, PAD_PULL_UP, PAD_OUT_DISABLE, PAD_OUT_LOW);

    Pad_PullConfigValue(I2C_0_DAT_PINMUX, PAD_STRONG_PULL);
    Pad_PullConfigValue(I2C_0_CLK_PINMUX, PAD_STRONG_PULL);
#endif
}
/**
 * @brief    Contains the initialization of peripherals
 * @note     Both new architecture driver and legacy driver initialization method can be used
 * @return   void
 */
static void driver_init(void)
{
#if F_APP_HIFI4_SUPPORT
    uint8_t buck_enable_pinmux = BUCK_PWR_EN;
    bool ext_buck_support = true;
    if (ext_buck_support)
    {
        if (app_buck_tps62860_init(buck_enable_pinmux) == true)
        {
            APP_PRINT_TRACE0("driver_init: tps62860 init success");
        }
        else if (app_buck_apw7564_init() == true)
        {
            APP_PRINT_TRACE0("driver_init: apw7564 init success");
        }
        else
        {
            APP_PRINT_ERROR0("driver_init: No invalid external buck recognised, please check the hardware setting!!");
        }
    }
    else
    {
        APP_PRINT_TRACE0("driver_init: not init buck support");
    }
#endif
}
/**
* @brief framework_init() contains the initialization of audio manager.
* @return void
*/
static void framework_init(void)
{
    /* System Manager */
    sys_mgr_init(audio_evt_queue_handle);

    /* RemoteController Manager */
    remote_mgr_init(REMOTE_SESSION_ROLE_SINGLE);

    /* Bluetooth Manager */
    bt_mgr_init();

    /* Audio Manager */
    audio_mgr_init(PLAYBACK_POOL_SIZE, VOICE_POOL_SIZE, RECORD_POOL_SIZE, NOTIFICATION_POOL_SIZE);
}
/**
 * @brief    Contains the initialization of all tasks
 * @note     There is only one task in BLE Peripheral APP, thus only one APP task is init here
 * @return   void
 */
static void app_task(void *pvParameters)
{
    uint8_t event;

    DBG_DIRECT("app_task - unused memory: %d", mem_peek());

    while (true)
    {
        if (os_msg_recv(audio_evt_queue_handle, &event, 0xFFFFFFFF) == true)
        {
            if (EVENT_GROUP(event) == EVENT_GROUP_IO)
            {
                T_IO_MSG io_msg;

                if (os_msg_recv(audio_io_queue_handle, &io_msg, 0) == true)
                {
                    if (event == EVENT_IO_TO_APP)
                    {
                        app_io_handle_msg(io_msg);
                    }
                }
            }
            else if (EVENT_GROUP(event) == EVENT_GROUP_STACK)
            {
//                gap_handle_msg(event);
            }
            else if (EVENT_GROUP(event) == EVENT_GROUP_FRAMEWORK)
            {
                sys_mgr_event_handle(event);
            }
            else if (EVENT_GROUP(event) == EVENT_GROUP_APP)
            {
                app_timer_handle_msg(event);
            }
        }
    }
}

/**
 * @brief    Entry of APP code
 * @return   int (To avoid compile warning)
 */
int main(void)
{
    void *app_task_handle;

    APP_PRINT_INFO2("APP COMPILE TIME: [%s - %s]", TRACE_STRING(__DATE__), TRACE_STRING(__TIME__));

    memset(&app_db, 0, sizeof(T_APP_DB));

    APP_PRINT_INFO0("APP START FROM HW_RESET");

    os_msg_queue_create(&audio_io_queue_handle, "ioQ", MAX_NUMBER_OF_IO_MESSAGE, sizeof(T_IO_MSG));
    os_msg_queue_create(&audio_evt_queue_handle, "evtQ", MAX_NUMBER_OF_RX_EVENT, sizeof(unsigned char));

    app_init_timer(audio_evt_queue_handle, MAX_NUMBER_OF_APP_TIMER_MODULE);

    board_init();
    framework_init();
    driver_init();

#if  CONFIG_REALTEK_USB_HOST_ENABLE
    extern void app_usbh_init(void);
    app_usbh_init();
#else
#if F_APP_USB_HID_SUPPORT & GPIO_KEY_EN
    key_init();
#endif
    app_usb_init();
#endif
    os_task_create(&app_task_handle, "app_task", app_task, NULL, 1024 * 3, 1);

    os_sched_start();

    return 0;
}
/** @} */ /* End of group USB_DEMO_MAIN */
```

## src/app_main.h
```c
/*
 * Copyright (c) 2026, Realtek Semiconductor Corporation
 *
 * SPDX-License-Identifier: LicenseRef-Realtek-5-Clause
 */

#ifndef _APP_MAIN_H_
#define _APP_MAIN_H_

#include <stdint.h>

//#include "app_device.h"
#include "voice_prompt.h"
//#include "engage.h"
#include "remote.h"

#ifdef __cplusplus
extern "C" {
#endif /* __cplusplus */


/** @defgroup USB_DEMO_APP_MAIN App Main
  * @brief Main entry function for audio sample application.
  * @{
  */

/*============================================================================*
 *                              Macros
 *============================================================================*/
/** @defgroup APP_MAIN_Exported_Macros App Main Macros
    * @{
    */
#define PLAYBACK_POOL_SIZE                  (15*1024)
#define VOICE_POOL_SIZE                     (2*1024)
#define RECORD_POOL_SIZE                    (1*1024)
#define NOTIFICATION_POOL_SIZE              (3*1024)



/** End of APP_MAIN_Exported_Macros
    * @}
    */

/*============================================================================*
 *                              Types
 *============================================================================*/
/** @defgroup APP_MAIN_Exported_Types App Main Types
    * @{
    */

/**  @brief  App define global app data structure */
typedef struct
{
//    T_APP_DEVICE_STATE          device_state;
    uint8_t                     remote_session_state;
    bool                        bt_is_ready;
} T_APP_DB;


/** End of APP_MAIN_Exported_Types
    * @}
    */

/*============================================================================*
 *                              Variables
 *============================================================================*/
/** @defgroup APP_MAIN_Exported_Variables App Main Variables
    * @{
    */
extern T_APP_DB app_db;

extern void *audio_evt_queue_handle;
extern void *audio_io_queue_handle;
/** End of APP_MAIN_Exported_Variables
    * @}
    */

/** End of USB_DEMO_APP_MAIN
* @}
*/


#ifdef __cplusplus
}
#endif /* __cplusplus */

#endif /* _APP_MAIN_H_ */
```

## src/app_usb.c
```c
/*
 * Copyright (c) 2026, Realtek Semiconductor Corporation
 *
 * SPDX-License-Identifier: LicenseRef-Realtek-5-Clause
 */

#if F_APP_USB_AUDIO_SUPPORT|F_APP_USB_HID_SUPPORT
#include <stdint.h>
#include <string.h>
#include "trace.h"
#include "section.h"
#include "sysm.h"
#include "hal_adp.h"
#include "pm.h"
#include "system_status_api.h"
#include "usb_hid.h"
#include "usb_audio_stream.h"
#include "usb_dev.h"
#include "usb_dm.h"
#include "usb_msg.h"
#include "app_io_msg.h"
#include "app_ipc.h"
#if F_APP_USB_AUDIO_SUPPORT
#include "app_usb_audio.h"
#if F_APP_USB_HID_SUPPORT
#include "app_usb_audio_mmi.h"
#endif
#elif F_APP_USB_HID_SUPPORT
#include "app_usb_hid.h"
#endif

#if (CONFIG_SOC_SERIES_RTL8773D == 1 || TARGET_RTL8773DFL == 1)
#include "pmu_api.h"
#endif

#if (CONFIG_SOC_SERIES_RTL8773D == 1 || TARGET_RTL8773DFL == 1)
#define     CPU_FREQ_MHZ_MAX    160
#elif (CONFIG_SOC_SERIES_RTL87X3G == 1)
#define     CPU_FREQ_MHZ_MAX    200
#else
#define     CPU_FREQ_MHZ_MAX    100
#endif
typedef enum
{
    USB_EVT_PLUG,
    USB_EVT_UNPLUG,
    USB_EVT_PWR_STATUS_CHG,
} T_USB_EVT;

#define USB_DM_EVT_Q_NUM     0x20

#define USB_DM_EVT_USB_START 0x01
#define USB_DM_EVT_USB_STOP  0x02

#define READY_BIT_INIT       (0x01 << 0)
#define READY_BIT_PLUGGED    (0x01 << 1)
#define READY_BIT_POWER_ON   (0x01 << 2)
#define READY_BIT_ALL        (READY_BIT_POWER_ON|READY_BIT_PLUGGED|READY_BIT_INIT)

typedef struct _store_param
{
    uint32_t pre_cpu_clk;
    POWERMode pre_pwr_mode;
} T_STORE_PARAM;

typedef struct _app_usb_db
{
    T_STORE_PARAM store;
    uint8_t ready_set_to_start;
    T_USB_POWER_STATE usb_pwr_state;
    void *usb_dm_task;
    void *usb_dm_evt_q_handle;
    bool power_on_when_usb_plug;
    bool ds_playing;
} T_APP_USB_DB;

static T_APP_USB_DB app_usb_db;
static uint8_t app_usb_freq_handle = 0;

static void app_usb_start(void)
{
    uint32_t actual_mhz = 0;
    sys_hall_auto_sleep_in_idle(false);
    app_usb_db.store.pre_cpu_clk = pm_cpu_freq_get();
#if (CONFIG_SOC_SERIES_RTL87X3G == 1)
#else
    pm_cpu_freq_set(CPU_FREQ_MHZ_MAX, &actual_mhz);
#endif
    // pm_cpu_freq_req(&app_usb_freq_handle, pm_cpu_max_freq_get(), &actual_mhz);
    pm_dvfs_set_supreme();
    usb_dm_start(false);

    APP_PRINT_INFO2("app_usb_start: pre clk %d, cur clk %d", app_usb_db.store.pre_cpu_clk,  actual_mhz);
    app_ipc_publish(USB_IPC_TOPIC, USB_IPC_EVT_PLUG, NULL);
}

void app_usb_stop(void)
{
    uint32_t actual_mhz = 0;
    usb_dm_stop();
    sys_hall_auto_sleep_in_idle(true);
    pm_cpu_freq_clear(&app_usb_freq_handle, &actual_mhz);
    app_ipc_publish(USB_IPC_TOPIC, USB_IPC_EVT_UNPLUG, NULL);
}

RAM_TEXT_SECTION
bool usb_dev_trigger_evt(T_USB_EVT evt,  uint32_t param)
{
    T_IO_MSG gpio_msg;

    gpio_msg.type = IO_MSG_TYPE_USB;
    gpio_msg.subtype = USB_MSG(USB_MSG_GROUP_DEV, evt);
    gpio_msg.u.param = param;

    return app_io_msg_send(&gpio_msg);
}

static void usb_dm_evt_handle(uint8_t evt, uint32_t data)
{

}

bool app_usb_connected(void)
{
    return (app_usb_db.usb_pwr_state > USB_PDN);
}

void app_usb_msg_handle(T_IO_MSG *msg)
{
    uint16_t subtype = msg->subtype;
    uint8_t group = USB_MSG_GROUP(subtype);
    uint8_t submsg = USB_MSG_SUBTYPE(subtype);
    uint32_t param = msg->u.param;

    switch (group)
    {
    case USB_MSG_GROUP_DEV:
        {
            usb_dm_evt_handle(submsg, param);
        }
        break;
#if F_APP_USB_AUDIO_SUPPORT
    case USB_MSG_GROUP_IF_AUDIO:
        {
            usb_audio_stream_evt_handle(submsg, param);
        }
        break;
#endif
    default:
        break;
    }
}

#if F_APP_USB_AUDIO_SUPPORT
static void app_usb_ipc_cback(uint32_t id, void *msg)
{
    switch (id)
    {
    case USB_IPC_EVT_AUDIO_DS_START:
        {
            if (app_usb_db.ds_playing == false)
            {
                app_usb_audio_start(USB_AUDIO_SCENARIO_PLAYBACK);
                app_usb_db.ds_playing = true;
            }
        }
        break;

    case USB_IPC_EVT_AUDIO_DS_STOP:
        {
            app_usb_db.ds_playing = false;
        }
        break;

    case USB_IPC_EVT_AUDIO_US_START:
        {
            app_usb_audio_start(USB_AUDIO_SCENARIO_CAPTURE);
        }
        break;

    case USB_IPC_EVT_AUDIO_US_STOP:
        {
            app_usb_audio_stop(USB_AUDIO_SCENARIO_CAPTURE);
        }
        break;

    case USB_IPC_EVT_AUDIO_DS_XMIT:
        {
            if (app_usb_db.ds_playing == false)
            {
                app_usb_audio_start(USB_AUDIO_SCENARIO_PLAYBACK);
                app_usb_db.ds_playing = true;
            }
        }
        break;

    default:
        break;
    }
}
#endif

#if F_APP_USB_AUDIO_SUPPORT & CONFIG_SOC_SERIES_RTL87X3G
#include "fmc_api.h"
extern bool fmc_psram_clock_switch(FMC_SPIC_ID spic_id, uint32_t required_mhz,
                                   uint32_t *actual_mhz);
void app_wb_opi_psram_init(void)
{

    uint32_t psram_freq = 0;
    bool fmc_psram_winbond_opi_init_ret = fmc_psram_winbond_opi_init(FMC_SPIC_ID_1);

    bool fmc_psram_clock_switch_ret = fmc_psram_clock_switch(FMC_SPIC_ID_1, 280,
                                                             &psram_freq);

    APP_PRINT_INFO3("app_wb_opi_psram_init: fmc_psram_winbond_opi_init_ret %d, fmc_psram_clock_switch_ret %d, actual freq %d",
                    fmc_psram_winbond_opi_init_ret, fmc_psram_clock_switch_ret, psram_freq);
}
void app_apm_opi_psram_init(void)
{
    bool fmc_psram_ap_memory_opi_init_ret = fmc_psram_ap_memory_opi_init(FMC_SPIC_ID_3);
    uint32_t psram_freq = 0;
    bool fmc_psram_clock_switch_ret = fmc_psram_clock_switch(FMC_SPIC_ID_3, 280,
                                                             &psram_freq);

    APP_PRINT_INFO3("app_apm_opi_psram_init: fmc_psram_ap_memory_opi_init_ret %d, fmc_psram_clock_switch_ret %d, actual freq %d",
                    fmc_psram_ap_memory_opi_init_ret, fmc_psram_clock_switch_ret, psram_freq);

}
#endif

void app_usb_init(void)
{
    memset(&app_usb_db, 0, sizeof(T_APP_USB_DB));

    T_USB_CORE_CONFIG config = {.speed = USB_SPEED_HIGH, .class_set = {.hid_enable = 0, .uac_enable = 0}};
    config.clk_mhz = 100;
#if F_APP_USB_AUDIO_SUPPORT
    config.class_set.uac_enable = 1;
    config.clk_mhz = 140;
#endif
#if F_APP_USB_HID_SUPPORT
    config.class_set.hid_enable = 1;
#endif
    usb_dm_core_init(config);

    usb_dev_init();
#if F_APP_USB_AUDIO_SUPPORT
    usb_audio_stream_init();
    app_usb_audio_init();
    app_ipc_subscribe(USB_IPC_TOPIC, app_usb_ipc_cback);
#endif
#if F_APP_USB_HID_SUPPORT
    usb_hid_init();
#endif
#if F_APP_USB_AUDIO_SUPPORT & F_APP_USB_HID_SUPPORT
    app_usb_audio_mmi_init();
#elif F_APP_USB_HID_SUPPORT
    app_usb_hid_init();
#endif

#if F_APP_USB_AUDIO_SUPPORT & CONFIG_SOC_SERIES_RTL87X3G
    app_wb_opi_psram_init();
    app_apm_opi_psram_init();
#endif

#if (CONFIG_SOC_SERIES_RTL87X3G == 1)
//    power_mode_resume();
#endif
    app_usb_start();
}
#endif
```

## src/app_usb.h
```c
/*
 * Copyright (c) 2026, Realtek Semiconductor Corporation
 *
 * SPDX-License-Identifier: LicenseRef-Realtek-5-Clause
 */

#ifndef __APP_USB_H__
#define __APP_USB_H__
#include <stdbool.h>
#include "app_io_msg.h"

/** @defgroup USB_DEMO_CTRL USB Control Demo
  * @brief Main entry function for audio sample application.
  * @{
  */

void app_usb_msg_handle(T_IO_MSG *msg);
bool app_usb_connected(void);
void app_usb_init(void);

/** @} */ /* End of group USB_DEMO_CTRL */

#endif
```

## src/board.h
```c
/*
 * Copyright (c) 2026, Realtek Semiconductor Corporation
 *
 * SPDX-License-Identifier: LicenseRef-Realtek-5-Clause
 */

#ifndef _BOARD_H_
#define _BOARD_H_

#include <stdint.h>
#include <stdbool.h>
#include <string.h>

#ifdef __cplusplus
extern "C" {
#endif

#define KEY_NULL                0
#define KEY0_MASK               0x01
#define KEY1_MASK               0x02
#define KEY2_MASK               0x04
#define KEY3_MASK               0x08
#define KEY4_MASK               0x10
#define KEY5_MASK               0x20
#define KEY6_MASK               0x40
#define KEY7_MASK               0x80

#define KEY_RELEASE             0
#define KEY_PRESS               1

#define MAX_KEY_NUM             8
#define HYBRID_KEY_NUM          8
#define RWS_KEY_NUM             8

#define LED_NUM                 3 //MAX: 3 LED
#define LED_DEMO_NUM            6 //MAX: 6 LED
#define SLEEP_LED_PINMUX_NUM    10

//teams extend led use the same timer with sensor, if enable together, make them not compile
#define multi_timer_isr_callback           sensor_timer_isr_callback
#define led_demo_breath_timer_handler      multi_timer_isr_callback

#define DSP_TIMER               TIM7 //DSP HW fixed at timer7

#define UART_RX_BUFFER_SIZE         1024
#define RX_GDMA_START_ADDR          UART_RX_BUFFER_SIZE
#define RX_GDMA_BUFFER_SIZE         300

#define I2C_0_DAT_PINMUX            P0_1
#define I2C_0_CLK_PINMUX            P0_0

#define BUCK_PWR_EN                 P5_1
#define BUCK_PWR_SEL                P5_2

/** @defgroup IO Driver Config
  * @note user must config it firstly!! Do not change macro names!!
  * @{
  */

/**
  * @}
  */
#ifdef __cplusplus
}
#endif

#endif /* _BOARD_H_ */
```
