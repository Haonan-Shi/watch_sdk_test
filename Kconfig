## applications/watch/build/Kconfig/soc/Kconfig
```kconfig
# Load Zephyr SoC Kconfig descriptions.
osource "D:/watch/GItCode/zephyr_sdk/RTL87X3G_MCU_SDK_Watch_Zephyr_v1.14.3.1/zephyr/soc/xlnx/zynqmp/Kconfig"
osource "D:/watch/GItCode/zephyr_sdk/RTL87X3G_MCU_SDK_Watch_Zephyr_v1.14.3.1/zephyr/soc/xlnx/zynq7000/Kconfig"
osource "D:/watch/GItCode/zephyr_sdk/RTL87X3G_MCU_SDK_Watch_Zephyr_v1.14.3.1/zephyr/soc/xen/Kconfig"
osource "D:/watch/GItCode/zephyr_sdk/RTL87X3G_MCU_SDK_Watch_Zephyr_v1.14.3.1/zephyr/soc/ti/simplelink/Kconfig"
osource "D:/watch/GItCode/zephyr_sdk/RTL87X3G_MCU_SDK_Watch_Zephyr_v1.14.3.1/zephyr/soc/ti/lm3s6965/Kconfig"
osource "D:/watch/GItCode/zephyr_sdk/RTL87X3G_MCU_SDK_Watch_Zephyr_v1.14.3.1/zephyr/soc/ti/k3/Kconfig"
osource "D:/watch/GItCode/zephyr_sdk/RTL87X3G_MCU_SDK_Watch_Zephyr_v1.14.3.1/zephyr/soc/telink/tlsr/Kconfig"
osource "D:/watch/GItCode/zephyr_sdk/RTL87X3G_MCU_SDK_Watch_Zephyr_v1.14.3.1/zephyr/soc/starfive/jh71xx/Kconfig"
osource "D:/watch/GItCode/zephyr_sdk/RTL87X3G_MCU_SDK_Watch_Zephyr_v1.14.3.1/zephyr/soc/st/stm32/Kconfig"
osource "D:/watch/GItCode/zephyr_sdk/RTL87X3G_MCU_SDK_Watch_Zephyr_v1.14.3.1/zephyr/soc/snps/qemu_arc/Kconfig"
osource "D:/watch/GItCode/zephyr_sdk/RTL87X3G_MCU_SDK_Watch_Zephyr_v1.14.3.1/zephyr/soc/snps/nsim/arc_v/Kconfig"
osource "D:/watch/GItCode/zephyr_sdk/RTL87X3G_MCU_SDK_Watch_Zephyr_v1.14.3.1/zephyr/soc/snps/nsim/arc_classic/Kconfig"
osource "D:/watch/GItCode/zephyr_sdk/RTL87X3G_MCU_SDK_Watch_Zephyr_v1.14.3.1/zephyr/soc/snps/hsdk4xd/Kconfig"
osource "D:/watch/GItCode/zephyr_sdk/RTL87X3G_MCU_SDK_Watch_Zephyr_v1.14.3.1/zephyr/soc/snps/hsdk/Kconfig"
osource "D:/watch/GItCode/zephyr_sdk/RTL87X3G_MCU_SDK_Watch_Zephyr_v1.14.3.1/zephyr/soc/snps/emsk/Kconfig"
osource "D:/watch/GItCode/zephyr_sdk/RTL87X3G_MCU_SDK_Watch_Zephyr_v1.14.3.1/zephyr/soc/snps/emsdp/Kconfig"
osource "D:/watch/GItCode/zephyr_sdk/RTL87X3G_MCU_SDK_Watch_Zephyr_v1.14.3.1/zephyr/soc/snps/arc_iot/Kconfig"
osource "D:/watch/GItCode/zephyr_sdk/RTL87X3G_MCU_SDK_Watch_Zephyr_v1.14.3.1/zephyr/soc/silabs/Kconfig"
osource "D:/watch/GItCode/zephyr_sdk/RTL87X3G_MCU_SDK_Watch_Zephyr_v1.14.3.1/zephyr/soc/sifive/sifive_freedom/Kconfig"
osource "D:/watch/GItCode/zephyr_sdk/RTL87X3G_MCU_SDK_Watch_Zephyr_v1.14.3.1/zephyr/soc/rockchip/Kconfig"
osource "D:/watch/GItCode/zephyr_sdk/RTL87X3G_MCU_SDK_Watch_Zephyr_v1.14.3.1/zephyr/soc/renode/riscv_virtual/Kconfig"
osource "D:/watch/GItCode/zephyr_sdk/RTL87X3G_MCU_SDK_Watch_Zephyr_v1.14.3.1/zephyr/soc/renesas/smartbond/Kconfig"
osource "D:/watch/GItCode/zephyr_sdk/RTL87X3G_MCU_SDK_Watch_Zephyr_v1.14.3.1/zephyr/soc/renesas/rzt2m/Kconfig"
osource "D:/watch/GItCode/zephyr_sdk/RTL87X3G_MCU_SDK_Watch_Zephyr_v1.14.3.1/zephyr/soc/renesas/rcar/Kconfig"
osource "D:/watch/GItCode/zephyr_sdk/RTL87X3G_MCU_SDK_Watch_Zephyr_v1.14.3.1/zephyr/soc/renesas/ra/Kconfig"
osource "D:/watch/GItCode/zephyr_sdk/RTL87X3G_MCU_SDK_Watch_Zephyr_v1.14.3.1/zephyr/soc/realtek/bee/Kconfig"
osource "D:/watch/GItCode/zephyr_sdk/RTL87X3G_MCU_SDK_Watch_Zephyr_v1.14.3.1/zephyr/soc/raspberrypi/Kconfig"
osource "D:/watch/GItCode/zephyr_sdk/RTL87X3G_MCU_SDK_Watch_Zephyr_v1.14.3.1/zephyr/soc/quicklogic/eos_s3/Kconfig"
osource "D:/watch/GItCode/zephyr_sdk/RTL87X3G_MCU_SDK_Watch_Zephyr_v1.14.3.1/zephyr/soc/qemu/virt_riscv/Kconfig"
osource "D:/watch/GItCode/zephyr_sdk/RTL87X3G_MCU_SDK_Watch_Zephyr_v1.14.3.1/zephyr/soc/qemu/malta/Kconfig"
osource "D:/watch/GItCode/zephyr_sdk/RTL87X3G_MCU_SDK_Watch_Zephyr_v1.14.3.1/zephyr/soc/openisa/rv32m1/Kconfig"
osource "D:/watch/GItCode/zephyr_sdk/RTL87X3G_MCU_SDK_Watch_Zephyr_v1.14.3.1/zephyr/soc/nxp/s32/Kconfig"
osource "D:/watch/GItCode/zephyr_sdk/RTL87X3G_MCU_SDK_Watch_Zephyr_v1.14.3.1/zephyr/soc/nxp/rw/Kconfig"
osource "D:/watch/GItCode/zephyr_sdk/RTL87X3G_MCU_SDK_Watch_Zephyr_v1.14.3.1/zephyr/soc/nxp/mcx/Kconfig"
osource "D:/watch/GItCode/zephyr_sdk/RTL87X3G_MCU_SDK_Watch_Zephyr_v1.14.3.1/zephyr/soc/nxp/lpc/Kconfig"
osource "D:/watch/GItCode/zephyr_sdk/RTL87X3G_MCU_SDK_Watch_Zephyr_v1.14.3.1/zephyr/soc/nxp/layerscape/Kconfig"
osource "D:/watch/GItCode/zephyr_sdk/RTL87X3G_MCU_SDK_Watch_Zephyr_v1.14.3.1/zephyr/soc/nxp/kinetis/Kconfig"
osource "D:/watch/GItCode/zephyr_sdk/RTL87X3G_MCU_SDK_Watch_Zephyr_v1.14.3.1/zephyr/soc/nxp/imxrt/Kconfig"
osource "D:/watch/GItCode/zephyr_sdk/RTL87X3G_MCU_SDK_Watch_Zephyr_v1.14.3.1/zephyr/soc/nxp/imx/Kconfig"
osource "D:/watch/GItCode/zephyr_sdk/RTL87X3G_MCU_SDK_Watch_Zephyr_v1.14.3.1/zephyr/soc/nuvoton/numicro/Kconfig"
osource "D:/watch/GItCode/zephyr_sdk/RTL87X3G_MCU_SDK_Watch_Zephyr_v1.14.3.1/zephyr/soc/nuvoton/numaker/Kconfig"
osource "D:/watch/GItCode/zephyr_sdk/RTL87X3G_MCU_SDK_Watch_Zephyr_v1.14.3.1/zephyr/soc/nuvoton/npcx/Kconfig"
osource "D:/watch/GItCode/zephyr_sdk/RTL87X3G_MCU_SDK_Watch_Zephyr_v1.14.3.1/zephyr/soc/nordic/Kconfig"
osource "D:/watch/GItCode/zephyr_sdk/RTL87X3G_MCU_SDK_Watch_Zephyr_v1.14.3.1/zephyr/soc/neorv32/Kconfig"
osource "D:/watch/GItCode/zephyr_sdk/RTL87X3G_MCU_SDK_Watch_Zephyr_v1.14.3.1/zephyr/soc/native/inf_clock/Kconfig"
osource "D:/watch/GItCode/zephyr_sdk/RTL87X3G_MCU_SDK_Watch_Zephyr_v1.14.3.1/zephyr/soc/microchip/miv/Kconfig"
osource "D:/watch/GItCode/zephyr_sdk/RTL87X3G_MCU_SDK_Watch_Zephyr_v1.14.3.1/zephyr/soc/microchip/mec/Kconfig"
osource "D:/watch/GItCode/zephyr_sdk/RTL87X3G_MCU_SDK_Watch_Zephyr_v1.14.3.1/zephyr/soc/mediatek/mtk_adsp/Kconfig"
osource "D:/watch/GItCode/zephyr_sdk/RTL87X3G_MCU_SDK_Watch_Zephyr_v1.14.3.1/zephyr/soc/lowrisc/opentitan/Kconfig"
osource "D:/watch/GItCode/zephyr_sdk/RTL87X3G_MCU_SDK_Watch_Zephyr_v1.14.3.1/zephyr/soc/litex/litex_vexriscv/Kconfig"
osource "D:/watch/GItCode/zephyr_sdk/RTL87X3G_MCU_SDK_Watch_Zephyr_v1.14.3.1/zephyr/soc/ite/ec/Kconfig"
osource "D:/watch/GItCode/zephyr_sdk/RTL87X3G_MCU_SDK_Watch_Zephyr_v1.14.3.1/zephyr/soc/intel/raptor_lake/Kconfig"
osource "D:/watch/GItCode/zephyr_sdk/RTL87X3G_MCU_SDK_Watch_Zephyr_v1.14.3.1/zephyr/soc/intel/lakemont/Kconfig"
osource "D:/watch/GItCode/zephyr_sdk/RTL87X3G_MCU_SDK_Watch_Zephyr_v1.14.3.1/zephyr/soc/intel/intel_socfpga_std/Kconfig"
osource "D:/watch/GItCode/zephyr_sdk/RTL87X3G_MCU_SDK_Watch_Zephyr_v1.14.3.1/zephyr/soc/intel/intel_socfpga/Kconfig"
osource "D:/watch/GItCode/zephyr_sdk/RTL87X3G_MCU_SDK_Watch_Zephyr_v1.14.3.1/zephyr/soc/intel/intel_niosv/Kconfig"
osource "D:/watch/GItCode/zephyr_sdk/RTL87X3G_MCU_SDK_Watch_Zephyr_v1.14.3.1/zephyr/soc/intel/intel_ish/Kconfig"
osource "D:/watch/GItCode/zephyr_sdk/RTL87X3G_MCU_SDK_Watch_Zephyr_v1.14.3.1/zephyr/soc/intel/intel_adsp/Kconfig"
osource "D:/watch/GItCode/zephyr_sdk/RTL87X3G_MCU_SDK_Watch_Zephyr_v1.14.3.1/zephyr/soc/intel/elkhart_lake/Kconfig"
osource "D:/watch/GItCode/zephyr_sdk/RTL87X3G_MCU_SDK_Watch_Zephyr_v1.14.3.1/zephyr/soc/intel/atom/Kconfig"
osource "D:/watch/GItCode/zephyr_sdk/RTL87X3G_MCU_SDK_Watch_Zephyr_v1.14.3.1/zephyr/soc/intel/apollo_lake/Kconfig"
osource "D:/watch/GItCode/zephyr_sdk/RTL87X3G_MCU_SDK_Watch_Zephyr_v1.14.3.1/zephyr/soc/intel/alder_lake/Kconfig"
osource "D:/watch/GItCode/zephyr_sdk/RTL87X3G_MCU_SDK_Watch_Zephyr_v1.14.3.1/zephyr/soc/infineon/cat3/Kconfig"
osource "D:/watch/GItCode/zephyr_sdk/RTL87X3G_MCU_SDK_Watch_Zephyr_v1.14.3.1/zephyr/soc/infineon/cat1b/Kconfig"
osource "D:/watch/GItCode/zephyr_sdk/RTL87X3G_MCU_SDK_Watch_Zephyr_v1.14.3.1/zephyr/soc/infineon/cat1a/Kconfig"
osource "D:/watch/GItCode/zephyr_sdk/RTL87X3G_MCU_SDK_Watch_Zephyr_v1.14.3.1/zephyr/soc/gd/gd32/Kconfig"
osource "D:/watch/GItCode/zephyr_sdk/RTL87X3G_MCU_SDK_Watch_Zephyr_v1.14.3.1/zephyr/soc/gaisler/leon3/Kconfig"
osource "D:/watch/GItCode/zephyr_sdk/RTL87X3G_MCU_SDK_Watch_Zephyr_v1.14.3.1/zephyr/soc/gaisler/gr716a/Kconfig"
osource "D:/watch/GItCode/zephyr_sdk/RTL87X3G_MCU_SDK_Watch_Zephyr_v1.14.3.1/zephyr/soc/espressif/Kconfig"
osource "D:/watch/GItCode/zephyr_sdk/RTL87X3G_MCU_SDK_Watch_Zephyr_v1.14.3.1/zephyr/soc/ene/kb1200/Kconfig"
osource "D:/watch/GItCode/zephyr_sdk/RTL87X3G_MCU_SDK_Watch_Zephyr_v1.14.3.1/zephyr/soc/efinix/sapphire/Kconfig"
osource "D:/watch/GItCode/zephyr_sdk/RTL87X3G_MCU_SDK_Watch_Zephyr_v1.14.3.1/zephyr/soc/cdns/xtensa_sample_controller/Kconfig"
osource "D:/watch/GItCode/zephyr_sdk/RTL87X3G_MCU_SDK_Watch_Zephyr_v1.14.3.1/zephyr/soc/cdns/dc233c/Kconfig"
osource "D:/watch/GItCode/zephyr_sdk/RTL87X3G_MCU_SDK_Watch_Zephyr_v1.14.3.1/zephyr/soc/brcm/bcmvk/Kconfig"
osource "D:/watch/GItCode/zephyr_sdk/RTL87X3G_MCU_SDK_Watch_Zephyr_v1.14.3.1/zephyr/soc/brcm/bcm2712/Kconfig"
osource "D:/watch/GItCode/zephyr_sdk/RTL87X3G_MCU_SDK_Watch_Zephyr_v1.14.3.1/zephyr/soc/brcm/bcm2711/Kconfig"
osource "D:/watch/GItCode/zephyr_sdk/RTL87X3G_MCU_SDK_Watch_Zephyr_v1.14.3.1/zephyr/soc/atmel/sam0/Kconfig"
osource "D:/watch/GItCode/zephyr_sdk/RTL87X3G_MCU_SDK_Watch_Zephyr_v1.14.3.1/zephyr/soc/atmel/sam/Kconfig"
osource "D:/watch/GItCode/zephyr_sdk/RTL87X3G_MCU_SDK_Watch_Zephyr_v1.14.3.1/zephyr/soc/aspeed/Kconfig"
osource "D:/watch/GItCode/zephyr_sdk/RTL87X3G_MCU_SDK_Watch_Zephyr_v1.14.3.1/zephyr/soc/arm/Kconfig"
osource "D:/watch/GItCode/zephyr_sdk/RTL87X3G_MCU_SDK_Watch_Zephyr_v1.14.3.1/zephyr/soc/arm/beetle/Kconfig"
osource "D:/watch/GItCode/zephyr_sdk/RTL87X3G_MCU_SDK_Watch_Zephyr_v1.14.3.1/zephyr/soc/andestech/Kconfig"
osource "D:/watch/GItCode/zephyr_sdk/RTL87X3G_MCU_SDK_Watch_Zephyr_v1.14.3.1/zephyr/soc/ambiq/Kconfig"
osource "D:/watch/GItCode/zephyr_sdk/RTL87X3G_MCU_SDK_Watch_Zephyr_v1.14.3.1/zephyr/soc/altr/zephyr_nios2f/Kconfig"
osource "D:/watch/GItCode/zephyr_sdk/RTL87X3G_MCU_SDK_Watch_Zephyr_v1.14.3.1/zephyr/soc/altr/qemu_nios2/Kconfig"
osource "D:/watch/GItCode/zephyr_sdk/RTL87X3G_MCU_SDK_Watch_Zephyr_v1.14.3.1/zephyr/soc/adi/max32/Kconfig"
```

## applications/watch/dts/bindings/spi_m2s2m-gpio.yaml
```yaml
#
# Copyright (c) 2026, Realtek Semiconductor Corporation
#
# SPDX-License-Identifier: LicenseRef-Realtek-5-Clause
#

description: |
    This binding provides resources required to m2s and s2m for SPI.

compatible: "spi_m2s2m-gpio"

properties:
  m2s-gpios:
    type: phandle-array
    required: true
    description: M2S GPIO
  s2m-gpios:
    type: phandle-array
    required: true
    description: S2M GPIO
```

## applications/watch/dts/bindings/wifi_8711-device.yaml
```yaml
#
# Copyright (c) 2026, Realtek Semiconductor Corporation
#
# SPDX-License-Identifier: LicenseRef-Realtek-5-Clause
#

description: |
    This binding provides resources required to build and run the
    transceiver demo with spi.

compatible: "wifi_8711-device"

include: [spi-device.yaml]
```
