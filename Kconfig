## applications/bt_audio_trx/Kconfig
```kconfig
#
# Copyright (c) 2026, Realtek Semiconductor Corporation
#
# SPDX-License-Identifier: LicenseRef-Realtek-5-Clause
#

# This loads bt_audio_trx source code config
menu "Realtek bt_audio_trx Application"
	rsource "src/Kconfig"

config SOC_SERIES_RTL87X3G
	bool "Select RTL87X3G IC Type"
	default y
	help
		Select RTL87X3G IC Type.

config REALTEK_FILESYSTEM_EXFAT_SUPPORT
	bool "Realtek Filesystem exfat support"
	default y
	help
		Realtek Filesystem exfat support.

choice
	prompt "bank select"
	default REALTEK_COMMON_SDK_BANK0
	config REALTEK_COMMON_SDK_BANK0
		bool "build bank0 image"
	config REALTEK_COMMON_SDK_BANK1
		bool "build bank1 image"
endchoice

choice
	prompt "flash size select"
	default REALTEK_COMMON_SDK_4M
	config REALTEK_COMMON_SDK_4M
		bool "use 4M flash map"
	config REALTEK_COMMON_SDK_8M
		bool "use 8M flash map"
	config REALTEK_COMMON_SDK_16M
		bool "use 16M flash map"
endchoice
endmenu

config REALTEK_APP_GUI
	bool "Enable APP GUI Code"
	default n
	help
		Enable APP GUI Code.

config REALTEK_KEY_BUTTON_8773G_ZEPHYR_CS
	bool "Enable KEY Button Driver"
	default n
	help
		Enable KEY Button Driver.

config APP_WIFI_SDIO
	bool "Enable WiFi SDIO driver"
	default $(dt_alias_enabled,wifi-int)
	help
		Enable SDIO-based WiFi driver (wifi_sdio.c).
		Auto-detected:
		enabled when the DTS defines a wifi-int alias
		(e.g. rtl8783gbf_record_pen), disabled otherwise.

config REALTEK_APP_AI_RECORD
	bool "Enable AI Record feature"
	default n
	help
		Enable AI Record (pen) application code.

config REALTEK_APP_AI_AUTH
	bool "Enable AI Record authentication"
	default n
	help
		Enable AI Record RTK authentication module.

menu "Zephyr Kernel"
	source "Kconfig.zephyr"
endmenu
```

## applications/bt_audio_trx/dts/bindings/bt_audio_trx_gpio-keys.yaml
```yaml
#
# Copyright (c) 2026, Realtek Semiconductor Corporation
#
# SPDX-License-Identifier: LicenseRef-Realtek-5-Clause
#

description: |
    gpio keys for bt_audio_trx project.

compatible: "bt_audio_trx_gpio-keys"

properties:
  gpios:
    type: phandle-array
    required: true

  label:
    type: string
    required: true
```

## applications/bt_audio_trx/dts/bindings/bt_audio_trx_spi-device.yaml
```yaml
#
# Copyright (c) 2026, Realtek Semiconductor Corporation
#
# SPDX-License-Identifier: LicenseRef-Realtek-5-Clause
#

description: |
    This binding provides resources required to build and run the
    transceiver demo with spi.

compatible: "bt_audio_trx_spi-device"

include: [spi-device.yaml]
```

## applications/bt_audio_trx/dts/bindings/bt_audio_trx_spi-gpio.yaml
```yaml
#
# Copyright (c) 2026, Realtek Semiconductor Corporation
#
# SPDX-License-Identifier: LicenseRef-Realtek-5-Clause
#

description: |
    This binding provides resources required to m2s and s2m for SPI.

compatible: "bt_audio_trx_spi-gpio"

properties:
  m2s-gpios:
    type: phandle-array
    required: true
    description: M2S GPIO
  s2m-gpios:
    type: phandle-array
    required: true
    description: S2M GPIO
```

## applications/bt_audio_trx/dts/bindings/spi_m2s2m-device.yaml
```yaml
#
# Copyright (c) 2026, Realtek Semiconductor Corporation
#
# SPDX-License-Identifier: LicenseRef-Realtek-5-Clause
#

description: |
    This binding provides resources required to build and run the
    transceiver demo with spi.

compatible: "spi_m2s2m-device"

include: [spi-device.yaml]
```

## applications/bt_audio_trx/dts/bindings/wifi_8711-device.yaml
```yaml
#
# Copyright (c) 2026, Realtek Semiconductor Corporation
#
# SPDX-License-Identifier: LicenseRef-Realtek-5-Clause
#

description: |
    This binding provides resources required to build and run the
    wifi_8711 AT-over-SPI master module (src/wifi_8711).

compatible: "wifi_8711-device"

include: [spi-device.yaml]
```

## applications/bt_audio_trx/sample.yaml
```yaml
#
# Copyright (c) 2026, Realtek Semiconductor Corporation
#
# SPDX-License-Identifier: LicenseRef-Realtek-5-Clause
#

sample:
  description: bt_audio_trx sample
  name: bt_audio_trx
  includes:
    -path: dts/gpio-keys.yaml
common:
  tags: introduction
  integration_platforms:
    - native_sim
  harness: console
  harness_config:
    type: one_line
    regex:
      - "bt_audio_trx"
tests:
  sample.basic.helloworld:
    tags: introduction
```

## applications/bt_audio_trx/src/Kconfig
```kconfig
#
# Copyright (c) 2026, Realtek Semiconductor Corporation
#
# SPDX-License-Identifier: LicenseRef-Realtek-5-Clause
#

rsource "app_gfps/Kconfig"
rsource "findmy/Kconfig"
rsource "mfb/Kconfig"
rsource "key_button/Kconfig"
```

## applications/bt_audio_trx/src/findmy/Kconfig
```kconfig
#
# Copyright (c) 2026, Realtek Semiconductor Corporation
#
# SPDX-License-Identifier: LicenseRef-Realtek-5-Clause
#
	  
config REALTEK_FINDMY_FEATURE_SUPPORT
    bool "Enable Find My Network Feature"
    default n
    help
      Enable this option to support Apple Find My Network features.

config REALTEK_FINDMY_USE_UARP
    bool "Enable Find My Firmware Update"
    depends on REALTEK_FINDMY_FEATURE_SUPPORT
    default n
    help
      Enable this option to support firmware update function.

config REALTEK_FINDMY_SUPPORT_NFC
    bool "Enable Find My NFC Support"
    depends on REALTEK_FINDMY_FEATURE_SUPPORT
    default n
    help
      Enable this option to support NFC features for Find My.

config REALTEK_FINDMY_SUPPORT_CUSTOMIZED_APP
    bool "Enable Find My Customized App Support"
    depends on REALTEK_FINDMY_FEATURE_SUPPORT
    default n
    help
      Enable this option to support customized app interactions, instead of GFPS or system standard behavior.

config REALTEK_FINDMY_SUPPORT_DYNAMIC_SERVICE
    bool "Enable Find My Dynamic Service Availability"
    depends on REALTEK_FINDMY_FEATURE_SUPPORT
    default n
    help
      Enable this option to support Service Availability feature.
```

## applications/bt_audio_trx/src/gfps/Kconfig
```kconfig
#
# Copyright (c) 2026, Realtek Semiconductor Corporation
#
# SPDX-License-Identifier: LicenseRef-Realtek-5-Clause
#

config REALTEK_GFPS_FEATURE_SUPPORT
    bool "Enable GFPS Feature"
    default n
    help
      Enable this option to support Google Fast Pair Service (GFPS) features.

config REALTEK_GFPS_FINDER_SUPPORT
    bool "Enable GFPS Finder Support"
    depends on REALTEK_GFPS_FEATURE_SUPPORT
    default n
    help
      Enable this option to support GFPS Finder features. Requires GFPS Feature enabled.

config REALTEK_GFPS_LE_DEVICE_SUPPORT
    bool "Enable GFPS Bluetooth LE Device Support"
    depends on REALTEK_GFPS_FEATURE_SUPPORT
    default n
    help
      Enable this option to support GFPS Bluetooth Low Energy device features. Requires GFPS Feature enabled.
```

## applications/bt_audio_trx/src/key_button/Kconfig
```kconfig
#
# Copyright (c) 2026, Realtek Semiconductor Corporation
#
# SPDX-License-Identifier: LicenseRef-Realtek-5-Clause
#

config REALTEK_KEY_BUTTON_8773G_ZEPHYR
	bool "Enable Realtek Key/Button Deivce with Zephyr code style"
	default n
	help
		This config for realtek Key/Button device driver

config REALTEK_INPUT_INIT_PRIORITY
	int "Realtek Input Init Priority of Zephyr"
	default 60
	help
		This config for realtek input init priority of zephyr
```

## applications/bt_audio_trx/src/mfb/Kconfig
```kconfig
#
# Copyright (c) 2026, Realtek Semiconductor Corporation
#
# SPDX-License-Identifier: LicenseRef-Realtek-5-Clause
#

config MFB
	bool "Enable mfb"
	default n
help
	This config for enable mfb
```

## applications/bt_audio_trx/src/wifi_8711/Kconfig
```kconfig
#
# Copyright (c) 2026, Realtek Semiconductor Corporation
#
# SPDX-License-Identifier: LicenseRef-Realtek-5-Clause
#

menu "WiFi-8711 (AT-over-SPI) transport module"

config WIFI_8711
	bool "Enable the WiFi-8711 AT-over-SPI transport module"
	default n
	select RING_BUFFER
	help
	  Compile the bt_audio_trx SPI transport module (src/wifi_8711)
	  that talks to the external RTL8711 WiFi chip over SPI. Replaces the
	  former app_flags.h F_APP_SPI_ROLE_* / F_APP_WIFI_SPI_CMD gating.
	  Pull it in via the wifi_8711 snippet or a per-variant board overlay
	  (record_pen / transceiver). RING_BUFFER (the SPI master TX cache) is
	  the module's own dependency and is selected here. The shared SPI stack
	  (SPI / SPI_SLAVE / SPI_ASYNC / SPI_RTL87X3G_DMA) lives in prj.conf
	  because other features use SPI too.

if WIFI_8711

config WIFI_8711_ROLE_MASTER
	bool "SPI master role (drive the 8711 slave)"
	default y
	help
	  Compile the SPI master transport (app_spi_master_zephyr.c). This is
	  the common case: the RTL87x3G is the SPI master toward the 8711.

config WIFI_8711_CMD
	bool "AT-command / TCP-TP command path"
	default n
	help
	  Compile the AT-command and TCP throughput test path
	  (app_spi_atcmd.c, spi_tcp_tp_test.c, app_spi_sd_source.c) and enlarge
	  SPI_XMIT_SIZE to 16K for bulk transfers.

endif # WIFI_8711

endmenu
```

## applications/watch/Kconfig
```kconfig
#
# Copyright (c) 2026, Realtek Semiconductor Corporation
#
# SPDX-License-Identifier: LicenseRef-Realtek-5-Clause
#

# This loads watch source code config
menu "Realtek Watch Application"
rsource "src/Kconfig"
endmenu

config APP_NANDBOOT
    bool "Compile app code with NANDBOOT support"
	default n
    select REALTEK_LIBS_NANDBOOT if y
    help
        Compile app code with NANDBOOT support.

menu "Zephyr Kernel"
source "Kconfig.zephyr"
endmenu
```

## applications/watch/boards/rtl87x3g_watch_rtl8773gtp_nandboot.conf
```kconfig
CONFIG_APP_NANDBOOT=y
CONFIG_FS_FATFS_MAX_SS=2048
CONFIG_DISK_DRIVER_NAND_FLASH_RTK=y
CONFIG_FS_FATFS_MOUNT_MKFS=y
CONFIG_DISK_DRIVER_SDMMC=n
CONFIG_REALTEK_HONEYGUI_410_502_HMI_SMARTWATCH_DEMO=y
CONFIG_PM=y
```

## applications/watch/build/Kconfig/Kconfig.modules
```kconfig
menu "cmsis (D:/watch/GItCode/zephyr_sdk/RTL87X3G_MCU_SDK_Watch_Zephyr_v1.14.3.1/modules/hal/cmsis)"
osource "$(ZEPHYR_CMSIS_KCONFIG)"
config ZEPHYR_CMSIS_MODULE
	bool
	default y
endmenu
config ZEPHYR_TINYCRYPT_MODULE
   bool
   default y
menu "mbedtls (D:/watch/GItCode/zephyr_sdk/RTL87X3G_MCU_SDK_Watch_Zephyr_v1.14.3.1/modules/crypto/mbedtls)"
osource "$(ZEPHYR_MBEDTLS_KCONFIG)"
config ZEPHYR_MBEDTLS_MODULE
	bool
	default y
endmenu
menu "fatfs (D:/watch/GItCode/zephyr_sdk/RTL87X3G_MCU_SDK_Watch_Zephyr_v1.14.3.1/modules/fs/fatfs)"
osource "$(ZEPHYR_FATFS_KCONFIG)"
config ZEPHYR_FATFS_MODULE
	bool
	default y
endmenu
menu "honeygui (D:/watch/GItCode/zephyr_sdk/RTL87X3G_MCU_SDK_Watch_Zephyr_v1.14.3.1/modules/honeygui)"
osource "D:/watch/GItCode/zephyr_sdk/RTL87X3G_MCU_SDK_Watch_Zephyr_v1.14.3.1/modules/honeygui/Kconfig.gui"
config ZEPHYR_HONEYGUI_MODULE
	bool
	default y
endmenu
menu "lvgl (D:/watch/GItCode/zephyr_sdk/RTL87X3G_MCU_SDK_Watch_Zephyr_v1.14.3.1/modules/lvgl)"
osource "D:/watch/GItCode/zephyr_sdk/RTL87X3G_MCU_SDK_Watch_Zephyr_v1.14.3.1/modules/lvgl/Kconfig"
config ZEPHYR_LVGL_MODULE
	bool
	default y
endmenu
menu "display (D:/watch/GItCode/zephyr_sdk/RTL87X3G_MCU_SDK_Watch_Zephyr_v1.14.3.1/modules/display)"
osource "D:/watch/GItCode/zephyr_sdk/RTL87X3G_MCU_SDK_Watch_Zephyr_v1.14.3.1/modules/display/Kconfig"
config ZEPHYR_DISPLAY_MODULE
	bool
	default y
endmenu
menu "realtek (D:/watch/GItCode/zephyr_sdk/RTL87X3G_MCU_SDK_Watch_Zephyr_v1.14.3.1/modules/hal/realtek)"
osource "D:/watch/GItCode/zephyr_sdk/RTL87X3G_MCU_SDK_Watch_Zephyr_v1.14.3.1/modules/hal/realtek/Kconfig"
config ZEPHYR_REALTEK_MODULE
	bool
	default y
endmenu
menu "realtek-app (D:/watch/GItCode/zephyr_sdk/RTL87X3G_MCU_SDK_Watch_Zephyr_v1.14.3.1/realtek-app)"
osource "D:/watch/GItCode/zephyr_sdk/RTL87X3G_MCU_SDK_Watch_Zephyr_v1.14.3.1/realtek-app/Kconfig"
config ZEPHYR_REALTEK_APP_MODULE
	bool
	default y
endmenu
```

## applications/watch/build/Kconfig/Kconfig.shield.defconfig
```kconfig
osource "D:/watch/GItCode/zephyr_sdk/RTL87X3G_MCU_SDK_Watch_Zephyr_v1.14.3.1/realtek-app/boards/shields/*/Kconfig.defconfig"
```

## applications/watch/build/Kconfig/Kconfig.sysbuild.modules
```kconfig
config ZEPHYR_CMSIS_MODULE
   bool
   default y
config ZEPHYR_TINYCRYPT_MODULE
   bool
   default y
config ZEPHYR_MBEDTLS_MODULE
   bool
   default y
config ZEPHYR_FATFS_MODULE
   bool
   default y
config ZEPHYR_HONEYGUI_MODULE
   bool
   default y
config ZEPHYR_LVGL_MODULE
   bool
   default y
config ZEPHYR_DISPLAY_MODULE
   bool
   default y
config ZEPHYR_REALTEK_MODULE
   bool
   default y
config ZEPHYR_REALTEK_APP_MODULE
   bool
   default y
```

## applications/watch/build/Kconfig/arch/Kconfig
```kconfig
# Load arch Kconfig descriptions.
osource "D:/watch/GItCode/zephyr_sdk/RTL87X3G_MCU_SDK_Watch_Zephyr_v1.14.3.1/zephyr/arch/x86/Kconfig"
osource "D:/watch/GItCode/zephyr_sdk/RTL87X3G_MCU_SDK_Watch_Zephyr_v1.14.3.1/zephyr/arch/xtensa/Kconfig"
osource "D:/watch/GItCode/zephyr_sdk/RTL87X3G_MCU_SDK_Watch_Zephyr_v1.14.3.1/zephyr/arch/sparc/Kconfig"
osource "D:/watch/GItCode/zephyr_sdk/RTL87X3G_MCU_SDK_Watch_Zephyr_v1.14.3.1/zephyr/arch/riscv/Kconfig"
osource "D:/watch/GItCode/zephyr_sdk/RTL87X3G_MCU_SDK_Watch_Zephyr_v1.14.3.1/zephyr/arch/posix/Kconfig"
osource "D:/watch/GItCode/zephyr_sdk/RTL87X3G_MCU_SDK_Watch_Zephyr_v1.14.3.1/zephyr/arch/nios2/Kconfig"
osource "D:/watch/GItCode/zephyr_sdk/RTL87X3G_MCU_SDK_Watch_Zephyr_v1.14.3.1/zephyr/arch/mips/Kconfig"
osource "D:/watch/GItCode/zephyr_sdk/RTL87X3G_MCU_SDK_Watch_Zephyr_v1.14.3.1/zephyr/arch/arm64/Kconfig"
osource "D:/watch/GItCode/zephyr_sdk/RTL87X3G_MCU_SDK_Watch_Zephyr_v1.14.3.1/zephyr/arch/arm/Kconfig"
osource "D:/watch/GItCode/zephyr_sdk/RTL87X3G_MCU_SDK_Watch_Zephyr_v1.14.3.1/zephyr/arch/arc/Kconfig"
```
